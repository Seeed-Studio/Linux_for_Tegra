// SPDX-License-Identifier: GPL-2.0-only
// SPDX-FileCopyrightText: Copyright (c) 2023, NVIDIA CORPORATION & AFFILIATES.  All rights reserved.
/*
 * Device-tree overlay for Adafruit I2S MEMS Microphone Breakout
 * (SPH0645LM4H) with board tegra234-p3767-0000 based platforms.
 */

/dts-v1/;
/plugin/;

#include <dt-bindings/tegra234-p3767-0000-common.h>
#include <overlay/jetson-audio-adafruit-sph0645lm4h.dtsi>
