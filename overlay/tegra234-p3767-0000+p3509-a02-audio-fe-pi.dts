// SPDX-License-Identifier: GPL-2.0-only
/*
 * Copyright (c) 2023, NVIDIA CORPORATION.  All rights reserved.
 *
 * Device-tree overlay for FE-PI Audio V1 and Z V2 with board
 * tegra234-p3767-0000 based platforms.
 */

/dts-v1/;
/plugin/;

#include <dt-bindings/tegra234-p3767-0000-common.h>
#include <overlay/jetson-audio-fe-pi.dtsi>
