// SPDX-License-Identifier: GPL-2.0-only
// Copyright (c) 2022-2023, NVIDIA CORPORATION & AFFILIATES.  All rights reserved.

#include "tegra234-base-overlay.dtsi"
#include "tegra234-soc-overlay.dtsi"
#include "tegra234-soc-prod-overlay.dtsi"
#include "tegra234-soc-display-overlay.dtsi"

/ {
};
