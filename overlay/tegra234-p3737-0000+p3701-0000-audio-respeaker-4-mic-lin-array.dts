// SPDX-License-Identifier: GPL-2.0-only
/*
 * Copyright (c) 2022-2023, NVIDIA CORPORATION.  All rights reserved.
 *
 * Device-tree overlay for ReSpeaker 4-Mic Array with board
 * tegra234-p3737-0000-p3701-0000.
 */

/dts-v1/;
/plugin/;

#include <dt-common/jetson/tegra234-p3737-0000-p3701-0000.h>
#include <overlays/jetson-respeaker-4-mic-lin-array.dts>
