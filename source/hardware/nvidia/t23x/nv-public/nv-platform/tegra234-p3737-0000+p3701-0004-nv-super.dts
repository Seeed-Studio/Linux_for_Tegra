// SPDX-License-Identifier: GPL-2.0-only
// SPDX-FileCopyrightText: Copyright (c) 2026, NVIDIA CORPORATION & AFFILIATES.  All rights reserved.

/dts-v1/;

#include "tegra234-p3737-0000+p3701-0004-nv.dts"

/ {
	compatible = "nvidia,p3737-0000+p3701-0004-super", "nvidia,p3701-0004", "nvidia,tegra234";
	model = "NVIDIA Jetson AGX Orin Developer Kit Super";
};
