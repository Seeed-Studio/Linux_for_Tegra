// SPDX-License-Identifier: GPL-2.0-only
// SPDX-FileCopyrightText: Copyright (c) 2023, NVIDIA CORPORATION & AFFILIATES.  All rights reserved.

/dts-v1/;

#include "tegra234-j401-p3768-0000+p3767-recomputer-common.dts"

/ {
        compatible = "nvidia,p3768-0000+p3767-0000-super", "nvidia,p3767-0000", "nvidia,tegra234";
        model = "NVIDIA Jetson Orin NX Engineering Reference Developer Kit Super";
};
