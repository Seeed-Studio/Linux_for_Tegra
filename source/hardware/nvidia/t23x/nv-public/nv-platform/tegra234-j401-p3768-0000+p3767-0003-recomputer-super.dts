// SPDX-License-Identifier: GPL-2.0-only
// SPDX-FileCopyrightText: Copyright (c) 2023, NVIDIA CORPORATION & AFFILIATES.  All rights reserved.

/dts-v1/;

#include "tegra234-j401-p3768-0000+p3767-recomputer-super-common.dts"

/ {
        compatible = "nvidia,p3768-0000+p3767-0003-super", "nvidia,p3767-0003", "nvidia,tegra234";
        model = "NVIDIA Jetson Orin Nano Seeed recomputer classic Super";
};

/delete-node/ &{/opp-table-cluster0/opp-1510400000};
/delete-node/ &{/opp-table-cluster1/opp-1510400000};
/delete-node/ &{/opp-table-cluster2/opp-1510400000};
