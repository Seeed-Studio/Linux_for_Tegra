// SPDX-License-Identifier: GPL-2.0-only
// SPDX-FileCopyrightText: Copyright (c) 2023, NVIDIA CORPORATION & AFFILIATES.  All rights reserved.
/*
 * Device-tree overlay for ReSpeaker 4-Mic Array with board
 * tegra234-p3767-0000 based platforms.
 */

/dts-v1/;
/plugin/;
#include <dt-bindings/tegra234-p3767-0000-common.h>
#include <overlay/jetson-audio-respeaker-4-mic-lin-array.dtsi>
