// SPDX-License-Identifier: GPL-2.0-only
// SPDX-FileCopyrightText: Copyright (c) 2024, NVIDIA CORPORATION & AFFILIATES.  All rights reserved.
//
// This file contains the Android bootargs for the kdump enabled kernel

/dts-v1/;
/plugin/;

#include <dt-bindings/tegra234-android-bootargs.h>

/ {
	fragment-t234-android@0 {
		target-path = "/";
		 __overlay__ {
			chosen {
				bootargs=ANDROID_KDUMP_BOOTARGS;
			};
		 };
	};
};
