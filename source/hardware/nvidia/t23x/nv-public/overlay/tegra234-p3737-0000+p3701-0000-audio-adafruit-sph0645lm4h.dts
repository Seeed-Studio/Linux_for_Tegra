// SPDX-License-Identifier: GPL-2.0-only
// SPDX-FileCopyrightText: Copyright (c) 2021-2023, NVIDIA CORPORATION & AFFILIATES.  All rights reserved.
/*
 *
 * Device-tree overlay for Adafruit I2S MEMS Microphone Breakout
 * (SPH0645LM4H) with board tegra234-p3737-0000-p3701-0000.
 */

/dts-v1/;
/plugin/;

#include <dt-bindings/tegra234-p3737-0000+p3701-0000.h>
#include <overlay/jetson-audio-adafruit-sph0645lm4h.dtsi>
