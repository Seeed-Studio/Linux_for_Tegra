## source/nvidia-oot/Documentation/devicetree/bindings/platform/tegra/rtcpu/nvidia,tegra186-camera-ivc-protocol-capture-control.yaml
```yaml
# Copyright (c) 2024, NVIDIA CORPORATION & AFFILIATES.  All rights reserved.
#
# This program is free software; you can redistribute it and/or modify it
# under the terms and conditions of the GNU General Public License,
# version 2, as published by the Free Software Foundation.
#
# This program is distributed in the hope it will be useful, but WITHOUT
# ANY WARRANTY; without even the implied warranty of MERCHANTABILITY or
# FITNESS FOR A PARTICULAR PURPOSE.  See the GNU General Public License for
# more details.

%YAML 1.2
---
$id: http://devicetree.org/schemas/ivccontrol@3/nvidia,tegra186-camera-ivc-protocol-capture-control.yaml#
$schema: http://devicetree.org/meta-schemas/core.yaml#

title: NVIDIA Tegra Capture IVC driver

maintainers:
  - Evgeny Kornev

description: |
     the compatability = nvidia,tegra186-camera-ivc-protocol-capture-control is mentioned in the following drivers
        - <TOP>/kernel/nvidia-oot/drivers/platform/tegra/rtcpu/capture-ivc.c

     The following nodes use this compatibility
        - /camera-ivc-channels/ivccontrol@3

select:
  properties:
    compatible:
        minItems: 1
        maxItems: 1
        items:
            enum:
                - nvidia,tegra186-camera-ivc-protocol-capture-control

  required:
    - compatible

properties:

    nvidia,service:
        $ref: "/schemas/types.yaml#/definitions/string-array"
        items:
            enum:
                - capture-control


    nvidia,version:
        $ref: "/schemas/types.yaml#/definitions/uint32"
        minimum: 0x0
        maximum: 0x0

    nvidia,group:
        $ref: "/schemas/types.yaml#/definitions/uint32"
        minimum: 0x1
        maximum: 0x1

    nvidia,frame-count:
        $ref: "/schemas/types.yaml#/definitions/uint32"
        minimum: 0x40
        maximum: 0x40

    nvidia,frame-size:
        $ref: "/schemas/types.yaml#/definitions/uint32"
        minimum: 0x140
        maximum: 0x140

required:
    - compatible

examples:
    - |
        ivccontrol@3 {
            compatible = "nvidia,tegra186-camera-ivc-protocol-capture-control";
            nvidia,service = "capture-control";
            nvidia,version = <0>;
            nvidia,group = <1>;
            nvidia,frame-count = <64>;
            nvidia,frame-size = <320>;
            status = "disabled";
        };
```

## source/nvidia-oot/Documentation/devicetree/bindings/platform/tegra/rtcpu/nvidia,tegra186-camera-ivc-protocol-debug.yaml
```yaml
# Copyright (c) 2024, NVIDIA CORPORATION & AFFILIATES.  All rights reserved.
#
# This program is free software; you can redistribute it and/or modify it
# under the terms and conditions of the GNU General Public License,
# version 2, as published by the Free Software Foundation.
#
# This program is distributed in the hope it will be useful, but WITHOUT
# ANY WARRANTY; without even the implied warranty of MERCHANTABILITY or
# FITNESS FOR A PARTICULAR PURPOSE.  See the GNU General Public License for
# more details.

%YAML 1.2
---
$id: http://devicetree.org/schemas/dbg@2/nvidia,tegra186-camera-ivc-protocol-debug.yaml#
$schema: http://devicetree.org/meta-schemas/core.yaml#

title: Debug Driver for Camera RTCPU

maintainers:
  - Evgeny Kornev

description: |
     the compatability = nvidia,tegra186-camera-ivc-protocol-debug is mentioned in the following drivers
        - <TOP>/kernel/nvidia-oot/drivers/platform/tegra/rtcpu/rtcpu-debug.c

     The following nodes use this compatibility
        - /camera-ivc-channels/dbg@2

select:
  properties:
    compatible:
        minItems: 1
        maxItems: 1
        items:
            enum:
                - nvidia,tegra186-camera-ivc-protocol-debug

  required:
    - compatible

properties:

    nvidia,service:
        $ref: "/schemas/types.yaml#/definitions/string-array"
        items:
            enum:
                - debug


    nvidia,version:
        $ref: "/schemas/types.yaml#/definitions/uint32"
        minimum: 0x0
        maximum: 0x0

    nvidia,group:
        $ref: "/schemas/types.yaml#/definitions/uint32"
        minimum: 0x1
        maximum: 0x1

    nvidia,frame-count:
        $ref: "/schemas/types.yaml#/definitions/uint32"
        minimum: 0x1
        maximum: 0x1

    nvidia,frame-size:
        $ref: "/schemas/types.yaml#/definitions/uint32"
        minimum: 0x2000
        maximum: 0x2000

    nvidia,ivc-timeout:
        $ref: "/schemas/types.yaml#/definitions/uint32"
        minimum: 0x32
        maximum: 0x32

    nvidia,test-timeout:
        $ref: "/schemas/types.yaml#/definitions/uint32"
        minimum: 0x1388
        maximum: 0x1388

    nvidia,mem-map:
        $ref: "/schemas/types.yaml#/definitions/uint32-matrix"
        items:
            minItems: 5
            maxItems: 5
            items:
                - $ref: "/schemas/types.yaml#/definitions/uint32"
                - $ref: "/schemas/types.yaml#/definitions/uint32"
                - $ref: "/schemas/types.yaml#/definitions/uint32"
                - $ref: "/schemas/types.yaml#/definitions/uint32"
                - $ref: "/schemas/types.yaml#/definitions/uint32"

    nvidia,test-bw:
        $ref: "/schemas/types.yaml#/definitions/uint32"
        minimum: 0x249f00
        maximum: 0x249f00

required:
    - compatible

examples:
    - |
        dbg@2 {
            compatible = "nvidia,tegra186-camera-ivc-protocol-debug";
            nvidia,service = "debug";
            nvidia,version = <0>;
            nvidia,group = <1>;
            nvidia,frame-count = <1>;
            nvidia,frame-size = <8192>;
            nvidia,ivc-timeout = <50>;
            nvidia,test-timeout = <5000>;
            nvidia,mem-map = <&tegra_rce &vi0 &isp &vi1 &isp1>;
            nvidia,test-bw = <2400000>;
            status = "disabled";
        };
```

## source/nvidia-oot/Documentation/devicetree/bindings/platform/tegra/tegra-fsicom.yaml
```yaml
# SPDX-License-Identifier: (GPL-2.0 OR BSD-2-Clause)
%YAML 1.2
---
$id: http://devicetree.org/schemas/platform/tegra/tegra-fsicom.yaml#
$schema: http://devicetree.org/meta-schemas/core.yaml#

title: Device tree binding for NVIDIA Tegra FSICOM

maintainers:
  - Rahul Bedarkar <rabedarkar@nvidia.com>

description: |
   The tegra-fsicom driver provides interface for communication with Functional Safety Island (FSI)

properties:
  compatible:
    enum:
      - nvidia,tegra234-fsicom-client

  mboxes:
    maxItems: 2
    description: |
       Specifies Tx and RX mailboxes for read/write notification.

  mbox-names:
    maxItems: 2
    description: |
       Specifies the name for Tx and Rx mailboxes. Expected Tx mailbox name is "fsi-tx" and Rx mailbox name is "fsi-rx".

  iommus:
    maxItems: 1
    description: |
       A list of phandle and IOMMU specifier pairs that describe the IOMMU master interfaces of the device.

  iommu-resv-regions:
    maxItems: 1
    description: |
       Pairs of upper and lower start addresses and sizes to reserve memory regions.

  dma-coherent:
    description: |
       Present if dma operations are coherent

required:
  - compatible
  - mboxes
  - mbox-names
  - iommus
  - iommu-resv-regions

additionalProperties: false

examples:
  - |
    #include <dt-bindings/mailbox/tegra186-hsp.h>
    #define TEGRA_SID_NISO1_FSI		0x11U
    #define TEGRA_HSP_MBOX_TYPE_SM_128BIT (1 << 8)

    soc {
        fsicom_client {
            compatible = "nvidia,tegra234-fsicom-client";
            mboxes =
                <&hsp_top2 (TEGRA_HSP_MBOX_TYPE_SM | TEGRA_HSP_MBOX_TYPE_SM_128BIT) TEGRA_HSP_SM_TX(3)>,
                <&hsp_top2 (TEGRA_HSP_MBOX_TYPE_SM | TEGRA_HSP_MBOX_TYPE_SM_128BIT) TEGRA_HSP_SM_RX(2)>;
            mbox-names = "fsi-tx", "fsi-rx";
            iommus = <&smmu_niso1 TEGRA_SID_NISO1_FSI>;
            iommu-resv-regions = <0x0 0x0 0x0 0xF0000000 0x0 0xF1000000 0xffffffff 0xffffffff>;
            dma-coherent;
        };

     };
...
```

## source/nvidia-oot/Documentation/devicetree/bindings/platform/tegra/tegra23x-mce.yaml
```yaml
# SPDX-License-Identifier: (GPL-2.0 OR BSD-2-Clause)
# Copyright (c) 2022, NVIDIA CORPORATION & AFFILIATES. All rights reserved.
%YAML 1.2
---
$id: http://devicetree.org/schemas/platform/tegra/tegra23x-mce.yaml#
$schema: http://devicetree.org/meta-schemas/core.yaml#

title: Device tree binding for NVIDIA Tegra23x MCE

maintainers:
  - Sanjay Chandrashekara <sanjayc@nvidia.com>
  - Eric Funsten <efunsten@nvidia.com>

description: |
   The tegra23x-mce driver provides an interface for sending ARI requests to MCE

properties:
  compatible:
    enum:
      - nvidia,t23x-mce

  reg:
    minItems: 12
    maxItems: 12
    description: |
       Address and size pairs of NS-ARI MMCRAB registers.

required:
  - compatible
  - reg

additionalProperties: false

examples:
  - |
    tegra_mce@e100000 {
				compatible = "nvidia,t23x-mce";
				reg =   <0x0 0x0E100000 0x0 0x00010000>, /* ARI BASE Core 0*/
						<0x0 0x0E110000 0x0 0x00010000>,
						<0x0 0x0E120000 0x0 0x00010000>,
						<0x0 0x0E130000 0x0 0x00010000>,
						<0x0 0x0E140000 0x0 0x00010000>,
						<0x0 0x0E150000 0x0 0x00010000>,
						<0x0 0x0E160000 0x0 0x00010000>,
						<0x0 0x0E170000 0x0 0x00010000>,
						<0x0 0x0E180000 0x0 0x00010000>,
						<0x0 0x0E190000 0x0 0x00010000>,
						<0x0 0x0E1A0000 0x0 0x00010000>,
						<0x0 0x0E1B0000 0x0 0x00010000>;
    };
...
```

## source/nvidia-oot/Documentation/devicetree/bindings/platform/tegra/tegra_bootloader_debug.yaml
```yaml
# SPDX-License-Identifier: (GPL-2.0 OR BSD-2-Clause)
%YAML 1.2
---
$id: http://devicetree.org/schemas/platform/tegra/tegra_bootloader_debug.yaml#
$schema: http://devicetree.org/meta-schemas/core.yaml#

title: Device tree binding for NVIDIA Tegra Bootloader Debug

maintainers:
  - Deepak Nibade <dnibade@nvidia.com>

description: |
   The tegra_bootloader_debug driver provides infrastructure to profile Boot and Resume KPIs

properties:
  compatible:
    enum:
      - nvidia,tegra_bl_debug

required:
  - compatible

additionalProperties: false

examples:
  - |
    profiler_device {
        compatible = "nvidia,tegra_bl_debug";
        usec_timer_reg_base = <0x0C240000>; /* USEC_CNTR_USECCVR_0 */
        status = "okay";
    };
...
```
