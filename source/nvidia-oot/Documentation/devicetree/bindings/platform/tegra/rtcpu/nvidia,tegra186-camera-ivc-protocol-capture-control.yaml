## source/nvidia-oot/Documentation/devicetree/bindings/video/tegra/host/pva/nvidia,pva-tegra264-iommu-context.yaml
```yaml
# Copyright (c) 2024, NVIDIA CORPORATION & AFFILIATES.  All rights reserved.
#
# This program is free software; you can redistribute it and/or modify it
# under the terms and conditions of the GNU General Public License,
# version 2, as published by the Free Software Foundation.
#
# This program is distributed in the hope it will be useful, but WITHOUT
# ANY WARRANTY; without even the implied warranty of MERCHANTABILITY or
# FITNESS FOR A PARTICULAR PURPOSE.  See the GNU General Public License for
# more details.

%YAML 1.2
---
$id: http://devicetree.org/schemas/pva0_niso1_ctx0/nvidia,pva-tegra264-iommu-context.yaml#
$schema: http://devicetree.org/meta-schemas/core.yaml#

title: PVA Application Specific Virtual Memory

maintainers:
  - Omar Nemri

description: |
     the compatability = nvidia,pva-tegra264-iommu-context is mentioned in the following drivers
        - <TOP>/kernel/nvidia-oot/drivers/video/tegra/host/pva/pva_iommu_context_dev.c

     The following nodes use this compatibility
        - /bus@0/host1x@8181200000/pva0@818c000000/pva0_niso1_ctx0
        - /bus@0/host1x@8181200000/pva0@818c000000/pva0_niso1_ctx1
        - /bus@0/host1x@8181200000/pva0@818c000000/pva0_niso1_ctx2
        - /bus@0/host1x@8181200000/pva0@818c000000/pva0_niso1_ctx3
        - /bus@0/host1x@8181200000/pva0@818c000000/pva0_niso1_ctx4
        - /bus@0/host1x@8181200000/pva0@818c000000/pva0_niso1_ctx5
        - /bus@0/host1x@8181200000/pva0@818c000000/pva0_niso1_ctx6
        - /bus@0/host1x@8181200000/pva0@818c000000/pva0_niso1_ctx7
        - /bus@0/host1x@8181200000/pva0@818c000000/pva0_niso1_ctx8

select:
  properties:
    compatible:
        minItems: 1
        maxItems: 1
        items:
            enum:
                - nvidia,pva-tegra264-iommu-context

  required:
    - compatible

properties:

    iommus:
        $ref: "/schemas/types.yaml#/definitions/uint32-matrix"
        description: |
            iommus are given by a tuple of 2 values:
                - Phandle to the device
                - Device ID
        items:
            minItems: 2
            maxItems: 2
            items:
                - $ref: "/schemas/types.yaml#/definitions/uint32"
                - $ref: "/schemas/types.yaml#/definitions/uint32"
                  minimum: 0x1101
                  maximum: 0x1109

    dma-coherent:
        $ref: "/schemas/types.yaml#/definitions/flag"

required:
    - compatible
    - iommus

examples:
    - |
        pva0_niso1_ctx0 {
            compatible = "nvidia,pva-tegra264-iommu-context";
            iommus = <&smmu4_mmu (TEGRA_SID_PVA+0x2)>;
            dma-coherent;
            status = "disabled";
        };
```

## source/nvidia-oot/Documentation/devicetree/bindings/video/tegra/host/pva/nvidia,tegra264-pva.yaml
```yaml
# Copyright (c) 2024, NVIDIA CORPORATION & AFFILIATES.  All rights reserved.
#
# This program is free software; you can redistribute it and/or modify it
# under the terms and conditions of the GNU General Public License,
# version 2, as published by the Free Software Foundation.
#
# This program is distributed in the hope it will be useful, but WITHOUT
# ANY WARRANTY; without even the implied warranty of MERCHANTABILITY or
# FITNESS FOR A PARTICULAR PURPOSE.  See the GNU General Public License for
# more details.

%YAML 1.2
---
$id: http://devicetree.org/schemas/pva0@818c000000/nvidia,tegra264-pva.yaml#
$schema: http://devicetree.org/meta-schemas/core.yaml#

title: Tegra Programable Vision Accelerator Module

maintainers:
  - Omar Nemri

description: |
     the compatability = nvidia,tegra264-pva is mentioned in the following drivers
        - <TOP>/kernel/nvidia-oot/drivers/video/tegra/host/pva/pva.c

     The following nodes use this compatibility
        - /bus@0/host1x@8181200000/pva0@818c000000

select:
  properties:
    compatible:
        minItems: 2
        maxItems: 2
        items:
            enum:
                - nvidia,tegra264-pva
                - simple-bus

  required:
    - compatible

properties:

    reg:
        $ref: "/schemas/types.yaml#/definitions/uint32-matrix"
        description: |
            Registers are given by a tuple of two values:
                - register address:
                - register block size.
        items:
            minItems: 4
            maxItems: 4
            items:
                - $ref: "/schemas/types.yaml#/definitions/uint32"
                  minimum: 0x0
                  maximum: 0x81
                - $ref: "/schemas/types.yaml#/definitions/uint32"
                  minimum: 0x10700000
                  maximum: 0x8c000000
                - $ref: "/schemas/types.yaml#/definitions/uint32"
                  minimum: 0x0
                  maximum: 0x0
                - $ref: "/schemas/types.yaml#/definitions/uint32"
                  minimum: 0x100000
                  maximum: 0x900000

    interrupts:
        $ref: "/schemas/types.yaml#/definitions/uint32-matrix"
        description: |
            Interrupts are give by a tuple of 3 values:
                - interrupt specifier (GIC_SPI = 0, GIC_PPI = 1)
                  definitions in dt-bindings/interrupt-controller/arm-gic.h
                - interrupt number
                - trigger type (rising edge, falling edge, both, etc)
                  definitions in dt-bindings/interrupt-controller/irq.h
        items:
            items:
                - $ref: "/schemas/types.yaml#/definitions/uint32"
                  minimum: 0x0
                  maximum: 0x0
                - $ref: "/schemas/types.yaml#/definitions/uint32"
                  minimum: 0x195
                  maximum: 0x19d
                - $ref: "/schemas/types.yaml#/definitions/uint32"
                  minimum: 0x4
                  maximum: 0x4

    resets:
        $ref: "/schemas/types.yaml#/definitions/uint32-matrix"
        description: |
            Resets are given by a tuple of 2 values:
                - Phandle to the device
                - Reset ID
        items:
            minItems: 2
            maxItems: 2
            items:
                - $ref: "/schemas/types.yaml#/definitions/uint32"
                - $ref: "/schemas/types.yaml#/definitions/uint32"
                  minimum: 0x30
                  maximum: 0x30

    reset-names:
        $ref: "/schemas/types.yaml#/definitions/string-array"
        items:
            enum:
                - pva0


    clocks:
        $ref: "/schemas/types.yaml#/definitions/uint32-matrix"
        description: |
            Clocks are given by a tuple of 2 values:
                - Phandle to the device
                - Clock ID
        items:
            minItems: 2
            maxItems: 2
            items:
                - $ref: "/schemas/types.yaml#/definitions/uint32"
                - $ref: "/schemas/types.yaml#/definitions/uint32"
                  minimum: 0x13
                  maximum: 0x18

    clock-names:
        $ref: "/schemas/types.yaml#/definitions/string-array"
        items:
            enum:
                - axi
                - vps0
                - vps1


    power-domains:
        $ref: "/schemas/types.yaml#/definitions/uint32-matrix"
        items:
            minItems: 2
            maxItems: 2
            items:
                - $ref: "/schemas/types.yaml#/definitions/uint32"
                - $ref: "/schemas/types.yaml#/definitions/uint32"
                  minimum: 0x15
                  maximum: 0x15

    iommus:
        $ref: "/schemas/types.yaml#/definitions/uint32-matrix"
        description: |
            iommus are given by a tuple of 2 values:
                - Phandle to the device
                - Device ID
        items:
            minItems: 2
            maxItems: 2
            items:
                - $ref: "/schemas/types.yaml#/definitions/uint32"
                - $ref: "/schemas/types.yaml#/definitions/uint32"
                  minimum: 0x1100
                  maximum: 0x1100

    dma-coherent:
        $ref: "/schemas/types.yaml#/definitions/flag"

required:
    - compatible
    - reg
    - interrupts
    - resets
    - reset-names
    - clocks
    - clock-names
    - iommus

examples:
    - |
        pva0@818c000000 {
            compatible = "nvidia,tegra264-pva, simple-bus";
            reg = <0x81 0x8c000000 0x0 0x900000>,
                  <0x0 0x10700000 0x0 0x100000>;
            interrupts = <GIC_SPI 0x195 IRQ_TYPE_LEVEL_HIGH>,
                         <GIC_SPI 0x196 IRQ_TYPE_LEVEL_HIGH>,
                         <GIC_SPI 0x197 IRQ_TYPE_LEVEL_HIGH>,
                         <GIC_SPI 0x198 IRQ_TYPE_LEVEL_HIGH>,
                         <GIC_SPI 0x199 IRQ_TYPE_LEVEL_HIGH>,
                         <GIC_SPI 0x19a IRQ_TYPE_LEVEL_HIGH>,
                         <GIC_SPI 0x19b IRQ_TYPE_LEVEL_HIGH>,
                         <GIC_SPI 0x19c IRQ_TYPE_LEVEL_HIGH>,
                         <GIC_SPI 0x19d IRQ_TYPE_LEVEL_HIGH>;
            resets = <&bpmp TEGRA264_RESET_PVA0_ALL>;
            reset-names = "pva0";
            clocks = <&bpmp TEGRA264_CLK_PVA0_CPU_AXI>,
                     <&bpmp TEGRA264_CLK_NAFLL_PVA0_VPS>,
                     <&bpmp TEGRA264_CLK_PVA0_VPS>;
            clock-names = "axi, vps0, vps1";
            power-domains = <&bpmp TEGRA264_POWER_DOMAIN_PVA0>;
            iommus = <&smmu4_mmu TEGRA_SID_PVA>;
            dma-coherent;
            status = "disabled";
        };
```

## source/nvidia-oot/Documentation/devicetree/bindings/video/tegra/nvmap/nvidia,carveouts.yaml
```yaml
# Copyright (c) 2024-2025, NVIDIA CORPORATION & AFFILIATES.  All rights reserved.
#
# This program is free software; you can redistribute it and/or modify it
# under the terms and conditions of the GNU General Public License,
# version 2, as published by the Free Software Foundation.
#
# This program is distributed in the hope it will be useful, but WITHOUT
# ANY WARRANTY; without even the implied warranty of MERCHANTABILITY or
# FITNESS FOR A PARTICULAR PURPOSE.  See the GNU General Public License for
# more details.

%YAML 1.2
---
$id: http://devicetree.org/schemas/tegra-carveouts/nvidia,carveouts.yaml#
$schema: http://devicetree.org/meta-schemas/core.yaml#

title: Nvidia Tegra Memory Management Driver

maintainers:
  - Ketan Patil

description: |
  This schema defines the properties for the NVIDIA Tegra carveouts nodes.

select:
  properties:
    compatible:
        minItems: 1
        maxItems: 1
        items:
            enum:
                - nvidia,carveouts

  required:
    - compatible

properties:

    dont-convert-iovmm-to-carveout:
        description: |
            If enabled, the nvmap will not convert iovmm to carveout. This property is necessary
            when generic carveout is enabled and iovmm memory should not be converted to carveout.
        $ref: "/schemas/types.yaml#/definitions/flag"

    disable-debug-support:
        description: |
            If enabled, the nvmap will not support debug APIs.
        $ref: "/schemas/types.yaml#/definitions/flag"

    memory-region:
        description: |
            A list of phandles to carveout nodes.
        $ref: "/schemas/types.yaml#/definitions/phandle-array"

    status:
        description: |
            The status of the carveouts node.
        enum:
            - okay
            - disabled

required:
    - compatible

examples:
    - |
        tegra-carveouts {
            compatible = "nvidia,carveouts";
            dont-convert-iovmm-to-carveout;
            memory-region = <&generic_reserved &fsi_reserved>;
            disable-debug-support;
            status = "okay";
        };
```

## source/nvidia-oot/Documentation/devicetree/bindings/virt/tegra/nvidia,tegra-hv-pm-ctl.yaml
```yaml
# Copyright (c) 2024, NVIDIA CORPORATION & AFFILIATES.  All rights reserved.
#
# This program is free software; you can redistribute it and/or modify it
# under the terms and conditions of the GNU General Public License,
# version 2, as published by the Free Software Foundation.
#
# This program is distributed in the hope it will be useful, but WITHOUT
# ANY WARRANTY; without even the implied warranty of MERCHANTABILITY or
# FITNESS FOR A PARTICULAR PURPOSE.  See the GNU General Public License for
# more details.

%YAML 1.2
---
$id: http://devicetree.org/schemas/tegra_hv_pm_ctl/nvidia,tegra-hv-pm-ctl.yaml#
$schema: http://devicetree.org/meta-schemas/core.yaml#

title: Nvidia hypervisor PM control driver

maintainers:
  - Manish Bhardwaj

description: |
     the compatability = nvidia,tegra-hv-pm-ctl is mentioned in the following drivers
        - <TOP>/kernel/nvidia-oot/drivers/virt/tegra/tegra_hv_pm_ctl.c

     The following nodes use this compatibility
        - /tegra_hv_pm_ctl

select:
  properties:
    compatible:
        minItems: 1
        maxItems: 1
        items:
            enum:
                - nvidia,tegra-hv-pm-ctl

  required:
    - compatible

properties:

    ivc:
        $ref: "/schemas/types.yaml#/definitions/uint32"
        minimum: 0xf
        maximum: 0xc8

required:
    - compatible

examples:
    - |
        tegra_hv_pm_ctl {
        };
```

## source/nvidia-oot/drivers/media/i2c/stereolabs/max96712/Kconfig
```kconfig
config SL_DESER_MAX96712

	tristate "Stereolabs MAX96712 Deserializer"
	help
	  If you say yes here you get support for the MAX96712 deserializer.

	  To compile this driver as a module, choose M here: the module
	  will be called max96712.
```
