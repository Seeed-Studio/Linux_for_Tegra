## source/nvidia-oot/Documentation/devicetree/bindings/soc/nvidia/tegra/cactmon.yaml
```yaml
# SPDX-License-Identifier: (GPL-2.0 OR BSD-2-Clause)
%YAML 1.2
---
$id: http://devicetree.org/schemas/soc/nvidia/tegra/cactmon.yaml#
$schema: http://devicetree.org/meta-schemas/core.yaml#

title: Device tree binding for NVIDIA Tegra central actmon

maintainers:
  - Laxman Dewangan <ldewangan@nvidia.com>

description: |
   The Tegra central actmon is the device to monitor activity of various hw devices,
   for e.g. external memory controller hw. It has dedicated actmon device to capture
   activity of each EMC client. Emc clients can be added as child node to parent node.
   For e.g. "mc_all" is one of the client of emc and captures rd/wr memory access by
   all the emc clients. Therefore "mc_all" can be added as child node of the
   "nvidia,tegra<hw>-cactmon" node.

properties:
  compatible:
    enum:
      - nvidia,tegra234-cactmon
      - nvidia,tegra194-cactmon
      - nvidia,tegra186-cactmon
  reg:
    maxItems: 1
    description: |
       Physical base address and length of registers for actmon HW.

  interrupts:
    maxItems: 1
    description: |
       IRQ number for actmon HW.

  clocks:
    maxItems: 1
    description: |
       Specifies the actmon hw ref clock.

  clock-names:
    description: |
      Specifies the name actmon hw ref clock. Valid name is "actmon".

  resets:
    maxItems: 1
    description: |
       Specifies the reset line.

  reset-names:
    description: |
      Specifies the name of the reset line. Valid name is "actmon_rst".

  nvidia,sample_period:
    $ref: /schemas/types.yaml#/definitions/uint32
    description: |
       Actmon sample period.


required:
  - compatible
  - interrupts
  - reg
  - clocks
  - clock-names
  - resets
  - reset-names
  - nvidia,sample_period

unevaluatedProperties: false

patternProperties:
  "^.*-actdev$":
    type: object
    description: |
       Actmon devices for mc clients.
    properties:
      clocks:
         maxItems: 1
         description: |
            Specifies the submodule HW ref clock.

      clock-names:
         description: |
            Specifies the name actmon hw ref clock. Valid name is "actmon".

      nvidia,reg_offs:
         $ref: /schemas/types.yaml#/definitions/uint32
         description: |
            register offset for actmon device

      nvidia,irq_mask:
         $ref: /schemas/types.yaml#/definitions/uint32
         description: |
            irq mask for actmon debvice.

      nvidia,suspend_freq:
         $ref: /schemas/types.yaml#/definitions/uint32
         description: |
            actmon device freq when mc client goes in suspend

      nvidia,boost_freq_step:
         $ref: /schemas/types.yaml#/definitions/uint32
         description: |
            base freq of boost freq component

      nvidia,boost_up_coef:
         $ref: /schemas/types.yaml#/definitions/uint32
         description: |
            percentage of times want to boost up the freq

      nvidia,boost_down_coef:
         $ref: /schemas/types.yaml#/definitions/uint32
         description: |
            percentage of times want to boost down the freq

      nvidia,boost_up_threshold:
         $ref: /schemas/types.yaml#/definitions/uint32
         description: |
            Up threshold, crossing that boost up interrupt triggeres

      nvidia,boost_down_threshold:
         $ref: /schemas/types.yaml#/definitions/uint32
         description: |
            Down threshold, crossing that boost down interrupt triggeres

      nvidia,up_wmark_window:
         $ref: /schemas/types.yaml#/definitions/uint32
         description: |
            Count crossing that many times of boost_up_threshold, boost interrupt triggeres

      nvidia,down_wmark_window:
         $ref: /schemas/types.yaml#/definitions/uint32
         description: |
            Count crossing that many times of boost_up_threshold, boost interrupt triggeres

      nvidia,avg_window_log2:
         $ref: /schemas/types.yaml#/definitions/uint32
         description: |
            K value for moving average of 2^k windows

      nvidia,count_weight:
         $ref: /schemas/types.yaml#/definitions/uint32
         description: |
            scaling factor

      nvidia,type:
         $ref: /schemas/types.yaml#/definitions/uint32
         description: |
            Freq sampler or Load sampler.

      nvidia,max_dram_channels:
         $ref: /schemas/types.yaml#/definitions/uint32
         description: |
            Number of DRAM channels if it is MC client.

    required:
      - clocks
      - clock-names
      - nvidia,reg_offs
      - nvidia,irq_mask

examples:
  - |
    #include <dt-bindings/interrupt-controller/irq.h>
    #define TEGRA234_IRQ_ACTMON                    210
    #define TEGRA234_RESET_ACTMON                  1U
    #define TEGRA234_CLK_ACTMON                    1U
    #define TEGRA234_CLK_EMC                       31U
    soc {
        #address-cells = <2>;
        #size-cells = <2>;
        actmon@d230000 {
            /* tegra194 central actmon */
            compatible = "nvidia,tegra234-cactmon";
            reg = <0x0 0x0d230000 0x0 0x1000>; /* ACTMON_BASE */
            interrupts = <0 TEGRA234_IRQ_ACTMON IRQ_TYPE_LEVEL_HIGH>;
            clocks = <&bpmp_clks TEGRA234_CLK_ACTMON>;
            clock-names = "actmon";
            resets = <&bpmp_resets TEGRA234_RESET_ACTMON>;
            reset-names = "actmon_rst";
            nvidia,sample_period = /bits/ 8 <20>;

            mc_all-actdev {        /* MC_ALL actmon device */
                nvidia,reg_offs = <0x100>;
                nvidia,irq_mask = <0x2>;
                /* EMC_PLLP_FREQ + 2000 */
                nvidia,suspend_freq = <204000>;
                nvidia,boost_freq_step = <204000>;
                nvidia,boost_up_coef = <200>;
                nvidia,boost_down_coef = <50>;
                nvidia,boost_up_threshold = <30>;
                nvidia,boost_down_threshold = <20>;
                nvidia,up_wmark_window = /bits/ 8 <3>;
                nvidia,down_wmark_window = /bits/ 8 <2>;
                nvidia,avg_window_log2 = /bits/ 8 <6>;
                /*
                 * count_weight(W) = no of dram clks needed to access N atoms
                 * N = atoms per dvfs pulse = (2^7+1) = 256 atoms
                 * 1 atom = 64bytes
                 * t194 has 256 max dram width (16 channels x 16 bits per channel)
                 * 1 dram clock cycle provides 256*2 bits = 64bytes
                 * (i.e) 1 dram clock provides 1 atom
                 * so 256 dram clocks needed for 256 atoms
                 * W = 256
                 */
                nvidia,count_weight = <0x100>;
                nvidia,max_dram_channels = /bits/ 8 <16>;
                nvidia,type = <1>;
                clocks = <&bpmp_clks TEGRA234_CLK_EMC>;
                clock-names = "emc";
            };
        };
     };
...
```

## source/nvidia-oot/Documentation/devicetree/bindings/soc/nvidia/tegra/fuse-burn.yaml
```yaml
# SPDX-License-Identifier: (GPL-2.0 OR BSD-2-Clause)
%YAML 1.2
---
$id: http://devicetree.org/schemas/soc/nvidia/tegra/fuse-burn.yaml#
$schema: http://devicetree.org/meta-schemas/core.yaml#

title: NVIDIA Tegra fuse burn DT binding

maintainers:
  - Laxman Dewangan <ldewangan@nvidia.com>

description: |
   This driver burn the fuse on NVIDIA Tegra SOCs.

properties:
  compatible:
    enum:
      - nvidia,tegra194-efuse-burn
      - nvidia,tegra234-efuse-burn

  reg:
    items:
      - description: Base register address and size of the MISC.
      - description: Base register address and size of the Fuse.

  clocks:
    maxItems: 2
    description: |
       Two entries, first one is for fuse clock and secon one is for the PGM clock.

  clock-names:
     description: |
        Name of the clock source. The valid names are "fuse-clk" and "pgm-clk".

  nvidia,temp-range:
     $ref: /schemas/types.yaml#/definitions/uint32-array
     description: |
        Temperature range in degC. It has two entries for lower and upper range.

  nvidia,redundant-aid-war:
     $ref: /schemas/types.yaml#/definitions/flag
     description: |
        If this property present then add WAR for the AID fuse to have redundancy.

  thermal-zone:
    $ref: /schemas/types.yaml#/definitions/uint32
    description: |
       Thermal zone ID for the fuse.

  thermal-zone-type:
    $ref: /schemas/types.yaml#/definitions/string
    description: |
       Thermal zone type.

  nvidia,bpmp:
    $ref: /schemas/types.yaml#/definitions/phandle
    description: |
      Handle of the BPMP node.

required:
  - compatible
  - reg
  - clocks
  - clock-names
  - nvidia,bpmp

unevaluatedProperties: false

examples:
  - |
    #define TEGRA234_CLK_FUSE         40U
    #define TEGRA234_CLK_CLK_M        14U
    soc {
        #address-cells = <2>;
        #size-cells = <2>;
        efuse-burn@3810000 {
           compatible = "nvidia,tegra234-efuse-burn";
           reg = <0x0 0x0c3a0000 0x0 0x10000>,
                 <0x0 0x03810000 0x0 0x19000>;
           clocks = <&bpmp_clks TEGRA234_CLK_FUSE>,
                 <&bpmp_clks TEGRA234_CLK_CLK_M>;
           clock-names = "fuse-clk", "pgm-clk";
           nvidia,bpmp = <&bpmp>;
        };
    };
...
```

## source/nvidia-oot/Documentation/devicetree/bindings/soc/nvidia/tegra/kfuse.yaml
```yaml
# SPDX-License-Identifier: (GPL-2.0 OR BSD-2-Clause)
%YAML 1.2
---
$id: http://devicetree.org/schemas/soc/nvidia/tegra/kfuse.yaml#
$schema: http://devicetree.org/meta-schemas/core.yaml#

title: Device tree binding for NVIDIA Tegra KFUSE

maintainers:
  - Laxman Dewangan <ldewangan@nvidia.com>

description: |
   The kfuse block stores downstream and upstream HDCP keys for use by the HDMI module.

properties:
  compatible:
    enum:
      - nvidia,tegra194-kfuse
      - nvidia,tegra186-kfuse
      - nvidia,tegra210-kfuse
      - nvidia,tegra124-kfuse

  reg:
    maxItems: 1
    description: |
       Physical base address and length of registers for Kfuse HW.

  clocks:
    maxItems: 1
    description: |
       Specifies the kfuse hw ref clock.

  clock-names:
    description: |
      Specifies the name kfuse hw ref clock. Valid name is "kfuse".

required:
  - compatible
  - reg
  - clocks
  - clock-names

unevaluatedProperties: false

examples:
  - |
    #define TEGRA194_CLK_KFUSE                 70U
    soc {
        #address-cells = <2>;
        #size-cells = <2>;

        kfuse@3830000 {
            compatible = "nvidia,tegra194-kfuse";
            reg = <0x0 0x3830000 0x0 0x10000>;
            clocks = <&bpmp_clks TEGRA194_CLK_KFUSE>;
            clock-names = "kfuse";
        };
     };
...
```

## source/nvidia-oot/Documentation/devicetree/bindings/soc/tegra/cbb/nvidia,tegra264-vision-cbb-fabric.yaml
```yaml
# Copyright (c) 2024, NVIDIA CORPORATION & AFFILIATES.  All rights reserved.
#
# This program is free software; you can redistribute it and/or modify it
# under the terms and conditions of the GNU General Public License,
# version 2, as published by the Free Software Foundation.
#
# This program is distributed in the hope it will be useful, but WITHOUT
# ANY WARRANTY; without even the implied warranty of MERCHANTABILITY or
# FITNESS FOR A PARTICULAR PURPOSE.  See the GNU General Public License for
# more details.

%YAML 1.2
---
$id: http://devicetree.org/schemas/vision-cbb-fabric@8180800000/nvidia,tegra264-vision-cbb-fabric.yaml#
$schema: http://devicetree.org/meta-schemas/core.yaml#

title: Control Backbone 2.0 error handling driver for Tegra

maintainers:
  - Sumit Gupta

description: |
     the compatability = nvidia,tegra264-vision-cbb-fabric is mentioned in the following drivers
        - <TOP>/kernel/kernel-oot/drivers/soc/tegra/cbb/tegra234-cbb.c

     The following nodes use this compatibility
        - /bus@0/vision-cbb-fabric@8180800000

select:
  properties:
    compatible:
        minItems: 1
        maxItems: 1
        items:
            enum:
                - nvidia,tegra264-vision-cbb-fabric

  required:
    - compatible

properties:

    reg:
        $ref: "/schemas/types.yaml#/definitions/uint32-matrix"
        description: |
            Registers are given by a tuple of two values:
                - register address:
                - register block size.
        items:
            minItems: 4
            maxItems: 4
            items:
                - $ref: "/schemas/types.yaml#/definitions/uint32"
                  minimum: 0x81
                  maximum: 0x81
                - $ref: "/schemas/types.yaml#/definitions/uint32"
                  minimum: 0x80800000
                  maximum: 0x80800000
                - $ref: "/schemas/types.yaml#/definitions/uint32"
                  minimum: 0x0
                  maximum: 0x0
                - $ref: "/schemas/types.yaml#/definitions/uint32"
                  minimum: 0x800000
                  maximum: 0x800000

    interrupts:
        $ref: "/schemas/types.yaml#/definitions/uint32-matrix"
        description: |
            Interrupts are give by a tuple of 3 values:
                - interrupt specifier (GIC_SPI = 0, GIC_PPI = 1)
                  definitions in dt-bindings/interrupt-controller/arm-gic.h
                - interrupt number
                - trigger type (rising edge, falling edge, both, etc)
                  definitions in dt-bindings/interrupt-controller/irq.h
        items:
            items:
                - $ref: "/schemas/types.yaml#/definitions/uint32"
                  minimum: 0x0
                  maximum: 0x0
                - $ref: "/schemas/types.yaml#/definitions/uint32"
                  minimum: 0x144
                  maximum: 0x144
                - $ref: "/schemas/types.yaml#/definitions/uint32"
                  minimum: 0x4
                  maximum: 0x4

    numa-node-id:
        $ref: "/schemas/types.yaml#/definitions/uint32"
        minimum: 0x0
        maximum: 0x0

required:
    - compatible
    - reg
    - interrupts

examples:
    - |
        vision-cbb-fabric@8180800000 {
            compatible = "nvidia,tegra264-vision-cbb-fabric";
            reg = <0x81 0x80800000 0x0 0x800000>;
            interrupts = <GIC_SPI 324 IRQ_TYPE_LEVEL_HIGH>;
            numa-node-id = <0x0>;
            status = "disabled";
        };
```
