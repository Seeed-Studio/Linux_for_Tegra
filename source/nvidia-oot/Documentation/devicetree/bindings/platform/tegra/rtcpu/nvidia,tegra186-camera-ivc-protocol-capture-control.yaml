## source/nvidia-oot/Documentation/devicetree/bindings/soc/tegra/fuse/nvidia,efuse-nvmem-helper.yaml
```yaml
# Copyright (c) 2024, NVIDIA CORPORATION & AFFILIATES.  All rights reserved.
#
# This program is free software; you can redistribute it and/or modify it
# under the terms and conditions of the GNU General Public License,
# version 2, as published by the Free Software Foundation.
#
# This program is distributed in the hope it will be useful, but WITHOUT
# ANY WARRANTY; without even the implied warranty of MERCHANTABILITY or
# FITNESS FOR A PARTICULAR PURPOSE.  See the GNU General Public License for
# more details.

%YAML 1.2
---
$id: http://devicetree.org/schemas/efuse-helper/nvidia,efuse-nvmem-helper.yaml#
$schema: http://devicetree.org/meta-schemas/core.yaml#

title: Tegra efuse Memory Helper

maintainers:
  - Suresh Mangipudi

description: |
     the compatability = nvidia,efuse-nvmem-helper is mentioned in the following drivers
        - <TOP>/kernel/kernel-oot/drivers/soc/tegra/fuse/tegra-efuse-nvmem-helper.c

     The following nodes use this compatibility
        - /bus@0/efuse-helper

select:
  properties:
    compatible:
        minItems: 1
        maxItems: 1
        items:
            enum:
                - nvidia,efuse-nvmem-helper

  required:
    - compatible

properties:

    nvmem:
        $ref: "/schemas/types.yaml#/definitions/uint32"

    nvmem-names:
        $ref: "/schemas/types.yaml#/definitions/string-array"
        items:
            enum:
                - efuse


required:
    - compatible

examples:
    - |
        efuse-helper {
            compatible = "nvidia,efuse-nvmem-helper";
            nvmem = <&tegra_efuse0>;
            nvmem-names = "efuse";
            status = "disabled";
        };
```

## source/nvidia-oot/Documentation/devicetree/bindings/thermal/nvidia,tegra234-oc-event.yaml
```yaml
# Copyright (c) 2024, NVIDIA CORPORATION & AFFILIATES.  All rights reserved.
#
# This program is free software; you can redistribute it and/or modify it
# under the terms and conditions of the GNU General Public License,
# version 2, as published by the Free Software Foundation.
#
# This program is distributed in the hope it will be useful, but WITHOUT
# ANY WARRANTY; without even the implied warranty of MERCHANTABILITY or
# FITNESS FOR A PARTICULAR PURPOSE.  See the GNU General Public License for
# more details.

%YAML 1.2
---
$id: http://devicetree.org/schemas/nvtherm-oc-event/nvidia,tegra234-oc-event.yaml#
$schema: http://devicetree.org/meta-schemas/core.yaml#

title: NVIDIA Tegra Overcurrent Event Driver

maintainers:
  - Yi-Wei Wang

description: |
     the compatability = nvidia,tegra234-oc-event is mentioned in the following drivers
        - <TOP>/kernel/nvidia-oot/drivers/thermal/tegra234-oc-event.c

     The following nodes use this compatibility
        - /nvtherm-oc-event

select:
  properties:
    compatible:
        minItems: 1
        maxItems: 1
        items:
            enum:
                - nvidia,tegra234-oc-event

  required:
    - compatible

properties:

    nvidia,bpmp:
        $ref: "/schemas/types.yaml#/definitions/uint32"

required:
    - compatible

examples:
    - |
        nvtherm-oc-event {
            compatible = "nvidia,tegra234-oc-event";
            status = "disabled";
            nvidia,bpmp = <&bpmp>;
        };
```

## source/nvidia-oot/Documentation/devicetree/bindings/thermal/pex9749-thermal.yaml
```yaml
# SPDX-License-Identifier: (GPL-2.0-only OR BSD-2-Clause)
%YAML 1.2
---
$id: http://devicetree.org/schemas/thermal/pex9749-thermal.yaml#
$schema: http://devicetree.org/meta-schemas/core.yaml#

title: PEX9749 Thermal Sensor

maintainers:
  - Laxman Dewangan <ldewangan@nvidia.com>

description: |
  PEX9749 thermal sensor monitors the temperature.

properties:
  compatible:
    const: "pex9749"

  reg:
    maxItems: 1

  "#thermal-sensor-cells":
    const: 1

required:
  - compatible
  - reg
  - "#thermal-sensor-cells"

additionalProperties: false

examples:
  - |
    i2c@3180000 {
        reg = <0x3180000 0x0>;
        #address-cells = <1>;
        #size-cells = <0>;
        pex9749: pex9749@5f {
           compatible = "pex9749";
           reg = <0x5f>;
           #thermal-sensor-cells = <1>;
       };
    };
...
```

## source/nvidia-oot/Documentation/devicetree/bindings/tty/serial/arm,sbsa-uart.yaml
```yaml
# Copyright (c) 2024, NVIDIA CORPORATION & AFFILIATES.  All rights reserved.
#
# This program is free software; you can redistribute it and/or modify it
# under the terms and conditions of the GNU General Public License,
# version 2, as published by the Free Software Foundation.
#
# This program is distributed in the hope it will be useful, but WITHOUT
# ANY WARRANTY; without even the implied warranty of MERCHANTABILITY or
# FITNESS FOR A PARTICULAR PURPOSE.  See the GNU General Public License for
# more details.

%YAML 1.2
---
$id: http://devicetree.org/schemas/serial@c5f0000/arm,sbsa-uart.yaml#
$schema: http://devicetree.org/meta-schemas/core.yaml#

title: ARM AMBA serial port driver

maintainers:
  - Suresh Mangipudi

description: |
     the compatability = arm,sbsa-uart is mentioned in the following drivers
        - <TOP>/kernel/kernel-oot/drivers/tty/serial/amba-pl011.c

     The following nodes use this compatibility
        - /bus@0/serial@c5f0000

select:
  properties:
    compatible:
        minItems: 2
        maxItems: 2
        items:
            enum:
                - arm,sbsa-uart
                - arm,pl011

  required:
    - compatible

properties:

    reg:
        $ref: "/schemas/types.yaml#/definitions/uint32-matrix"
        description: |
            Registers are given by a tuple of two values:
                - register address:
                - register block size.
        items:
            minItems: 4
            maxItems: 4
            items:
                - $ref: "/schemas/types.yaml#/definitions/uint32"
                  minimum: 0x0
                  maximum: 0x0
                - $ref: "/schemas/types.yaml#/definitions/uint32"
                  minimum: 0xc5f0000
                  maximum: 0xc5f0000
                - $ref: "/schemas/types.yaml#/definitions/uint32"
                  minimum: 0x0
                  maximum: 0x0
                - $ref: "/schemas/types.yaml#/definitions/uint32"
                  minimum: 0x10000
                  maximum: 0x10000

    reg-io-width:
        $ref: "/schemas/types.yaml#/definitions/uint32"
        minimum: 0x4
        maximum: 0x4

    interrupts:
        $ref: "/schemas/types.yaml#/definitions/uint32-matrix"
        description: |
            Interrupts are give by a tuple of 3 values:
                - interrupt specifier (GIC_SPI = 0, GIC_PPI = 1)
                  definitions in dt-bindings/interrupt-controller/arm-gic.h
                - interrupt number
                - trigger type (rising edge, falling edge, both, etc)
                  definitions in dt-bindings/interrupt-controller/irq.h
        items:
            items:
                - $ref: "/schemas/types.yaml#/definitions/uint32"
                  minimum: 0x0
                  maximum: 0x0
                - $ref: "/schemas/types.yaml#/definitions/uint32"
                  minimum: 0x202
                  maximum: 0x202
                - $ref: "/schemas/types.yaml#/definitions/uint32"
                  minimum: 0x4
                  maximum: 0x4

    current-speed:
        $ref: "/schemas/types.yaml#/definitions/uint32"
        minimum: 0x1c200
        maximum: 0x1c200

    numa-node-id:
        $ref: "/schemas/types.yaml#/definitions/uint32"
        minimum: 0x0
        maximum: 0x0

required:
    - compatible
    - reg
    - interrupts

examples:
    - |
        serial@c5f0000 {
            compatible = "arm,sbsa-uart",
                         "arm,pl011";
            status = "disabled";
            reg = <0x0 0xc5f0000 0x0 0x10000>;
            reg-io-width = <0x4>;
            interrupts = <GIC_SPI 514 IRQ_TYPE_LEVEL_HIGH>;
            current-speed = <0x1c200>;
            numa-node-id = <0>;
        };
```

## source/nvidia-oot/Documentation/devicetree/bindings/usb/host/nvidia,tegra264-xusb-vf4.yaml
```yaml
# Copyright (c) 2024, NVIDIA CORPORATION & AFFILIATES.  All rights reserved.
#
# This program is free software; you can redistribute it and/or modify it
# under the terms and conditions of the GNU General Public License,
# version 2, as published by the Free Software Foundation.
#
# This program is distributed in the hope it will be useful, but WITHOUT
# ANY WARRANTY; without even the implied warranty of MERCHANTABILITY or
# FITNESS FOR A PARTICULAR PURPOSE.  See the GNU General Public License for
# more details.

%YAML 1.2
---
$id: http://devicetree.org/schemas/usb@a80ab60000/nvidia,tegra264-xusb-vf4.yaml#
$schema: http://devicetree.org/meta-schemas/core.yaml#

title: NVIDIA Tegra XUSB xHCI host-controller driver

maintainers:
  - Sing HanChen

description: |
     the compatability = nvidia,tegra264-xusb-vf4 is mentioned in the following drivers
        - <TOP>/kernel/kernel-oot/drivers/usb/host/xhci-tegra.c

     The following nodes use this compatibility
        - /bus@0/usb@a80ab60000

select:
  properties:
    compatible:
        minItems: 1
        maxItems: 1
        items:
            enum:
                - nvidia,tegra264-xusb-vf4

  required:
    - compatible

properties:

    reg:
        $ref: "/schemas/types.yaml#/definitions/uint32-matrix"
        description: |
            Registers are given by a tuple of two values:
                - register address:
                - register block size.
        items:
            minItems: 4
            maxItems: 4
            items:
                - $ref: "/schemas/types.yaml#/definitions/uint32"
                  minimum: 0xa8
                  maximum: 0xa8
                - $ref: "/schemas/types.yaml#/definitions/uint32"
                  minimum: 0xab60000
                  maximum: 0xab60000
                - $ref: "/schemas/types.yaml#/definitions/uint32"
                  minimum: 0x0
                  maximum: 0x0
                - $ref: "/schemas/types.yaml#/definitions/uint32"
                  minimum: 0x40000
                  maximum: 0x40000

    interrupts:
        $ref: "/schemas/types.yaml#/definitions/uint32-matrix"
        description: |
            Interrupts are give by a tuple of 3 values:
                - interrupt specifier (GIC_SPI = 0, GIC_PPI = 1)
                  definitions in dt-bindings/interrupt-controller/arm-gic.h
                - interrupt number
                - trigger type (rising edge, falling edge, both, etc)
                  definitions in dt-bindings/interrupt-controller/irq.h
        items:
            items:
                - $ref: "/schemas/types.yaml#/definitions/uint32"
                  minimum: 0x0
                  maximum: 0x0
                - $ref: "/schemas/types.yaml#/definitions/uint32"
                  minimum: 0x3bc
                  maximum: 0x3bc
                - $ref: "/schemas/types.yaml#/definitions/uint32"
                  minimum: 0x4
                  maximum: 0x4

    iommus:
        $ref: "/schemas/types.yaml#/definitions/uint32-matrix"
        description: |
            iommus are given by a tuple of 2 values:
                - Phandle to the device
                - Device ID
        items:
            minItems: 2
            maxItems: 2
            items:
                - $ref: "/schemas/types.yaml#/definitions/uint32"
                - $ref: "/schemas/types.yaml#/definitions/uint32"
                  minimum: 0x3204
                  maximum: 0x3604

    dma-coherent:
        $ref: "/schemas/types.yaml#/definitions/flag"

    nvidia,xusb-padctl:
        $ref: "/schemas/types.yaml#/definitions/uint32"

required:
    - compatible
    - reg
    - interrupts
    - iommus

examples:
    - |
        usb@a80ab60000 {
            compatible = "nvidia,tegra264-xusb-vf4";
            reg = <0xa8 0xab60000 0x0 0x40000>;
            interrupts = <0 956 IRQ_TYPE_LEVEL_HIGH>;
            iommus = <&smmu1_mmu TEGRA_SID_XUSB_VF4_HS_PORTS>,
                     <&smmu1_mmu TEGRA_SID_XUSB_VF4_SS_PORT1>,
                     <&smmu1_mmu TEGRA_SID_XUSB_VF4_SS_PORT2>,
                     <&smmu1_mmu TEGRA_SID_XUSB_VF4_SS_PORT3>,
                     <&smmu1_mmu TEGRA_SID_XUSB_VF4_SS_PORT4>;
            dma-coherent;
            nvidia,xusb-padctl = <&xusb_padctl>;
            status = "disabled";
        };
```

## source/nvidia-oot/Documentation/devicetree/bindings/video/tegra/host/nvcsi/nvidia,tegra194-nvcsi.yaml
```yaml
# Copyright (c) 2024, NVIDIA CORPORATION & AFFILIATES.  All rights reserved.
#
# This program is free software; you can redistribute it and/or modify it
# under the terms and conditions of the GNU General Public License,
# version 2, as published by the Free Software Foundation.
#
# This program is distributed in the hope it will be useful, but WITHOUT
# ANY WARRANTY; without even the implied warranty of MERCHANTABILITY or
# FITNESS FOR A PARTICULAR PURPOSE.  See the GNU General Public License for
# more details.

%YAML 1.2
---
$id: http://devicetree.org/schemas/nvcsi@8188000000/nvidia,tegra194-nvcsi.yaml#
$schema: http://devicetree.org/meta-schemas/core.yaml#

title: Tegra Camera Serial Interface Module

maintainers:
  - Chinniah Poosapadi

description: |
     the compatability = nvidia,tegra194-nvcsi is mentioned in the following drivers
        - <TOP>/kernel/nvidia-oot/drivers/video/tegra/host/nvcsi/nvcsi-t194.c

     The following nodes use this compatibility
        - /bus@0/host1x@8181200000/nvcsi@8188000000

select:
  properties:
    compatible:
        minItems: 1
        maxItems: 1
        items:
            enum:
                - nvidia,tegra194-nvcsi

  required:
    - compatible

properties:

    clocks:
        $ref: "/schemas/types.yaml#/definitions/uint32-matrix"
        description: |
            Clocks are given by a tuple of 2 values:
                - Phandle to the device
                - Clock ID
        items:
            minItems: 2
            maxItems: 2
            items:
                - $ref: "/schemas/types.yaml#/definitions/uint32"
                - $ref: "/schemas/types.yaml#/definitions/uint32"
                  minimum: 0x14
                  maximum: 0x14

    clock-names:
        $ref: "/schemas/types.yaml#/definitions/string-array"
        items:
            enum:
                - nvcsi


    resets:
        $ref: "/schemas/types.yaml#/definitions/uint32-matrix"
        description: |
            Resets are given by a tuple of 2 values:
                - Phandle to the device
                - Reset ID
        items:
            minItems: 2
            maxItems: 2
            items:
                - $ref: "/schemas/types.yaml#/definitions/uint32"
                - $ref: "/schemas/types.yaml#/definitions/uint32"
                  minimum: 0x15
                  maximum: 0x15

    reset-names:
        $ref: "/schemas/types.yaml#/definitions/string-array"
        items:
            enum:
                - nvcsi


required:
    - compatible
    - clocks
    - clock-names
    - resets
    - reset-names

examples:
    - |
        nvcsi@8188000000 {
            compatible = "nvidia,tegra194-nvcsi";
            clocks = <&bpmp TEGRA264_CLK_NVCSI>;
            clock-names = "nvcsi";
            resets = <&bpmp TEGRA264_RESET_NVCSI>;
            reset-names = "nvcsi";
            status = "disabled";
        };
```
