## source/nvidia-oot/Documentation/devicetree/bindings/mailbox/nvidia,tegra264-hsp.yaml
```yaml
# Copyright (c) 2024, NVIDIA CORPORATION & AFFILIATES.  All rights reserved.
#
# This program is free software; you can redistribute it and/or modify it
# under the terms and conditions of the GNU General Public License,
# version 2, as published by the Free Software Foundation.
#
# This program is distributed in the hope it will be useful, but WITHOUT
# ANY WARRANTY; without even the implied warranty of MERCHANTABILITY or
# FITNESS FOR A PARTICULAR PURPOSE.  See the GNU General Public License for
# more details.

%YAML 1.2
---
$id: http://devicetree.org/schemas/tegra-hsp@818c160000/nvidia,tegra264-hsp.yaml#
$schema: http://devicetree.org/meta-schemas/core.yaml#

title: Hypervisor Hardware Syncronization Primatives (HSP) Driver

maintainers:
  - Suresh Mangipudi

description: |
     the compatability = nvidia,tegra264-hsp is mentioned in the following drivers
        - <TOP>/kernel/kernel-oot/drivers/mailbox/tegra-hsp.c

     The following nodes use this compatibility
        - /bus@0/tegra-hsp@818c160000
        - /bus@0/tegra-hsp@8189200000

select:
  properties:
    compatible:
        minItems: 3
        maxItems: 3
        items:
            enum:
                - nvidia,tegra264-hsp
                - nvidia,tegra234-hsp
                - nvidia,tegra186-hsp

  required:
    - compatible

properties:

    reg:
        $ref: "/schemas/types.yaml#/definitions/uint32-matrix"
        description: |
            Registers are given by a tuple of two values:
                - register address:
                - register block size.
        items:
            minItems: 4
            maxItems: 4
            items:
                - $ref: "/schemas/types.yaml#/definitions/uint32"
                  minimum: 0x81
                  maximum: 0x81
                - $ref: "/schemas/types.yaml#/definitions/uint32"
                  minimum: 0x89200000
                  maximum: 0x8c160000
                - $ref: "/schemas/types.yaml#/definitions/uint32"
                  minimum: 0x0
                  maximum: 0x0
                - $ref: "/schemas/types.yaml#/definitions/uint32"
                  minimum: 0x90000
                  maximum: 0xc0000

    interrupts:
        $ref: "/schemas/types.yaml#/definitions/uint32-matrix"
        description: |
            Interrupts are give by a tuple of 3 values:
                - interrupt specifier (GIC_SPI = 0, GIC_PPI = 1)
                  definitions in dt-bindings/interrupt-controller/arm-gic.h
                - interrupt number
                - trigger type (rising edge, falling edge, both, etc)
                  definitions in dt-bindings/interrupt-controller/irq.h
        items:
            items:
                - $ref: "/schemas/types.yaml#/definitions/uint32"
                  minimum: 0x0
                  maximum: 0x0
                - $ref: "/schemas/types.yaml#/definitions/uint32"
                  minimum: 0x190
                  maximum: 0x1a6
                - $ref: "/schemas/types.yaml#/definitions/uint32"
                  minimum: 0x4
                  maximum: 0x4

    interrupt-names:
        $ref: "/schemas/types.yaml#/definitions/string-array"
        items:
            enum:
                - shared0
                - shared1
                - shared2
                - shared3
                - shared4


    nvidia,num-SM:
        $ref: "/schemas/types.yaml#/definitions/uint32"
        minimum: 0x8
        maximum: 0x8

    nvidia,num-SS:
        $ref: "/schemas/types.yaml#/definitions/uint32"
        minimum: 0x4
        maximum: 0x4

    nvidia,num-SI:
        $ref: "/schemas/types.yaml#/definitions/uint32"
        minimum: 0x5
        maximum: 0x5

    nvidia,mbox-ie:
        $ref: "/schemas/types.yaml#/definitions/flag"

    '#mbox-cells':
        $ref: "/schemas/types.yaml#/definitions/uint32"
        minimum: 0x2
        maximum: 0x2

required:
    - compatible
    - reg
    - interrupts
    - interrupt-names

examples:
    - |
        tegra-hsp@818c160000 {
            compatible = "nvidia,tegra264-hsp";
            reg = <0x81 0x8c160000 0x0 0x00090000>;
            interrupts = <0 400 0x04>;
            interrupt-names = "shared0";
            nvidia,num-SM = <0x8>;
            nvidia,num-SS = <0x4>;
            nvidia,num-SI = <0x5>;
            nvidia,mbox-ie;
            status = "disabled";
        };
```

## source/nvidia-oot/Documentation/devicetree/bindings/media/platform/tegra/cdi/nvidia,cdi-mgr.yaml
```yaml
# Copyright (c) 2024, NVIDIA CORPORATION & AFFILIATES.  All rights reserved.
#
# This program is free software; you can redistribute it and/or modify it
# under the terms and conditions of the GNU General Public License,
# version 2, as published by the Free Software Foundation.
#
# This program is distributed in the hope it will be useful, but WITHOUT
# ANY WARRANTY; without even the implied warranty of MERCHANTABILITY or
# FITNESS FOR A PARTICULAR PURPOSE.  See the GNU General Public License for
# more details.

%YAML 1.2
---
$id: http://devicetree.org/schemas/sipl_devblk_7/nvidia,cdi-mgr.yaml#
$schema: http://devicetree.org/meta-schemas/core.yaml#

title: Tegra Automotive CDI Manager Driver

maintainers:
    - Frank Chen

description: |
     the compatability = nvidia,cdi-mgr is mentioned in the following drivers
        - <TOP>/kernel/nvidia-oot/drivers/media/platform/tegra/cdi/cdi_mgr.c

     The following nodes use this compatibility
        - /sipl_devblk_7
        - /sipl_devblk_9
        - /sipl_devblk_0
        - /sipl_devblk_12
        - /sipl_devblk_1
        - /sipl_devblk_3

select:
  properties:
    compatible:
        minItems: 1
        maxItems: 1
        items:
            enum:
                - nvidia,cdi-mgr

  required:
    - compatible

properties:

    pwdn-gpios:
        $ref: "/schemas/types.yaml#/definitions/uint32"
        minimum: 0x0
        maximum: 0x5a

required:
    - compatible

examples:
    - |
        sipl_devblk_7 {
            compatible = "nvidia,cdi-mgr";
            status = "okay";
        };
```

## source/nvidia-oot/Documentation/devicetree/bindings/media/platform/tegra/cdi/nvidia,cim_ver.yaml
```yaml
# Copyright (c) 2024, NVIDIA CORPORATION & AFFILIATES.  All rights reserved.
#
# This program is free software; you can redistribute it and/or modify it
# under the terms and conditions of the GNU General Public License,
# version 2, as published by the Free Software Foundation.
#
# This program is distributed in the hope it will be useful, but WITHOUT
# ANY WARRANTY; without even the implied warranty of MERCHANTABILITY or
# FITNESS FOR A PARTICULAR PURPOSE.  See the GNU General Public License for
# more details.

%YAML 1.2
---
$id: http://devicetree.org/schemas/cim_ver/nvidia,cim_ver.yaml#
$schema: http://devicetree.org/meta-schemas/core.yaml#

title: Tegra Automotive CDI Manager Driver

maintainers:
  - Frank Chen

description: |
     the compatability = nvidia,cim_ver is mentioned in the following drivers
        - <TOP>/kernel/nvidia-oot/drivers/media/platform/tegra/cdi/cdi_mgr.c
        - <TOP>/kernel/nvidia-oot/drivers/media/platform/tegra/cdi/cdi_dev.c

     The following nodes use this compatibility
        - /cim_ver

select:
  properties:
    compatible:
        minItems: 1
        maxItems: 1
        items:
            enum:
                - nvidia,cim_ver

  required:
    - compatible

properties:

    cim_ver:
        $ref: "/schemas/types.yaml#/definitions/string-array"
        items:
            enum:
                - cim_ver_a02


    cim_frsync_src:
        $ref: "/schemas/types.yaml#/definitions/uint32"
        minimum: 0x0
        maximum: 0x0

required:
    - compatible

examples:
    - |
        cim_ver {
            compatible = "nvidia,cim_ver";
            status = "okay";
        };
```

## source/nvidia-oot/Documentation/devicetree/bindings/mfd/nvidia-vrs-pseq.yaml
```yaml
# SPDX-License-Identifier: (GPL-2.0-only OR BSD-2-Clause)
%YAML 1.2
---
$id: http://devicetree.org/schemas/mfd/nvidia-vrs-pseq.yaml#
$schema: http://devicetree.org/meta-schemas/core.yaml#

title: NVIDIA VRS sequencer driver

maintainers:
  - Shubhi Garg <shgarg@nvidia.com>
  - Laxman Dewangan <ldewangan@nvidia.com>

description: |
  NVIDIA VRS sequencer device for controlling the voltage rails.

properties:
  compatible:
    const: "nvidia,vrs-pseq"

  reg:
    description:
      I2C device address.
    maxItems: 1

  interrupts:
    maxItems: 1

  interrupt-controller: true

  "#interrupt-cells":
    const: 3
    description:
      The first cell is the IRQ number, the second cell is the trigger type.

required:
  - compatible
  - reg
  - interrupts
  - interrupt-controller
  - "#interrupt-cells"

additionalProperties: false

examples:
  - |
    #include <dt-bindings/interrupt-controller/arm-gic.h>
    #include <dt-bindings/interrupt-controller/irq.h>
    #define TEGRA234_IRQ_PMIC_EXT_INTR             209

    bpmp {
        i2c {
            #address-cells = <1>;
            #size-cells = <0>;

            vrs@3c {
                compatible = "nvidia,vrs-pseq";
                reg = <0x3c>;
                interrupt-parent = <&intc>;
                /* IRQ is active-low but pmc inverts the signal */
                interrupts = <GIC_SPI TEGRA234_IRQ_PMIC_EXT_INTR IRQ_TYPE_LEVEL_HIGH>;
                interrupt-controller;
                #interrupt-cells = <3>;
            };
        };
    };
```

## source/nvidia-oot/Documentation/devicetree/bindings/misc/arm,armv8-pmuv3.yaml
```yaml
# Copyright (c) 2024, NVIDIA CORPORATION & AFFILIATES.  All rights reserved.
#
# This program is free software; you can redistribute it and/or modify it
# under the terms and conditions of the GNU General Public License,
# version 2, as published by the Free Software Foundation.
#
# This program is distributed in the hope it will be useful, but WITHOUT
# ANY WARRANTY; without even the implied warranty of MERCHANTABILITY or
# FITNESS FOR A PARTICULAR PURPOSE.  See the GNU General Public License for
# more details.

%YAML 1.2
---
$id: http://devicetree.org/schemas/pmu/arm,armv8-pmuv3.yaml#
$schema: http://devicetree.org/meta-schemas/core.yaml#

title: Tegra Power Management Unit Module

maintainers:
  - Besar Wicaksono

description: |
     The following nodes use this compatibility
        - /pmu

select:
  properties:
    compatible:
        minItems: 1
        maxItems: 1
        items:
            enum:
                - arm,armv8-pmuv3

  required:
    - compatible

properties:

    interrupts:
        $ref: "/schemas/types.yaml#/definitions/uint32-matrix"
        description: |
            Interrupts are give by a tuple of 3 values:
                - interrupt specifier (GIC_SPI = 0, GIC_PPI = 1)
                  definitions in dt-bindings/interrupt-controller/arm-gic.h
                - interrupt number
                - trigger type (rising edge, falling edge, both, etc)
                  definitions in dt-bindings/interrupt-controller/irq.h
        items:
            items:
                - $ref: "/schemas/types.yaml#/definitions/uint32"
                  minimum: 0x1
                  maximum: 0x1
                - $ref: "/schemas/types.yaml#/definitions/uint32"
                  minimum: 0x7
                  maximum: 0x7
                - $ref: "/schemas/types.yaml#/definitions/uint32"
                  minimum: 0x8
                  maximum: 0x8

required:
    - compatible
    - interrupts

examples:
    - |
        pmu {
            compatible = "arm,armv8-pmuv3";
            status = "disabled";
            interrupts = <GIC_PPI 7 8>;
        };
```

## source/nvidia-oot/Documentation/devicetree/bindings/misc/arm,coresight-dynamic-funnel.yaml
```yaml
# Copyright (c) 2024, NVIDIA CORPORATION & AFFILIATES.  All rights reserved.
#
# This program is free software; you can redistribute it and/or modify it
# under the terms and conditions of the GNU General Public License,
# version 2, as published by the Free Software Foundation.
#
# This program is distributed in the hope it will be useful, but WITHOUT
# ANY WARRANTY; without even the implied warranty of MERCHANTABILITY or
# FITNESS FOR A PARTICULAR PURPOSE.  See the GNU General Public License for
# more details.

%YAML 1.2
---
$id: http://devicetree.org/schemas/funnel_major@10080000/arm,coresight-dynamic-funnel.yaml#
$schema: http://devicetree.org/meta-schemas/core.yaml#

title: Coresight Dynamic Funnel Driver

maintainers:
  - Rich Wiley

description: |

     The following nodes use this compatibility
        - /funnel_major@10080000

select:
  properties:
    compatible:
        minItems: 2
        maxItems: 2
        items:
            enum:
                - arm,coresight-dynamic-funnel
                - arm,primecell

  required:
    - compatible

properties:

    reg:
        $ref: "/schemas/types.yaml#/definitions/uint32-matrix"
        description: |
            Registers are given by a tuple of two values:
                - register address:
                - register block size.
        items:
            minItems: 4
            maxItems: 4
            items:
                - $ref: "/schemas/types.yaml#/definitions/uint32"
                  minimum: 0x0
                  maximum: 0x0
                - $ref: "/schemas/types.yaml#/definitions/uint32"
                  minimum: 0x10080000
                  maximum: 0x10080000
                - $ref: "/schemas/types.yaml#/definitions/uint32"
                  minimum: 0x0
                  maximum: 0x0
                - $ref: "/schemas/types.yaml#/definitions/uint32"
                  minimum: 0x1000
                  maximum: 0x1000

    clocks:
        $ref: "/schemas/types.yaml#/definitions/uint32-matrix"
        description: |
            Clocks are given by a tuple of 2 values:
                - Phandle to the device
                - Clock ID
        items:
            minItems: 2
            maxItems: 2
            items:
                - $ref: "/schemas/types.yaml#/definitions/uint32"
                - $ref: "/schemas/types.yaml#/definitions/uint32"
                  minimum: 0xcb
                  maximum: 0xcb

    clock-names:
        $ref: "/schemas/types.yaml#/definitions/string-array"
        items:
            enum:
                - apb_pclk


required:
    - compatible
    - reg
    - clocks
    - clock-names

examples:
    - |
        funnel_major@10080000 {
            compatible = "arm,coresight-dynamic-funnel, arm,primecell";
            status = "disabled";
            reg = <0x0 0x10080000 0x0 0x1000>;
            clocks = <&bpmp TEGRA264_CLK_HCSITE>;
            clock-names = "apb_pclk";
        };
```
