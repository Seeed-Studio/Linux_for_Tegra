## source/nvidia-oot/Documentation/devicetree/bindings/cpufreq/nvidia,tegra264-ccplex-cluster.yaml
```yaml
# Copyright (c) 2024, NVIDIA CORPORATION & AFFILIATES.  All rights reserved.
#
# This program is free software; you can redistribute it and/or modify it
# under the terms and conditions of the GNU General Public License,
# version 2, as published by the Free Software Foundation.
#
# This program is distributed in the hope it will be useful, but WITHOUT
# ANY WARRANTY; without even the implied warranty of MERCHANTABILITY or
# FITNESS FOR A PARTICULAR PURPOSE.  See the GNU General Public License for
# more details.

%YAML 1.2
---
$id: http://devicetree.org/schemas/ccplex@8120000000/nvidia,tegra264-ccplex-cluster.yaml#
$schema: http://devicetree.org/meta-schemas/core.yaml#

title: NVIDIA Tegra T264 cpufreq driver

maintainers:
  - Sumit Gupta
  - Mikko Perttunen
  - Rich Wiley

description: |
     the compatability = nvidia,tegra264-ccplex-cluster is mentioned in the following drivers
        - <TOP>/kernel/kernel-oot/drivers/cpufreq/tegra194-cpufreq.c

     The following nodes use this compatibility
        - /bus@0/ccplex@8120000000

select:
  properties:
    compatible:
        minItems: 1
        maxItems: 1
        items:
            enum:
                - nvidia,tegra264-ccplex-cluster

  required:
    - compatible

properties:

    nvidia,bpmp:
        $ref: "/schemas/types.yaml#/definitions/uint32"

    reg:
        $ref: "/schemas/types.yaml#/definitions/uint32-matrix"
        description: |
            Registers are given by a tuple of two values:
                - register address:
                - register block size.
        items:
            minItems: 4
            maxItems: 4
            items:
                - $ref: "/schemas/types.yaml#/definitions/uint32"
                  minimum: 0x81
                  maximum: 0x81
                - $ref: "/schemas/types.yaml#/definitions/uint32"
                  minimum: 0x30000000
                  maximum: 0x30000000
                - $ref: "/schemas/types.yaml#/definitions/uint32"
                  minimum: 0x0
                  maximum: 0x0
                - $ref: "/schemas/types.yaml#/definitions/uint32"
                  minimum: 0xcf0000
                  maximum: 0xcf0000

required:
    - compatible
    - reg

examples:
    - |
        ccplex@8120000000 {
            compatible = "nvidia,tegra264-ccplex-cluster";
            status = "disabled";
            nvidia,bpmp = <&bpmp>;
            reg = <0x81 0x30000000 0x0 0xcf0000>;
        };
```

## source/nvidia-oot/Documentation/devicetree/bindings/cpuidle/arm,idle-state.yaml
```yaml
# Copyright (c) 2024, NVIDIA CORPORATION & AFFILIATES.  All rights reserved.
#
# This program is free software; you can redistribute it and/or modify it
# under the terms and conditions of the GNU General Public License,
# version 2, as published by the Free Software Foundation.
#
# This program is distributed in the hope it will be useful, but WITHOUT
# ANY WARRANTY; without even the implied warranty of MERCHANTABILITY or
# FITNESS FOR A PARTICULAR PURPOSE.  See the GNU General Public License for
# more details.

%YAML 1.2
---
$id: http://devicetree.org/schemas/cc7/arm,idle-state.yaml#
$schema: http://devicetree.org/meta-schemas/core.yaml#

title: ARM/ARM64 generic CPU idle driver

maintainers:
  - Rich Wiley


description: |
     the compatability = arm,idle-state is mentioned in the following drivers
        - <TOP>/kernel/kernel-oot/drivers/cpuidle/cpuidle-psci.c
        - <TOP>/kernel/kernel-oot/drivers/cpuidle/cpuidle-big_little.c
        - <TOP>/kernel/kernel-oot/drivers/cpuidle/cpuidle-arm.c

     The following nodes use this compatibility
        - /cpus/idle-states/cc7

select:
  properties:
    compatible:
        minItems: 1
        maxItems: 1
        items:
            enum:
                - arm,idle-state

  required:
    - compatible

properties:

    state-name:
        $ref: "/schemas/types.yaml#/definitions/string-array"
        items:
            enum:
                - Cluster Powergate


    entry-latency-us:
        $ref: "/schemas/types.yaml#/definitions/uint32"
        minimum: 0x1388
        maximum: 0x1388

    exit-latency-us:
        $ref: "/schemas/types.yaml#/definitions/uint32"
        minimum: 0x1388
        maximum: 0x1388

    min-residency-us:
        $ref: "/schemas/types.yaml#/definitions/uint32"
        minimum: 0x61a8
        maximum: 0x61a8

    arm,psci-suspend-param:
        $ref: "/schemas/types.yaml#/definitions/uint32"
        minimum: 0x40000007
        maximum: 0x40000007

required:
    - compatible

examples:
    - |
        cc7 {
            compatible = "arm,idle-state";
            state-name = "Cluster Powergate";
            entry-latency-us = <5000>;
            exit-latency-us = <5000>;
            min-residency-us = <25000>;
            arm,psci-suspend-param = <0x40000007>;
            status = "disabled";
        };
```

## source/nvidia-oot/Documentation/devicetree/bindings/firmware/tegra/nvidia,tegra194-safe-bpmp-hv.yaml
```yaml
# Copyright (c) 2024, NVIDIA CORPORATION & AFFILIATES.  All rights reserved.
#
# This program is free software; you can redistribute it and/or modify it
# under the terms and conditions of the GNU General Public License,
# version 2, as published by the Free Software Foundation.
#
# This program is distributed in the hope it will be useful, but WITHOUT
# ANY WARRANTY; without even the implied warranty of MERCHANTABILITY or
# FITNESS FOR A PARTICULAR PURPOSE.  See the GNU General Public License for
# more details.

%YAML 1.2
---
$id: http://devicetree.org/schemas/bpmp/nvidia,tegra194-safe-bpmp-hv.yaml#
$schema: http://devicetree.org/meta-schemas/core.yaml#

title: Virtual BPMP Driver

maintainers:
  - Sharif Shaik

description: |
     the compatability = nvidia,tegra194-safe-bpmp-hv is mentioned in the following drivers
        - <TOP>/kernel/nvidia-oot/drivers/firmware/tegra/bpmp-tegra186-hv.c
        - <TOP>/kernel/nvidia-oot/drivers/gpu/drm/tegra/virt.c

     The following nodes use this compatibility
        - /bpmp

select:
  properties:
    compatible:
        minItems: 1
        maxItems: 1
        items:
            enum:
                - nvidia,tegra194-safe-bpmp-hv

  required:
    - compatible

properties:

    mboxes:
        $ref: "/schemas/types.yaml#/definitions/uint32-matrix"
        items:
            minItems: 3
            maxItems: 3
            items:
                - $ref: "/schemas/types.yaml#/definitions/uint32"
                - $ref: "/schemas/types.yaml#/definitions/uint32"
                  minimum: 0x0
                  maximum: 0x0
                - $ref: "/schemas/types.yaml#/definitions/uint32"
                  minimum: 0x13
                  maximum: 0x13

    '#clock-cells':
        $ref: "/schemas/types.yaml#/definitions/uint32"
        minimum: 0x1
        maximum: 0x1

    '#reset-cells':
        $ref: "/schemas/types.yaml#/definitions/uint32"
        minimum: 0x1
        maximum: 0x1

    '#power-domain-cells':
        $ref: "/schemas/types.yaml#/definitions/uint32"
        minimum: 0x1
        maximum: 0x1

    numa-node-id:
        $ref: "/schemas/types.yaml#/definitions/uint32"
        minimum: 0x0
        maximum: 0x0

    ivc_queue:
        $ref: "/schemas/types.yaml#/definitions/uint32"
        minimum: 0x0
        maximum: 0xf

    mempool:
        $ref: "/schemas/types.yaml#/definitions/uint32"
        minimum: 0x3
        maximum: 0x3

required:
    - compatible

examples:
    - |
        bpmp {
            compatible = "nvidia,tegra264-bpmp",
                         "nvidia,tegra234-bpmp",
                         "nvidia,tegra186-bpmp";
            status = "disabled";
            mboxes = <&top_hsp0 TEGRA_HSP_MBOX_TYPE_DB TEGRA_HSP_DB_MASTER_BPMP>;
            memory-region = <&dram_cpu_bpmp_mail>;
            #clock-cells = <1>;
            #reset-cells = <1>;
            #power-domain-cells = <1>;
            numa-node-id = <0>;
        };
```

## source/nvidia-oot/Documentation/devicetree/bindings/gpio/nvidia,tegra264-pinmux-uphy.yaml
```yaml
# Copyright (c) 2024, NVIDIA CORPORATION & AFFILIATES.  All rights reserved.
#
# This program is free software; you can redistribute it and/or modify it
# under the terms and conditions of the GNU General Public License,
# version 2, as published by the Free Software Foundation.
#
# This program is distributed in the hope it will be useful, but WITHOUT
# ANY WARRANTY; without even the implied warranty of MERCHANTABILITY or
# FITNESS FOR A PARTICULAR PURPOSE.  See the GNU General Public License for
# more details.

%YAML 1.2
---
$id: http://devicetree.org/schemas/pinmux@a8082e0000/nvidia,tegra264-pinmux-uphy.yaml#
$schema: http://devicetree.org/meta-schemas/core.yaml#

title: NVIDIA Tegra PINMUX driver

maintainers:
  - Suresh Mangipudi

description: |
     the compatability = nvidia,tegra264-pinmux-uphy is mentioned in the following drivers
        - <TOP>/kernel/kernel-oot/drivers/gpio/gpio-tegra186.c
        - <TOP>/kernel/kernel-oot/drivers/pinctrl/tegra/pinctrl-tegra264-generic.c

     The following nodes use this compatibility
        - /bus@0/pinmux@a8082e0000

select:
  properties:
    compatible:
        minItems: 1
        maxItems: 1
        items:
            enum:
                - nvidia,tegra264-pinmux-uphy

  required:
    - compatible

properties:

    reg:
        $ref: "/schemas/types.yaml#/definitions/uint32-matrix"
        description: |
            Registers are given by a tuple of two values:
                - register address:
                - register block size.
        items:
            minItems: 4
            maxItems: 4
            items:
                - $ref: "/schemas/types.yaml#/definitions/uint32"
                  minimum: 0xa8
                  maximum: 0xa8
                - $ref: "/schemas/types.yaml#/definitions/uint32"
                  minimum: 0x82e0000
                  maximum: 0x82e0000
                - $ref: "/schemas/types.yaml#/definitions/uint32"
                  minimum: 0x0
                  maximum: 0x0
                - $ref: "/schemas/types.yaml#/definitions/uint32"
                  minimum: 0x4000
                  maximum: 0x4000

required:
    - compatible
    - reg

examples:
    - |
        pinmux@a8082e0000 {
            compatible = "nvidia,tegra264-pinmux-uphy";
            status = "disabled";
            reg = <0xa8 0x082e0000 0x0 0x4000>;
        };
```

## source/nvidia-oot/Documentation/devicetree/bindings/hte/nvidia,tegra264-gte-aon.yaml
```yaml
# Copyright (c) 2024, NVIDIA CORPORATION & AFFILIATES.  All rights reserved.
#
# This program is free software; you can redistribute it and/or modify it
# under the terms and conditions of the GNU General Public License,
# version 2, as published by the Free Software Foundation.
#
# This program is distributed in the hope it will be useful, but WITHOUT
# ANY WARRANTY; without even the implied warranty of MERCHANTABILITY or
# FITNESS FOR A PARTICULAR PURPOSE.  See the GNU General Public License for
# more details.

%YAML 1.2
---
$id: http://devicetree.org/schemas/hardware-timestamp@c2b0000/nvidia,tegra264-gte-aon.yaml#
$schema: http://devicetree.org/meta-schemas/core.yaml#

title: NVIDIA Tegra HTE (Hardware Timestamping Engine) Driver

maintainers:
  - Dipen Patel

description: |
     the compatability = nvidia,tegra264-gte-aon is mentioned in the following drivers
        - <TOP>/kernel/kernel-oot/drivers/hte/hte-tegra194.c

     The following nodes use this compatibility
        - /bus@0/hardware-timestamp@c2b0000

select:
  properties:
    compatible:
        minItems: 1
        maxItems: 1
        items:
            enum:
                - nvidia,tegra264-gte-aon

  required:
    - compatible

properties:

    reg:
        $ref: "/schemas/types.yaml#/definitions/uint32-matrix"
        description: |
            Registers are given by a tuple of two values:
                - register address:
                - register block size.
        items:
            minItems: 4
            maxItems: 4
            items:
                - $ref: "/schemas/types.yaml#/definitions/uint32"
                  minimum: 0x0
                  maximum: 0x0
                - $ref: "/schemas/types.yaml#/definitions/uint32"
                  minimum: 0xc2b0000
                  maximum: 0xc2b0000
                - $ref: "/schemas/types.yaml#/definitions/uint32"
                  minimum: 0x0
                  maximum: 0x0
                - $ref: "/schemas/types.yaml#/definitions/uint32"
                  minimum: 0x10000
                  maximum: 0x10000

    interrupts:
        $ref: "/schemas/types.yaml#/definitions/uint32-matrix"
        description: |
            Interrupts are give by a tuple of 3 values:
                - interrupt specifier (GIC_SPI = 0, GIC_PPI = 1)
                  definitions in dt-bindings/interrupt-controller/arm-gic.h
                - interrupt number
                - trigger type (rising edge, falling edge, both, etc)
                  definitions in dt-bindings/interrupt-controller/irq.h
        items:
            items:
                - $ref: "/schemas/types.yaml#/definitions/uint32"
                  minimum: 0x0
                  maximum: 0x0
                - $ref: "/schemas/types.yaml#/definitions/uint32"
                  minimum: 0x226
                  maximum: 0x226
                - $ref: "/schemas/types.yaml#/definitions/uint32"
                  minimum: 0x4
                  maximum: 0x4

    nvidia,int-threshold:
        $ref: "/schemas/types.yaml#/definitions/uint32"
        minimum: 0x1
        maximum: 0x1

    '#timestamp-cells':
        $ref: "/schemas/types.yaml#/definitions/uint32"
        minimum: 0x1
        maximum: 0x1

    nvidia,gpio-controller:
        $ref: "/schemas/types.yaml#/definitions/uint32"

required:
    - compatible
    - reg
    - interrupts

examples:
    - |
        hardware-timestamp@c2b0000 {
            compatible = "nvidia,tegra264-gte-aon";
            reg = <0x0 0x0c2b0000 0x0 0x10000>;
            interrupts = <GIC_SPI 0x00000226 IRQ_TYPE_LEVEL_HIGH>;
            nvidia,int-threshold = <1>;
            #timestamp-cells = <1>;
            nvidia,gpio-controller = <&gpio_aon>;
            status = "disabled";
        };
```
