## source/nvidia-oot/Documentation/devicetree/bindings/misc/arm,coresight-stm.yaml
```yaml
# Copyright (c) 2024, NVIDIA CORPORATION & AFFILIATES.  All rights reserved.
#
# This program is free software; you can redistribute it and/or modify it
# under the terms and conditions of the GNU General Public License,
# version 2, as published by the Free Software Foundation.
#
# This program is distributed in the hope it will be useful, but WITHOUT
# ANY WARRANTY; without even the implied warranty of MERCHANTABILITY or
# FITNESS FOR A PARTICULAR PURPOSE.  See the GNU General Public License for
# more details.

%YAML 1.2
---
$id: http://devicetree.org/schemas/stm@10070000/arm,coresight-stm.yaml#
$schema: http://devicetree.org/meta-schemas/core.yaml#

title: Coresight STM Driver

maintainers:
  - Rich Wiley

description: |
     The following nodes use this compatibility
        - /stm@10070000

select:
  properties:
    compatible:
        minItems: 2
        maxItems: 2
        items:
            enum:
                - arm,coresight-stm
                - arm,primecell

  required:
    - compatible

properties:

    reg:
        $ref: "/schemas/types.yaml#/definitions/uint32-matrix"
        description: |
            Registers are given by a tuple of two values:
                - register address:
                - register block size.
        items:
            minItems: 4
            maxItems: 4
            items:
                - $ref: "/schemas/types.yaml#/definitions/uint32"
                  minimum: 0x0
                  maximum: 0x0
                - $ref: "/schemas/types.yaml#/definitions/uint32"
                  minimum: 0x10070000
                  maximum: 0x11000000
                - $ref: "/schemas/types.yaml#/definitions/uint32"
                  minimum: 0x0
                  maximum: 0x0
                - $ref: "/schemas/types.yaml#/definitions/uint32"
                  minimum: 0x1000
                  maximum: 0x1000000

    reg-names:
        $ref: "/schemas/types.yaml#/definitions/string-array"
        items:
            enum:
                - stm-base
                - stm-stimulus-base


    clocks:
        $ref: "/schemas/types.yaml#/definitions/uint32-matrix"
        description: |
            Clocks are given by a tuple of 2 values:
                - Phandle to the device
                - Clock ID
        items:
            minItems: 2
            maxItems: 2
            items:
                - $ref: "/schemas/types.yaml#/definitions/uint32"
                - $ref: "/schemas/types.yaml#/definitions/uint32"
                  minimum: 0xca
                  maximum: 0xca

    clock-names:
        $ref: "/schemas/types.yaml#/definitions/string-array"
        items:
            enum:
                - apb_pclk


required:
    - compatible
    - reg
    - clocks
    - clock-names

examples:
    - |
        stm@10070000 {
            compatible = "arm,coresight-stm, arm,primecell";
            status = "disabled";
            reg = <0x0 0x10070000 0x0 0x1000>,
                  <0x0 0x11000000 0x0 0x1000000>;
            reg-names = "stm-base, stm-stimulus-base";
            clocks = <&bpmp TEGRA264_CLK_CSITE>;
            clock-names = "apb_pclk";
        };
```

## source/nvidia-oot/Documentation/devicetree/bindings/misc/mods/simple-bus.yaml
```yaml
# Copyright (c) 2024, NVIDIA CORPORATION & AFFILIATES.  All rights reserved.
#
# This program is free software; you can redistribute it and/or modify it
# under the terms and conditions of the GNU General Public License,
# version 2, as published by the Free Software Foundation.
#
# This program is distributed in the hope it will be useful, but WITHOUT
# ANY WARRANTY; without even the implied warranty of MERCHANTABILITY or
# FITNESS FOR A PARTICULAR PURPOSE.  See the GNU General Public License for
# more details.

%YAML 1.2
---
$id: http://devicetree.org/schemas/bus@0/simple-bus.yaml#
$schema: http://devicetree.org/meta-schemas/core.yaml#

title: Mods Simple Bus Driver

maintainers:
  - Chris Dragan
  - Kiran Kasamsetty

description: |
     the compatability = simple-bus is mentioned in the following drivers
        - <TOP>/kernel/nvidia-oot/drivers/misc/mods/mods_clock.c

     The following nodes use this compatibility
        - /bus@0
        - /mods-simple-bus

select:
  properties:
    compatible:
        minItems: 1
        maxItems: 1
        items:
            enum:
                - simple-bus

  required:
    - compatible

properties:

    '#address-cells':
        $ref: "/schemas/types.yaml#/definitions/uint32"
        minimum: 0x1
        maximum: 0x2

    '#size-cells':
        $ref: "/schemas/types.yaml#/definitions/uint32"
        minimum: 0x0
        maximum: 0x2

    device_type:
        $ref: "/schemas/types.yaml#/definitions/string-array"
        items:
            enum:
                - mods-simple-bus


required:
    - compatible

examples:
    - |
        bus@0 {
            compatible = "simple-bus";
            #address-cells = <2>;
            #size-cells = <2>;
            ranges = <0x0 0x0 0x0 0x0 0x100 0x0>;
        };
```

## source/nvidia-oot/Documentation/devicetree/bindings/misc/nvidia,csi-isp-map-config.yaml
```yaml
# Copyright (c) 2024, NVIDIA CORPORATION & AFFILIATES.  All rights reserved.
#
# This program is free software; you can redistribute it and/or modify it
# under the terms and conditions of the GNU General Public License,
# version 2, as published by the Free Software Foundation.
#
# This program is distributed in the hope it will be useful, but WITHOUT
# ANY WARRANTY; without even the implied warranty of MERCHANTABILITY or
# FITNESS FOR A PARTICULAR PURPOSE.  See the GNU General Public License for
# more details.

%YAML 1.2
---
$id: http://devicetree.org/schemas/tegra-isp-map/nvidia,csi-isp-map-config.yaml#
$schema: http://devicetree.org/meta-schemas/core.yaml#

title: Nvidia Tegra CSI-ISP Map Config

maintainers:
  - Chinniah Poosapadi

description: |
     The following nodes use this compatibility
        - /tegra-isp-map

select:
  properties:
    compatible:
        minItems: 1
        maxItems: 1
        items:
            enum:
                - nvidia,csi-isp-map-config

  required:
    - compatible

properties:

    nvidia,isp-mapping:
        $ref: "/schemas/types.yaml#/definitions/uint32-matrix"
        items:
            minItems: 2
            maxItems: 2
            items:
                - $ref: "/schemas/types.yaml#/definitions/uint32"
                  minimum: 0x0
                  maximum: 0x5
                - $ref: "/schemas/types.yaml#/definitions/uint32"
                  minimum: 0x0
                  maximum: 0x1

required:
    - compatible

examples:
    - |
        tegra-isp-map {
            compatible = "nvidia,csi-isp-map-config";
            nvidia,isp-mapping = <0 0>,
                                 <1 0>,
                                 <2 1>,
                                 <3 1>,
                                 <4 0>,
                                 <5 1>;
            status = "disabled";
        };
```

## source/nvidia-oot/Documentation/devicetree/bindings/misc/nvidia,sensor-isp-map-config.yaml
```yaml
# SPDX-License-Identifier: GPL-2.0-only OR BSD-2-Clause
# SPDX-FileCopyrightText: Copyright (c) 2025 NVIDIA CORPORATION & AFFILIATES. All rights reserved.
#
# This program is free software; you can redistribute it and/or modify it
# under the terms and conditions of the GNU General Public License,
# version 2, as published by the Free Software Foundation.
#
# This program is distributed in the hope it will be useful, but WITHOUT
# ANY WARRANTY; without even the implied warranty of MERCHANTABILITY or
# FITNESS FOR A PARTICULAR PURPOSE.  See the GNU General Public License for
# more details.

%YAML 1.2
---
$id: http://devicetree.org/schemas/tegra-isp-map/nvidia,sensor-isp-map-config.yaml#
$schema: http://devicetree.org/meta-schemas/core.yaml#

title: Nvidia Tegra Sensor-ISP Map Config

maintainers:
  - Chinniah Poosapadi

description: |
     The following nodes use this compatibility
        - /tegra-isp-map

select:
  properties:
    compatible:
        minItems: 1
        maxItems: 1
        items:
            enum:
                - nvidia,sensor-isp-map-config

  required:
    - compatible

properties:

    nvidia,isp-mapping:
        $ref: "/schemas/types.yaml#/definitions/uint32-matrix"
        items:
            minItems: 2
            maxItems: 2
            items:
                - $ref: "/schemas/types.yaml#/definitions/uint32"
                  minimum: 0x0
                  maximum: 0x11
                - $ref: "/schemas/types.yaml#/definitions/uint32"
                  minimum: 0x0
                  maximum: 0x1

required:
    - compatible

examples:
    - |
        tegra-isp-map {
            compatible = "nvidia,sensor-isp-map-config";
            nvidia,isp-mapping = <0 0>,
                                 <1 1>,
                                 <2 0>,
                                 <3 1>,
                                 <4 0>,
                                 <5 1>,
                                 <6 0>,
                                 <7 1>,
                                 <8 0>,
                                 <9 1>,
                                 <10 0>,
                                 <11 1>,
                                 <12 0>,
                                 <13 1>,
                                 <14 0>,
                                 <15 1>,
                                 <16 0>,
                                 <17 1>;
            status = "disabled";
        };
```
