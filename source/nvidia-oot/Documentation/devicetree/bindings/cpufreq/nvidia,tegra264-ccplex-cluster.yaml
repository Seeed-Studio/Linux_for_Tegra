## source/nvidia-oot/Documentation/devicetree/bindings/misc/nvidia,tegra186-hsp-mailbox.yaml
```yaml
# Copyright (c) 2024, NVIDIA CORPORATION & AFFILIATES.  All rights reserved.
#
# This program is free software; you can redistribute it and/or modify it
# under the terms and conditions of the GNU General Public License,
# version 2, as published by the Free Software Foundation.
#
# This program is distributed in the hope it will be useful, but WITHOUT
# ANY WARRANTY; without even the implied warranty of MERCHANTABILITY or
# FITNESS FOR A PARTICULAR PURPOSE.  See the GNU General Public License for
# more details.

%YAML 1.2
---
$id: http://devicetree.org/schemas/hsp-mbox/nvidia,tegra186-hsp-mailbox.yaml#
$schema: http://devicetree.org/meta-schemas/core.yaml#

title: Hypervisor Hardware Syncronization Primatives (HSP) Driver

maintainers:
  - Suresh Mangipudi

description: |
     The following nodes use this compatibility
        - /bus@0/host1x@8181200000/pva0@818c000000/hsp/hsp-mbox

select:
  properties:
    compatible:
        minItems: 1
        maxItems: 1
        items:
            enum:
                - nvidia,tegra186-hsp-mailbox

  required:
    - compatible

properties:

    nvidia,hsp-shared-mailbox:
        $ref: "/schemas/types.yaml#/definitions/uint32-matrix"
        items:
            minItems: 2
            maxItems: 2
            items:
                - $ref: "/schemas/types.yaml#/definitions/uint32"
                - $ref: "/schemas/types.yaml#/definitions/uint32"
                  minimum: 0x0
                  maximum: 0x7

    nvidia,hsp-shared-mailbox-names:
        $ref: "/schemas/types.yaml#/definitions/string-array"
        items:
            enum:
                - command
                - addr
                - len
                - args
                - sidechannel-wr
                - aisr
                - sidechannel-rd
                - isr


required:
    - compatible

examples:
    - |
        hsp-mbox {
            compatible = "nvidia,tegra186-hsp-mailbox";
            nvidia,hsp-shared-mailbox = <&hsp_pva0 0x0>,
                                        <&hsp_pva0 0x1>,
                                        <&hsp_pva0 0x2>,
                                        <&hsp_pva0 0x3>,
                                        <&hsp_pva0 0x4>,
                                        <&hsp_pva0 0x5>,
                                        <&hsp_pva0 0x6>,
                                        <&hsp_pva0 0x7>;
            nvidia,hsp-shared-mailbox-names = "command, addr, len, args, sidechannel-wr, aisr, sidechannel-rd, isr";
            status = "disabled";
        };
```

## source/nvidia-oot/Documentation/devicetree/bindings/misc/nvidia,tegra264-adsp-audio-hv.yaml
```yaml
# Copyright (c) 2024, NVIDIA CORPORATION & AFFILIATES.  All rights reserved.
#
# This program is free software; you can redistribute it and/or modify it
# under the terms and conditions of the GNU General Public License,
# version 2, as published by the Free Software Foundation.
#
# This program is distributed in the hope it will be useful, but WITHOUT
# ANY WARRANTY; without even the implied warranty of MERCHANTABILITY or
# FITNESS FOR A PARTICULAR PURPOSE.  See the GNU General Public License for
# more details.

%YAML 1.2
---
$id: http://devicetree.org/schemas/adsp_audio/nvidia,tegra264-adsp-audio-hv.yaml#
$schema: http://devicetree.org/meta-schemas/core.yaml#

title: Nvidia Hypervisor Audio Driver

maintainers:
  - Mohan Kumar

description: |
     The following nodes use this compatibility
        - /bus@0/aconnect@9000000/adsp_audio

select:
  properties:
    compatible:
        minItems: 1
        maxItems: 1
        items:
            enum:
                - nvidia,tegra264-adsp-audio-hv

  required:
    - compatible

properties:

    nvidia,adma_ch_page:
        $ref: "/schemas/types.yaml#/definitions/uint32"
        minimum: 0x7
        maximum: 0x7

    nvidia,adma_ch_start:
        $ref: "/schemas/types.yaml#/definitions/uint32"
        minimum: 0x31
        maximum: 0x31

    nvidia,adma_ch_cnt:
        $ref: "/schemas/types.yaml#/definitions/uint32"
        minimum: 0x8
        maximum: 0x8

    compr-ops:
        $ref: "/schemas/types.yaml#/definitions/uint32"
        minimum: 0x0
        maximum: 0x0

    num-plugin:
        $ref: "/schemas/types.yaml#/definitions/uint32"
        minimum: 0x1
        maximum: 0x1

required:
    - compatible

examples:
    - |
        adsp_audio {
        };
```

## source/nvidia-oot/Documentation/devicetree/bindings/misc/nvidia,tegra264-agic.yaml
```yaml
# Copyright (c) 2024, NVIDIA CORPORATION & AFFILIATES.  All rights reserved.
#
# This program is free software; you can redistribute it and/or modify it
# under the terms and conditions of the GNU General Public License,
# version 2, as published by the Free Software Foundation.
#
# This program is distributed in the hope it will be useful, but WITHOUT
# ANY WARRANTY; without even the implied warranty of MERCHANTABILITY or
# FITNESS FOR A PARTICULAR PURPOSE.  See the GNU General Public License for
# more details.

%YAML 1.2
---
$id: http://devicetree.org/schemas/interrupt-controller@9960000/nvidia,tegra264-agic.yaml#
$schema: http://devicetree.org/meta-schemas/core.yaml#

title: Nvidia T264 Interrupt Controller

maintainers:
  - Mohan Kumar

description: |
     The following nodes use this compatibility
        - /bus@0/aconnect@9000000/interrupt-controller@9960000
        - /bus@0/aconnect@9000000/interrupt-controller@9970000
        - /bus@0/aconnect@9000000/interrupt-controller@9980000
        - /bus@0/aconnect@9000000/interrupt-controller@9990000
        - /bus@0/aconnect@9000000/interrupt-controller@99a0000
        - /bus@0/aconnect@9000000/interrupt-controller@99b0000

select:
  properties:
    compatible:
        minItems: 2
        maxItems: 2
        items:
            enum:
                - nvidia,tegra264-agic
                - nvidia,tegra210-agic

  required:
    - compatible

properties:

    '#interrupt-cells':
        $ref: "/schemas/types.yaml#/definitions/uint32"
        minimum: 0x3
        maximum: 0x3

    interrupt-controller:
        $ref: "/schemas/types.yaml#/definitions/flag"

    reg:
        $ref: "/schemas/types.yaml#/definitions/uint32-matrix"
        description: |
            Registers are given by a tuple of two values:
                - register address:
                - register block size.
        items:
            minItems: 4
            maxItems: 4
            items:
                - $ref: "/schemas/types.yaml#/definitions/uint32"
                  minimum: 0x0
                  maximum: 0x0
                - $ref: "/schemas/types.yaml#/definitions/uint32"
                  minimum: 0x9961000
                  maximum: 0x99b2000
                - $ref: "/schemas/types.yaml#/definitions/uint32"
                  minimum: 0x0
                  maximum: 0x0
                - $ref: "/schemas/types.yaml#/definitions/uint32"
                  minimum: 0x1000
                  maximum: 0x1000

    interrupts:
        $ref: "/schemas/types.yaml#/definitions/uint32-matrix"
        description: |
            Interrupts are give by a tuple of 3 values:
                - interrupt specifier (GIC_SPI = 0, GIC_PPI = 1)
                  definitions in dt-bindings/interrupt-controller/arm-gic.h
                - interrupt number
                - trigger type (rising edge, falling edge, both, etc)
                  definitions in dt-bindings/interrupt-controller/irq.h
        items:
            items:
                - $ref: "/schemas/types.yaml#/definitions/uint32"
                  minimum: 0x0
                  maximum: 0xf04
                - $ref: "/schemas/types.yaml#/definitions/uint32"
                  minimum: 0x0
                  maximum: 0xf04

    clocks:
        $ref: "/schemas/types.yaml#/definitions/uint32-matrix"
        description: |
            Clocks are given by a tuple of 2 values:
                - Phandle to the device
                - Clock ID
        items:
            minItems: 2
            maxItems: 2
            items:
                - $ref: "/schemas/types.yaml#/definitions/uint32"
                - $ref: "/schemas/types.yaml#/definitions/uint32"
                  minimum: 0x9c
                  maximum: 0x9c

    clock-names:
        $ref: "/schemas/types.yaml#/definitions/string-array"
        items:
            enum:
                - clk


required:
    - compatible
    - reg
    - interrupts
    - clocks
    - clock-names

examples:
    - |
        interrupt-controller@9960000 {
            compatible = "nvidia,tegra264-agic",
                         "nvidia,tegra210-agic";
            #interrupt-cells = <3>;
            interrupt-controller;
            reg = <0x0 0x9961000 0x0 0x1000>,
                  <0x0 0x9962000 0x0 0x1000>;
            interrupts = <GIC_SPI 0x230(GIC_CPU_MASK_SIMPLE(4)|IRQ_TYPE_LEVEL_HIGH)>;
            clocks = <&bpmp TEGRA264_CLK_ADSP>;
            clock-names = "clk";
            status = "disabled";
        };
```

## source/nvidia-oot/Documentation/devicetree/bindings/misc/nvidia,tegra264-audio-graph-card.yaml
```yaml
# Copyright (c) 2024, NVIDIA CORPORATION & AFFILIATES.  All rights reserved.
#
# This program is free software; you can redistribute it and/or modify it
# under the terms and conditions of the GNU General Public License,
# version 2, as published by the Free Software Foundation.
#
# This program is distributed in the hope it will be useful, but WITHOUT
# ANY WARRANTY; without even the implied warranty of MERCHANTABILITY or
# FITNESS FOR A PARTICULAR PURPOSE.  See the GNU General Public License for
# more details.

%YAML 1.2
---
$id: http://devicetree.org/schemas/sound/nvidia,tegra264-audio-graph-card.yaml#
$schema: http://devicetree.org/meta-schemas/core.yaml#

title: Nvidia T264 Audio Graph Card Driver

maintainers:
  - Mohan Kumar

description: |
     The following nodes use this compatibility
        - /sound

select:
  properties:
    compatible:
        minItems: 1
        maxItems: 1
        items:
            enum:
                - nvidia,tegra264-audio-graph-card

  required:
    - compatible

properties:

    nvidia,ahub-c2c-links:
        $ref: "/schemas/types.yaml#/definitions/flag"

    clocks:
        $ref: "/schemas/types.yaml#/definitions/uint32-matrix"
        description: |
            Clocks are given by a tuple of 2 values:
                - Phandle to the device
                - Clock ID
        items:
            minItems: 2
            maxItems: 2
            items:
                - $ref: "/schemas/types.yaml#/definitions/uint32"
                - $ref: "/schemas/types.yaml#/definitions/uint32"
                  minimum: 0x9e
                  maximum: 0x9f

    clock-names:
        $ref: "/schemas/types.yaml#/definitions/string-array"
        items:
            enum:
                - pll_a
                - plla_out0


    assigned-clocks:
        $ref: "/schemas/types.yaml#/definitions/uint32-matrix"
        items:
            minItems: 2
            maxItems: 2
            items:
                - $ref: "/schemas/types.yaml#/definitions/uint32"
                - $ref: "/schemas/types.yaml#/definitions/uint32"
                  minimum: 0x9e
                  maximum: 0x115

    assigned-clock-parents:
        $ref: "/schemas/types.yaml#/definitions/uint32"
        minimum: 0x0
        maximum: 0x9f

required:
    - compatible
    - clocks
    - clock-names

examples:
    - |
        sound {
            nvidia,ahub-c2c-links;
            compatible = "nvidia,tegra264-audio-graph-card";
            clocks = <&bpmp TEGRA264_CLK_PLLA1>,
                     <&bpmp TEGRA264_CLK_PLLA1_OUT1>;
            clock-names = "pll_a, plla_out0";
            assigned-clocks = <&bpmp TEGRA264_CLK_PLLA1>,
                              <&bpmp TEGRA264_CLK_PLLA1_OUT1>,
                              <&bpmp TEGRA264_CLK_AUD_MCLK>;
            assigned-clock-parents = <0>,
                                     <&bpmp TEGRA264_CLK_PLLA1>,
                                     <&bpmp TEGRA264_CLK_PLLA1_OUT1>;
            status = "disabled";
        };
```
