## source/nvidia-oot/Documentation/devicetree/bindings/i2c/busses/nvidia,tegra264-i2c.yaml
```yaml
# Copyright (c) 2024, NVIDIA CORPORATION & AFFILIATES.  All rights reserved.
#
# This program is free software; you can redistribute it and/or modify it
# under the terms and conditions of the GNU General Public License,
# version 2, as published by the Free Software Foundation.
#
# This program is distributed in the hope it will be useful, but WITHOUT
# ANY WARRANTY; without even the implied warranty of MERCHANTABILITY or
# FITNESS FOR A PARTICULAR PURPOSE.  See the GNU General Public License for
# more details.

%YAML 1.2
---
$id: http://devicetree.org/schemas/i2c@c600000/nvidia,tegra264-i2c.yaml#
$schema: http://devicetree.org/meta-schemas/core.yaml#

title: NVIDIA Tegra I2C Bus Controller driver

maintainers:
  - Suresh Mangipudi

description: |
     the compatability = nvidia,tegra264-i2c is mentioned in the following drivers
        - <TOP>/kernel/kernel-oot/drivers/i2c/busses/i2c-tegra.c

     The following nodes use this compatibility
        - /bus@0/i2c@c600000
        - /bus@0/i2c@c610000
        - /bus@0/i2c@810c410000
        - /bus@0/i2c@810c420000
        - /bus@0/i2c@810c430000
        - /bus@0/i2c@810c630000
        - /bus@0/i2c@810c640000
        - /bus@0/i2c@810c650000
        - /bus@0/i2c@810c670000
        - /bus@0/i2c@810c680000
        - /bus@0/i2c@810c690000
        - /bus@0/i2c@810c6a0000
        - /bus@0/i2c@810c6b0000
        - /bus@0/i2c@810c6c0000
        - /bus@0/i2c@810c6d0000

select:
  properties:
    compatible:
        minItems: 1
        maxItems: 1
        items:
            enum:
                - nvidia,tegra264-i2c

  required:
    - compatible

properties:

    reg:
        $ref: "/schemas/types.yaml#/definitions/uint32-matrix"
        description: |
            Registers are given by a tuple of two values:
                - register address:
                - register block size.
        items:
            minItems: 4
            maxItems: 4
            items:
                - $ref: "/schemas/types.yaml#/definitions/uint32"
                  minimum: 0x0
                  maximum: 0x81
                - $ref: "/schemas/types.yaml#/definitions/uint32"
                  minimum: 0xc410000
                  maximum: 0xc6d0000
                - $ref: "/schemas/types.yaml#/definitions/uint32"
                  minimum: 0x0
                  maximum: 0x0
                - $ref: "/schemas/types.yaml#/definitions/uint32"
                  minimum: 0x10000
                  maximum: 0x10000

    interrupts:
        $ref: "/schemas/types.yaml#/definitions/uint32-matrix"
        description: |
            Interrupts are give by a tuple of 3 values:
                - interrupt specifier (GIC_SPI = 0, GIC_PPI = 1)
                  definitions in dt-bindings/interrupt-controller/arm-gic.h
                - interrupt number
                - trigger type (rising edge, falling edge, both, etc)
                  definitions in dt-bindings/interrupt-controller/irq.h
        items:
            items:
                - $ref: "/schemas/types.yaml#/definitions/uint32"
                  minimum: 0x0
                  maximum: 0x0
                - $ref: "/schemas/types.yaml#/definitions/uint32"
                  minimum: 0x7e
                  maximum: 0x215
                - $ref: "/schemas/types.yaml#/definitions/uint32"
                  minimum: 0x4
                  maximum: 0x4

    clock-frequency:
        $ref: "/schemas/types.yaml#/definitions/uint32"
        minimum: 0x61a80
        maximum: 0x61a80

    dmas:
        $ref: "/schemas/types.yaml#/definitions/uint32-matrix"
        items:
            minItems: 4
            maxItems: 4
            items:
                - $ref: "/schemas/types.yaml#/definitions/uint32"
                - $ref: "/schemas/types.yaml#/definitions/uint32"
                  minimum: 0x0
                  maximum: 0x14
                - $ref: "/schemas/types.yaml#/definitions/uint32"
                  minimum: 0x1
                  maximum: 0x1f
                - $ref: "/schemas/types.yaml#/definitions/uint32"
                  minimum: 0x801
                  maximum: 0x81f

    dma-names:
        $ref: "/schemas/types.yaml#/definitions/string-array"
        items:
            enum:
                - tx


    iommus:
        $ref: "/schemas/types.yaml#/definitions/uint32-matrix"
        description: |
            iommus are given by a tuple of 2 values:
                - Phandle to the device
                - Device ID
        items:
            minItems: 2
            maxItems: 2
            items:
                - $ref: "/schemas/types.yaml#/definitions/uint32"
                - $ref: "/schemas/types.yaml#/definitions/uint32"
                  minimum: 0x801
                  maximum: 0x81f

    dma-coherent:
        $ref: "/schemas/types.yaml#/definitions/flag"

    clocks:
        $ref: "/schemas/types.yaml#/definitions/uint32-matrix"
        description: |
            Clocks are given by a tuple of 2 values:
                - Phandle to the device
                - Clock ID
        items:
            minItems: 2
            maxItems: 2
            items:
                - $ref: "/schemas/types.yaml#/definitions/uint32"
                - $ref: "/schemas/types.yaml#/definitions/uint32"
                  minimum: 0xd
                  maximum: 0xa0

    clock-names:
        $ref: "/schemas/types.yaml#/definitions/string-array"
        items:
            enum:
                - div-clk
                - parent


    assigned-clocks:
        $ref: "/schemas/types.yaml#/definitions/uint32-matrix"
        items:
            minItems: 2
            maxItems: 2
            items:
                - $ref: "/schemas/types.yaml#/definitions/uint32"
                - $ref: "/schemas/types.yaml#/definitions/uint32"
                  minimum: 0xd
                  maximum: 0x2f

    assigned-clock-parents:
        $ref: "/schemas/types.yaml#/definitions/uint32-matrix"
        items:
            minItems: 2
            maxItems: 2
            items:
                - $ref: "/schemas/types.yaml#/definitions/uint32"
                - $ref: "/schemas/types.yaml#/definitions/uint32"
                  minimum: 0x16
                  maximum: 0xa0

    resets:
        $ref: "/schemas/types.yaml#/definitions/uint32-matrix"
        description: |
            Resets are given by a tuple of 2 values:
                - Phandle to the device
                - Reset ID
        items:
            minItems: 2
            maxItems: 2
            items:
                - $ref: "/schemas/types.yaml#/definitions/uint32"
                - $ref: "/schemas/types.yaml#/definitions/uint32"
                  minimum: 0xb
                  maximum: 0x3c

    reset-names:
        $ref: "/schemas/types.yaml#/definitions/string-array"
        items:
            enum:
                - i2c


required:
    - compatible
    - reg
    - interrupts
    - iommus
    - clocks
    - clock-names
    - resets
    - reset-names

examples:
    - |
        i2c@c600000 {
            compatible = "nvidia,tegra264-i2c";
            status = "disabled";
            reg = <0x0 0x0c600000 0x0 0x10000>;
            interrupts = <GIC_SPI 532 IRQ_TYPE_LEVEL_HIGH>;
            clock-frequency = <400000>;
            dmas = <&gpcdma 3 3 TEGRA264_GPCDMA_SID_I2C2>;
            dma-names = "tx";
            iommus = <&smmu1_mmu TEGRA264_GPCDMA_SID_I2C2>;
            dma-coherent;
            clocks = <&bpmp TEGRA264_CLK_AON_I2C>,
                     <&bpmp TEGRA264_CLK_PLLAON>;
            clock-names = "div-clk, parent";
            assigned-clocks = <&bpmp TEGRA264_CLK_AON_I2C>;
            assigned-clock-parents = <&bpmp TEGRA264_CLK_PLLAON>;
            resets = <&bpmp TEGRA264_RESET_I2C2>;
            reset-names = "i2c";
        };
```

## source/nvidia-oot/Documentation/devicetree/bindings/mailbox/nvidia,tegra264-hsp-hv.yaml
```yaml
# Copyright (c) 2024, NVIDIA CORPORATION & AFFILIATES.  All rights reserved.
#
# This program is free software; you can redistribute it and/or modify it
# under the terms and conditions of the GNU General Public License,
# version 2, as published by the Free Software Foundation.
#
# This program is distributed in the hope it will be useful, but WITHOUT
# ANY WARRANTY; without even the implied warranty of MERCHANTABILITY or
# FITNESS FOR A PARTICULAR PURPOSE.  See the GNU General Public License for
# more details.

%YAML 1.2
---
$id: http://devicetree.org/schemas/tegra-hsp@8800000/nvidia,tegra264-hsp-hv.yaml#
$schema: http://devicetree.org/meta-schemas/core.yaml#

title: Hypervisor Hardware Syncronization Primatives (HSP) Driver

maintainers:
  - Suresh Mangipudi

description: |
     the compatability = nvidia,tegra264-hsp-hv is mentioned in the following drivers
        - <TOP>/kernel/kernel-oot/drivers/mailbox/tegra-hsp.c

     The following nodes use this compatibility
        - /bus@0/tegra-hsp@8800000
        - /bus@0/tegra-hsp@8c00000
        - /bus@0/tegra-hsp@8d00000
        - /bus@0/tegra-hsp@8189100000

select:
  properties:
    compatible:
        minItems: 1
        maxItems: 1
        items:
            enum:
                - nvidia,tegra264-hsp-hv

  required:
    - compatible

properties:

    reg:
        $ref: "/schemas/types.yaml#/definitions/uint32-matrix"
        description: |
            Registers are given by a tuple of two values:
                - register address:
                - register block size.
        items:
            minItems: 4
            maxItems: 4
            items:
                - $ref: "/schemas/types.yaml#/definitions/uint32"
                  minimum: 0x0
                  maximum: 0x81
                - $ref: "/schemas/types.yaml#/definitions/uint32"
                  minimum: 0x8800000
                  maximum: 0x89100000
                - $ref: "/schemas/types.yaml#/definitions/uint32"
                  minimum: 0x0
                  maximum: 0x0
                - $ref: "/schemas/types.yaml#/definitions/uint32"
                  minimum: 0xc0000
                  maximum: 0xd0000

    interrupts:
        $ref: "/schemas/types.yaml#/definitions/uint32-matrix"
        description: |
            Interrupts are give by a tuple of 3 values:
                - interrupt specifier (GIC_SPI = 0, GIC_PPI = 1)
                  definitions in dt-bindings/interrupt-controller/arm-gic.h
                - interrupt number
                - trigger type (rising edge, falling edge, both, etc)
                  definitions in dt-bindings/interrupt-controller/irq.h
        items:
            items:
                - $ref: "/schemas/types.yaml#/definitions/uint32"
                  minimum: 0x0
                  maximum: 0x0
                - $ref: "/schemas/types.yaml#/definitions/uint32"
                  minimum: 0x19f
                  maximum: 0x2a5
                - $ref: "/schemas/types.yaml#/definitions/uint32"
                  minimum: 0x4
                  maximum: 0x4

    interrupt-names:
        $ref: "/schemas/types.yaml#/definitions/string-array"
        items:
            enum:
                - doorbell
                - shared0
                - shared1
                - shared2
                - shared3
                - shared4
                - shared5
                - shared6
                - shared7


    '#mbox-cells':
        $ref: "/schemas/types.yaml#/definitions/uint32"
        minimum: 0x2
        maximum: 0x2

    nvidia,mbox-ie:
        $ref: "/schemas/types.yaml#/definitions/flag"

required:
    - compatible
    - reg
    - interrupts
    - interrupt-names

examples:
    - |
        tegra-hsp@8800000 {
            compatible = "nvidia,tegra264-hsp",
                         "nvidia,tegra234-hsp",
                         "nvidia,tegra186-hsp";
            status = "disabled";
            reg = <0x0 0x08800000 0x0 0xd0000>;
            interrupts = <GIC_SPI 620 IRQ_TYPE_LEVEL_HIGH>,
                         <GIC_SPI 622 IRQ_TYPE_LEVEL_HIGH>,
                         <GIC_SPI 623 IRQ_TYPE_LEVEL_HIGH>,
                         <GIC_SPI 624 IRQ_TYPE_LEVEL_HIGH>,
                         <GIC_SPI 625 IRQ_TYPE_LEVEL_HIGH>,
                         <GIC_SPI 626 IRQ_TYPE_LEVEL_HIGH>,
                         <GIC_SPI 627 IRQ_TYPE_LEVEL_HIGH>,
                         <GIC_SPI 628 IRQ_TYPE_LEVEL_HIGH>,
                         <GIC_SPI 629 IRQ_TYPE_LEVEL_HIGH>;
            interrupt-names = "doorbell, shared0, shared1, shared2",
                              "shared3",
                              "shared4, shared5, shared6, shared7";
            #mbox-cells = <2>;
            nvidia,mbox-ie;
        };
```
