## source/nvidia-oot/Documentation/devicetree/bindings/misc/nvidia,tegra264-bpmp-i2c.yaml
```yaml
# Copyright (c) 2024-2025, NVIDIA CORPORATION & AFFILIATES.  All rights reserved.
#
# This program is free software; you can redistribute it and/or modify it
# under the terms and conditions of the GNU General Public License,
# version 2, as published by the Free Software Foundation.
#
# This program is distributed in the hope it will be useful, but WITHOUT
# ANY WARRANTY; without even the implied warranty of MERCHANTABILITY or
# FITNESS FOR A PARTICULAR PURPOSE.  See the GNU General Public License for
# more details.

%YAML 1.2
---
$id: http://devicetree.org/schemas/i2c/nvidia,tegra264-bpmp-i2c.yaml#
$schema: http://devicetree.org/meta-schemas/core.yaml#

title: Nvidia Tegra T264 BPMP I2C Driver

maintainers:
  - Suresh Mangipudi

description: |
     The following nodes use this compatibility
        - /bpmp/i2c

select:
  properties:
    compatible:
        minItems: 2
        maxItems: 2
        items:
            enum:
                - nvidia,tegra264-bpmp-i2c
                - nvidia,tegra186-bpmp-i2c

  required:
    - compatible

properties:

    nvidia,bpmp-bus-id:
        $ref: "/schemas/types.yaml#/definitions/uint32"
        minimum: 0x5
        maximum: 0x5

    multi-master:
        $ref: "/schemas/types.yaml#/definitions/flag"
        description: Enables retries if arbitration is lost. Currently, the
                     functionality is supported only by the Tegra264 BPMP firmware.

    '#address-cells':
        $ref: "/schemas/types.yaml#/definitions/uint32"
        minimum: 0x1
        maximum: 0x1

    '#size-cells':
        $ref: "/schemas/types.yaml#/definitions/uint32"
        minimum: 0x0
        maximum: 0x0

required:
    - compatible

examples:
    - |
        i2c {
            compatible = "nvidia,tegra264-bpmp-i2c",
                         "nvidia,tegra186-bpmp-i2c";
            status = "disabled";
            nvidia,bpmp-bus-id = <5>;
            #address-cells = <1>;
            #size-cells = <0>;
        };
```

## source/nvidia-oot/Documentation/devicetree/bindings/misc/nvidia,tegra264-hda.yaml
```yaml
# Copyright (c) 2024, NVIDIA CORPORATION & AFFILIATES.  All rights reserved.
#
# This program is free software; you can redistribute it and/or modify it
# under the terms and conditions of the GNU General Public License,
# version 2, as published by the Free Software Foundation.
#
# This program is distributed in the hope it will be useful, but WITHOUT
# ANY WARRANTY; without even the implied warranty of MERCHANTABILITY or
# FITNESS FOR A PARTICULAR PURPOSE.  See the GNU General Public License for
# more details.

%YAML 1.2
---
$id: http://devicetree.org/schemas/hda@88090b0000/nvidia,tegra264-hda.yaml#
$schema: http://devicetree.org/meta-schemas/core.yaml#

title: Nvidia Tegra T264 HDA Driver

maintainers:
  - Mohan Kumar

description: |
     The following nodes use this compatibility
        - /bus@0/hda@88090b0000

select:
  properties:
    compatible:
        minItems: 1
        maxItems: 1
        items:
            enum:
                - nvidia,tegra264-hda

  required:
    - compatible

properties:

    reg:
        $ref: "/schemas/types.yaml#/definitions/uint32-matrix"
        description: |
            Registers are given by a tuple of two values:
                - register address:
                - register block size.
        items:
            minItems: 4
            maxItems: 4
            items:
                - $ref: "/schemas/types.yaml#/definitions/uint32"
                  minimum: 0x88
                  maximum: 0x88
                - $ref: "/schemas/types.yaml#/definitions/uint32"
                  minimum: 0x90b0000
                  maximum: 0x90b0000
                - $ref: "/schemas/types.yaml#/definitions/uint32"
                  minimum: 0x0
                  maximum: 0x0
                - $ref: "/schemas/types.yaml#/definitions/uint32"
                  minimum: 0x10000
                  maximum: 0x10000

    interrupts:
        $ref: "/schemas/types.yaml#/definitions/uint32-matrix"
        description: |
            Interrupts are give by a tuple of 3 values:
                - interrupt specifier (GIC_SPI = 0, GIC_PPI = 1)
                  definitions in dt-bindings/interrupt-controller/arm-gic.h
                - interrupt number
                - trigger type (rising edge, falling edge, both, etc)
                  definitions in dt-bindings/interrupt-controller/irq.h
        items:
            items:
                - $ref: "/schemas/types.yaml#/definitions/uint32"
                  minimum: 0x0
                  maximum: 0x0
                - $ref: "/schemas/types.yaml#/definitions/uint32"
                  minimum: 0xfb
                  maximum: 0xfb
                - $ref: "/schemas/types.yaml#/definitions/uint32"
                  minimum: 0x4
                  maximum: 0x4

    clocks:
        $ref: "/schemas/types.yaml#/definitions/uint32-matrix"
        description: |
            Clocks are given by a tuple of 2 values:
                - Phandle to the device
                - Clock ID
        items:
            minItems: 2
            maxItems: 2
            items:
                - $ref: "/schemas/types.yaml#/definitions/uint32"
                - $ref: "/schemas/types.yaml#/definitions/uint32"
                  minimum: 0x8f
                  maximum: 0x8f

    clock-names:
        $ref: "/schemas/types.yaml#/definitions/string-array"
        items:
            enum:
                - hda


    interconnects:
        $ref: "/schemas/types.yaml#/definitions/uint32-matrix"
        items:
            minItems: 3
            maxItems: 3
            items:
                - $ref: "/schemas/types.yaml#/definitions/uint32"
                - $ref: "/schemas/types.yaml#/definitions/uint32"
                  minimum: 0x17c
                  maximum: 0x17d
                - $ref: "/schemas/types.yaml#/definitions/uint32"

    interconnect-names:
        $ref: "/schemas/types.yaml#/definitions/string-array"
        items:
            enum:
                - dma-mem
                - write


    iommus:
        $ref: "/schemas/types.yaml#/definitions/uint32-matrix"
        description: |
            iommus are given by a tuple of 2 values:
                - Phandle to the device
                - Device ID
        items:
            minItems: 2
            maxItems: 2
            items:
                - $ref: "/schemas/types.yaml#/definitions/uint32"
                - $ref: "/schemas/types.yaml#/definitions/uint32"
                  minimum: 0xa00
                  maximum: 0xa00

required:
    - compatible
    - reg
    - interrupts
    - clocks
    - clock-names
    - iommus

examples:
    - |
        hda@88090b0000 {
            compatible = "nvidia,tegra264-hda";
            reg = <0x88 0x90b0000 0x0 0x10000>;
            interrupts = <GIC_SPI 251 IRQ_TYPE_LEVEL_HIGH>;
            clocks = <&bpmp TEGRA264_CLK_AZA_2XBIT>;
            clock-names = "hda";
            interconnects = <&mc TEGRA264_MEMORY_CLIENT_HDAR &emc>,
                            <&mc TEGRA264_MEMORY_CLIENT_HDAW &emc>;
            interconnect-names = "dma-mem, write";
            iommus = <&smmu3_mmu TEGRA_SID_HDA>;
            status = "disabled";
        };
```

## source/nvidia-oot/Documentation/devicetree/bindings/misc/nvidia,tegra264-isp-thi.yaml
```yaml
# Copyright (c) 2024, NVIDIA CORPORATION & AFFILIATES.  All rights reserved.
#
# This program is free software; you can redistribute it and/or modify it
# under the terms and conditions of the GNU General Public License,
# version 2, as published by the Free Software Foundation.
#
# This program is distributed in the hope it will be useful, but WITHOUT
# ANY WARRANTY; without even the implied warranty of MERCHANTABILITY or
# FITNESS FOR A PARTICULAR PURPOSE.  See the GNU General Public License for
# more details.

%YAML 1.2
---
$id: http://devicetree.org/schemas/isp-thi@8188b00000/nvidia,tegra264-isp-thi.yaml#
$schema: http://devicetree.org/meta-schemas/core.yaml#

title: Nvidia Tegra t264 ISP-THI

maintainers:
  - Chinniah Poosapadi

select:
  properties:
    compatible:
        minItems: 1
        maxItems: 1
        items:
            enum:
                - nvidia,tegra264-isp-thi

  required:
    - compatible

properties:

    compatible:
        minItems: 1
        maxItems: 1
        items:
            enum:
                - nvidia,tegra264-isp-thi

    resets:
        $ref: "/schemas/types.yaml#/definitions/uint32-matrix"
        description: |
            Resets are given by a tuple of 2 values:
                - Phandle to the device
                - Reset ID
        items:
            minItems: 2
            maxItems: 2
            items:
                - $ref: "/schemas/types.yaml#/definitions/uint32"
                - $ref: "/schemas/types.yaml#/definitions/uint32"
                  minimum: 0x37
                  maximum: 0x37

    reset-names:
        $ref: "/schemas/types.yaml#/definitions/string-array"
        items:
            enum:
                - isp_thi
                - isp1_thi


required:
    - compatible
    - resets
    - reset-names

examples:
    - |
        isp-thi@8188b00000 {
            compatible = "nvidia,tegra264-isp-thi";
            resets = <&bpmp TEGRA264_RESET_ISP1>;
            reset-names = "isp_thi";
            status = "disabled";
        };
```

## source/nvidia-oot/Documentation/devicetree/bindings/misc/nvidia,tegra264-mixer-control.yaml
```yaml
# Copyright (c) 2024, NVIDIA CORPORATION & AFFILIATES.  All rights reserved.
#
# This program is free software; you can redistribute it and/or modify it
# under the terms and conditions of the GNU General Public License,
# version 2, as published by the Free Software Foundation.
#
# This program is distributed in the hope it will be useful, but WITHOUT
# ANY WARRANTY; without even the implied warranty of MERCHANTABILITY or
# FITNESS FOR A PARTICULAR PURPOSE.  See the GNU General Public License for
# more details.

%YAML 1.2
---
$id: http://devicetree.org/schemas/mixer-controls/nvidia,tegra264-mixer-control.yaml#
$schema: http://devicetree.org/meta-schemas/core.yaml#

title: Nvidia Tegra t264 Audio Mixer

maintainers:
  - Mohan Kumar

description: |
     The following nodes use this compatibility
        - /sound/mixer-controls

select:
  properties:
    compatible:
        minItems: 2
        maxItems: 2
        items:
            enum:
                - nvidia,tegra264-mixer-control
                - nvidia,tegra234-mixer-control

  required:
    - compatible

properties:

required:
    - compatible

examples:
    - |
        mixer-controls {
            compatible = "nvidia,tegra264-mixer-control",
                         "nvidia,tegra234-mixer-control";
        };
```
