## source/nvidia-oot/Documentation/devicetree/bindings/net/nvidia,tegra-hv-net.yaml
```yaml
# SPDX-FileCopyrightText: Copyright (c) 2025 NVIDIA CORPORATION & AFFILIATES. All rights reserved.
# SPDX-License-Identifier: GPL-2.0-only OR BSD-2-Clause

Tegra HV Net Kernel Driver

The tegra_hv_net kernel driver provides Inter-VM based networking.

Required properties:
--------------------
- compatible: should be nvidia,tegra-hv-net
- status: property is used to enable or disable the interface
- ivc: property links to the queue entry made in PCT platform_config.h
       here the second element should be the index of the IVC queue declared in .queues field
- carrier-retry-delay-msecs: Delay in milliseconds between attempts to restore
                             network carrier when IVC write channel becomes unavailable.
                             When the hypervisor IVC channel cannot accept writes
                             (e.g., peer VM restart, channel reset), the driver will retry
                             checking channel availability after this delay.
                             Default is 1000ms if not specified.

Example:
--------
	tegra_hv_net@0 {
		compatible = "nvidia,tegra-hv-net";
		status = "okay";
		ivc = <&tegra_hv 410>;
                carrier-retry-delay-msecs = <2000>; /* 2 seconds */
	};

This sets the hv0 interface backed by IVC queue 410.
```

## source/nvidia-oot/Documentation/devicetree/bindings/nvpmodel/nvpmodel-emc-cap.yaml
```yaml
# SPDX-License-Identifier: GPL-2.0-only OR BSD-2-Clause
# Copyright (c) 2022, NVIDIA CORPORATION & AFFILIATES. All rights reserved.
%YAML 1.2
---
$id: http://devicetree.org/schemas/nvpmodel/nvpmodel-emc-cap.yaml#
$schema: http://devicetree.org/meta-schemas/core.yaml#

title: NVIDIA nvpmodel driver for emc clock cap

maintainers:
  - Johnny Liu <johnliu@nvidia.com>

description: |
  Nvpmodel is a driver that provides sysfs nodes that allow capping certain clock
  frequencies in order to keep the power consumption under a certain budget.

  These caps are designed to be relatively static. They should not be used
  during runtime (under load) to dynamically change the power budget

properties:
  compatible:
    enum:
      - nvidia,nvpmodel-emc-cap

required:
  - compatible

examples:
  - |
    nvpmodel: {
      compatible = "nvidia,nvpmodel-emc-cap";
      status = "okay";
    };
...
```

## source/nvidia-oot/Documentation/devicetree/bindings/nvpps/nvidia,tegra264-nvpps.yaml
```yaml
# Copyright (c) 2024, NVIDIA CORPORATION & AFFILIATES.  All rights reserved.
#
# This program is free software; you can redistribute it and/or modify it
# under the terms and conditions of the GNU General Public License,
# version 2, as published by the Free Software Foundation.
#
# This program is distributed in the hope it will be useful, but WITHOUT
# ANY WARRANTY; without even the implied warranty of MERCHANTABILITY or
# FITNESS FOR A PARTICULAR PURPOSE.  See the GNU General Public License for
# more details.

%YAML 1.2
---
$id: http://devicetree.org/schemas/nvpps/nvidia,tegra264-nvpps.yaml#
$schema: http://devicetree.org/meta-schemas/core.yaml#

title: NVidia Tegra PPS Driver

maintainers:
  - Vijay Mishra

description: |
     the compatability = nvidia,tegra264-nvpps is mentioned in the following drivers
        - <TOP>/kernel/nvidia-oot/drivers/nvpps/nvpps_main.c

     The following nodes use this compatibility
        - /nvpps

select:
  properties:
    compatible:
        minItems: 1
        maxItems: 1
        items:
            enum:
                - nvidia,tegra264-nvpps
  required:
    - compatible

properties:

    '#address-cells':
        $ref: "/schemas/types.yaml#/definitions/uint32"
        minimum: 0x1
        maximum: 0x1

    '#size-cells':
        $ref: "/schemas/types.yaml#/definitions/uint32"
        minimum: 0x1
        maximum: 0x1

    reg:
        $ref: "/schemas/types.yaml#/definitions/uint32-matrix"
        description: |
            Registers are given by a tuple of two values:
                - register address:
                - register block size.
        items:
            minItems: 4
            maxItems: 4
            items:
                - $ref: "/schemas/types.yaml#/definitions/uint32"
                  minimum: 0x0
                  maximum: 0xc230000

    primary-emac:
        $ref: "/schemas/types.yaml#/definitions/uint32"
        minimum: 0x83
        maximum: 0x83

    sec-emac:
        $ref: "/schemas/types.yaml#/definitions/uint32"
        minimum: 0x84
        maximum: 0x84

required:
    - compatible
    - reg

examples:
    - |
        nvpps {
        };
```

## source/nvidia-oot/Documentation/devicetree/bindings/of/ramoops.yaml
```yaml
# Copyright (c) 2024, NVIDIA CORPORATION & AFFILIATES.  All rights reserved.
#
# This program is free software; you can redistribute it and/or modify it
# under the terms and conditions of the GNU General Public License,
# version 2, as published by the Free Software Foundation.
#
# This program is distributed in the hope it will be useful, but WITHOUT
# ANY WARRANTY; without even the implied warranty of MERCHANTABILITY or
# FITNESS FOR A PARTICULAR PURPOSE.  See the GNU General Public License for
# more details.

%YAML 1.2
---
$id: http://devicetree.org/schemas/ramoops_carveout/ramoops.yaml#
$schema: http://devicetree.org/meta-schemas/core.yaml#

title: Ramoops

maintainers:
  - Pritesh Raithatha

description: |
     the compatability = ramoops is mentioned in the following drivers
        - <TOP>/kernel/kernel-oot/drivers/of/platform.c
        - <TOP>/kernel/kernel-oot/drivers/platform/chrome/chromeos_pstore.c

     The following nodes use this compatibility
        - /reserved-memory/ramoops_carveout

select:
  properties:
    compatible:
        minItems: 1
        maxItems: 1
        items:
            enum:
                - ramoops

  required:
    - compatible

properties:

    size:
        $ref: "/schemas/types.yaml#/definitions/uint32-matrix"
        items:
            minItems: 2
            maxItems: 2
            items:
                - $ref: "/schemas/types.yaml#/definitions/uint32"
                  minimum: 0x0
                  maximum: 0x0
                - $ref: "/schemas/types.yaml#/definitions/uint32"
                  minimum: 0x200000
                  maximum: 0x200000

    record-size:
        $ref: "/schemas/types.yaml#/definitions/uint32"
        minimum: 0x10000
        maximum: 0x10000

    console-size:
        $ref: "/schemas/types.yaml#/definitions/uint32"
        minimum: 0x80000
        maximum: 0x80000

    alignment:
        $ref: "/schemas/types.yaml#/definitions/uint32-matrix"
        items:
            minItems: 2
            maxItems: 2
            items:
                - $ref: "/schemas/types.yaml#/definitions/uint32"
                  minimum: 0x0
                  maximum: 0x0
                - $ref: "/schemas/types.yaml#/definitions/uint32"
                  minimum: 0x10000
                  maximum: 0x10000

    alloc-ranges:
        $ref: "/schemas/types.yaml#/definitions/uint32-matrix"
        items:
            minItems: 4
            maxItems: 4
            items:
                - $ref: "/schemas/types.yaml#/definitions/uint32"
                  minimum: 0x0
                  maximum: 0x0
                - $ref: "/schemas/types.yaml#/definitions/uint32"
                  minimum: 0x0
                  maximum: 0x0
                - $ref: "/schemas/types.yaml#/definitions/uint32"
                  minimum: 0x1
                  maximum: 0x1
                - $ref: "/schemas/types.yaml#/definitions/uint32"
                  minimum: 0x0
                  maximum: 0x0

    no-map:
        $ref: "/schemas/types.yaml#/definitions/flag"

required:
    - compatible

examples:
    - |
        ramoops_carveout {
            compatible = "ramoops";
            status = "disabled";
            size = <0x0 0x200000>;
            record-size = <0x00010000>;
            console-size = <0x00080000>;
            alignment = <0x0 0x10000>;
            alloc-ranges = <0x0 0x0 0x1 0x0>;
            no-map;
        };
```

## source/nvidia-oot/Documentation/devicetree/bindings/of/shared-dma-pool.yaml
```yaml
# Copyright (c) 2024, NVIDIA CORPORATION & AFFILIATES.  All rights reserved.
#
# This program is free software; you can redistribute it and/or modify it
# under the terms and conditions of the GNU General Public License,
# version 2, as published by the Free Software Foundation.
#
# This program is distributed in the hope it will be useful, but WITHOUT
# ANY WARRANTY; without even the implied warranty of MERCHANTABILITY or
# FITNESS FOR A PARTICULAR PURPOSE.  See the GNU General Public License for
# more details.

%YAML 1.2
---
$id: http://devicetree.org/schemas/linux,cma/shared-dma-pool.yaml#
$schema: http://devicetree.org/meta-schemas/core.yaml#

title:  DMA-mapping operations based on reserved memory region

maintainers:
  - Pritesh Raithatha
  - Ketan Patil

description: |
     the compatability = shared-dma-pool is mentioned in the following drivers
        - <TOP>/kernel/kernel-oot/drivers/of/of_reserved_mem.c

     The following nodes use this compatibility
        - /reserved-memory/linux,cma

select:
  properties:
    compatible:
        minItems: 1
        maxItems: 1
        items:
            enum:
                - shared-dma-pool

  required:
    - compatible

properties:

    reusable:
        $ref: "/schemas/types.yaml#/definitions/flag"

    size:
        $ref: "/schemas/types.yaml#/definitions/uint32-matrix"
        items:
            minItems: 2
            maxItems: 2
            items:
                - $ref: "/schemas/types.yaml#/definitions/uint32"
                  minimum: 0x0
                  maximum: 0x0
                - $ref: "/schemas/types.yaml#/definitions/uint32"
                  minimum: 0x4000000
                  maximum: 0x4000000

    alignment:
        $ref: "/schemas/types.yaml#/definitions/uint32-matrix"
        items:
            minItems: 2
            maxItems: 2
            items:
                - $ref: "/schemas/types.yaml#/definitions/uint32"
                  minimum: 0x0
                  maximum: 0x0
                - $ref: "/schemas/types.yaml#/definitions/uint32"
                  minimum: 0x10000
                  maximum: 0x10000

    linux,cma-default:
        $ref: "/schemas/types.yaml#/definitions/flag"

required:
    - compatible

examples:
    - |
        linux,cma {
            compatible = "shared-dma-pool";
            status = "disabled";
            reusable;
            size = <0x0 0x4000000>;
            alignment = <0x0 0x10000>;
            linux,cma-default;
        };
```
