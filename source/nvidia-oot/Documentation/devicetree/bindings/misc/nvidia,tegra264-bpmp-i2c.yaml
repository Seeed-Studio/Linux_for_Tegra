## source/nvidia-oot/Documentation/devicetree/bindings/platform/tegra/mc-utils/nvidia,tegra264-mc.yaml
```yaml
# Copyright (c) 2024, NVIDIA CORPORATION & AFFILIATES.  All rights reserved.
#
# This program is free software; you can redistribute it and/or modify it
# under the terms and conditions of the GNU General Public License,
# version 2, as published by the Free Software Foundation.
#
# This program is distributed in the hope it will be useful, but WITHOUT
# ANY WARRANTY; without even the implied warranty of MERCHANTABILITY or
# FITNESS FOR A PARTICULAR PURPOSE.  See the GNU General Public License for
# more details.

%YAML 1.2
---
$id: http://devicetree.org/schemas/memory-controller@8108020000/nvidia,tegra264-mc.yaml#
$schema: http://devicetree.org/meta-schemas/core.yaml#

title: MC utility provider module

maintainers:
  - Ashish Mhetre

description: |
     the compatability = nvidia,tegra264-mc is mentioned in the following drivers
        - <TOP>/kernel/nvidia-oot/drivers/platform/tegra/mc-utils/mc-utils.c

     The following nodes use this compatibility
        - /bus@0/memory-controller@8108020000

select:
  properties:
    compatible:
        minItems: 2
        maxItems: 2
        items:
            enum:
                - nvidia,tegra264-mc
                - nvidia,tegra234-mc

  required:
    - compatible

properties:

    reg:
        $ref: "/schemas/types.yaml#/definitions/uint32-matrix"
        description: |
            Registers are given by a tuple of two values:
                - register address:
                - register block size.
        items:
            minItems: 4
            maxItems: 4
            items:
                - $ref: "/schemas/types.yaml#/definitions/uint32"
                  minimum: 0x81
                  maximum: 0x81
                - $ref: "/schemas/types.yaml#/definitions/uint32"
                  minimum: 0x8020000
                  maximum: 0x8220000
                - $ref: "/schemas/types.yaml#/definitions/uint32"
                  minimum: 0x0
                  maximum: 0x0
                - $ref: "/schemas/types.yaml#/definitions/uint32"
                  minimum: 0x20000
                  maximum: 0x20000

    reg-names:
        $ref: "/schemas/types.yaml#/definitions/string-array"
        items:
            enum:
                - broadcast
                - ch0
                - ch1
                - ch2
                - ch3
                - ch4
                - ch5
                - ch6
                - ch7
                - ch8
                - ch9
                - ch10
                - ch11
                - ch12
                - ch13
                - ch14
                - ch15


    interrupts:
        $ref: "/schemas/types.yaml#/definitions/uint32-matrix"
        description: |
            Interrupts are give by a tuple of 3 values:
                - interrupt specifier (GIC_SPI = 0, GIC_PPI = 1)
                  definitions in dt-bindings/interrupt-controller/arm-gic.h
                - interrupt number
                - trigger type (rising edge, falling edge, both, etc)
                  definitions in dt-bindings/interrupt-controller/irq.h
        items:
            items:
                - $ref: "/schemas/types.yaml#/definitions/uint32"
                  minimum: 0x0
                  maximum: 0x0
                - $ref: "/schemas/types.yaml#/definitions/uint32"
                  minimum: 0x8b
                  maximum: 0x387
                - $ref: "/schemas/types.yaml#/definitions/uint32"
                  minimum: 0x4
                  maximum: 0x4

    '#interconnect-cells':
        $ref: "/schemas/types.yaml#/definitions/uint32"
        minimum: 0x1
        maximum: 0x1

    '#address-cells':
        $ref: "/schemas/types.yaml#/definitions/uint32"
        minimum: 0x2
        maximum: 0x2

    '#size-cells':
        $ref: "/schemas/types.yaml#/definitions/uint32"
        minimum: 0x2
        maximum: 0x2

    dma-ranges:
        $ref: "/schemas/types.yaml#/definitions/uint32-matrix"
        items:
            minItems: 6
            maxItems: 6
            items:
                - $ref: "/schemas/types.yaml#/definitions/uint32"
                  minimum: 0x0
                  maximum: 0x0
                - $ref: "/schemas/types.yaml#/definitions/uint32"
                  minimum: 0x0
                  maximum: 0x0
                - $ref: "/schemas/types.yaml#/definitions/uint32"
                  minimum: 0x0
                  maximum: 0x0
                - $ref: "/schemas/types.yaml#/definitions/uint32"
                  minimum: 0x0
                  maximum: 0x0
                - $ref: "/schemas/types.yaml#/definitions/uint32"
                  minimum: 0x100
                  maximum: 0x100
                - $ref: "/schemas/types.yaml#/definitions/uint32"
                  minimum: 0x0
                  maximum: 0x0

    numa-node-id:
        $ref: "/schemas/types.yaml#/definitions/uint32"
        minimum: 0x0
        maximum: 0x0

required:
    - compatible
    - reg
    - interrupts

examples:
    - |
        memory-controller@8108020000 {
            compatible = "nvidia,tegra264-mc",
                         "nvidia,tegra234-mc";
            status = "disabled";
            reg = <0x81 0x08020000 0x0 0x20000>,
                  <0x81 0x08040000 0x0 0x20000>,
                  <0x81 0x08060000 0x0 0x20000>,
                  <0x81 0x08080000 0x0 0x20000>,
                  <0x81 0x080a0000 0x0 0x20000>,
                  <0x81 0x080c0000 0x0 0x20000>,
                  <0x81 0x080e0000 0x0 0x20000>,
                  <0x81 0x08100000 0x0 0x20000>,
                  <0x81 0x08120000 0x0 0x20000>,
                  <0x81 0x08140000 0x0 0x20000>,
                  <0x81 0x08160000 0x0 0x20000>,
                  <0x81 0x08180000 0x0 0x20000>,
                  <0x81 0x081a0000 0x0 0x20000>,
                  <0x81 0x081c0000 0x0 0x20000>,
                  <0x81 0x081e0000 0x0 0x20000>,
                  <0x81 0x08200000 0x0 0x20000>,
                  <0x81 0x08220000 0x0 0x20000>;
            reg-names = "broadcast, ch0, ch1, ch2, ch3",
                        "ch4, ch5, ch6, ch7, ch8, ch9, ch10",
                        "ch11, ch12, ch13, ch14, ch15";
            interrupts = <GIC_SPI 139 IRQ_TYPE_LEVEL_HIGH>,
                         <GIC_SPI 255 IRQ_TYPE_LEVEL_HIGH>,
                         <GIC_SPI 402 IRQ_TYPE_LEVEL_HIGH>,
                         <GIC_SPI 694 IRQ_TYPE_LEVEL_HIGH>,
                         <GIC_SPI 903 IRQ_TYPE_LEVEL_HIGH>,
                         <GIC_SPI 148 IRQ_TYPE_LEVEL_HIGH>,
                         <GIC_SPI 401 IRQ_TYPE_LEVEL_HIGH>,
                         <GIC_SPI 142 IRQ_TYPE_LEVEL_HIGH>;
            #interconnect-cells = <1>;
            #address-cells = <2>;
            #size-cells = <2>;
            ranges = <0x81 0x08020000 0x81 0x08020000 0x0 0x20000>,
                     <0x81 0x08040000 0x81 0x08040000 0x0 0x20000>,
                     <0x81 0x080c0000 0x81 0x080c0000 0x0 0x20000>;
            dma-ranges = <0x0 0x0 0x0 0x0 0x100 0x0>;
            numa-node-id = <0x0>;
        };
```

## source/nvidia-oot/Documentation/devicetree/bindings/platform/tegra/nvidia,tegra234-epl-client.yaml
```yaml
# Copyright (c) 2024, NVIDIA CORPORATION & AFFILIATES.  All rights reserved.
#
# This program is free software; you can redistribute it and/or modify it
# under the terms and conditions of the GNU General Public License,
# version 2, as published by the Free Software Foundation.
#
# This program is distributed in the hope it will be useful, but WITHOUT
# ANY WARRANTY; without even the implied warranty of MERCHANTABILITY or
# FITNESS FOR A PARTICULAR PURPOSE.  See the GNU General Public License for
# more details.

%YAML 1.2
---
$id: http://devicetree.org/schemas/safetyservices_epl_client@110000/nvidia,tegra234-epl-client.yaml#
$schema: http://devicetree.org/meta-schemas/core.yaml#

title: Tegra Error Propagation Library driver

maintainers:
  - Rahul Bedarkar

description: |
     the compatability = nvidia,tegra234-epl-client is mentioned in the following drivers
        - <TOP>/kernel/kernel-oot/drivers/platform/tegra/tegra-epl.c

     The following nodes use this compatibility
        - /safetyservices_epl_client@110000

select:
  properties:
    compatible:
        minItems: 1
        maxItems: 1
        items:
            enum:
                - nvidia,tegra234-epl-client

  required:
    - compatible

properties:

    mboxes:
        $ref: "/schemas/types.yaml#/definitions/uint32-matrix"
        items:
            minItems: 3
            maxItems: 3
            items:
                - $ref: "/schemas/types.yaml#/definitions/uint32"
                - $ref: "/schemas/types.yaml#/definitions/uint32"
                  minimum: 0x101
                  maximum: 0x101
                - $ref: "/schemas/types.yaml#/definitions/uint32"
                  minimum: 0x80000000
                  maximum: 0x80000000

    mbox-names:
        $ref: "/schemas/types.yaml#/definitions/string-array"
        items:
            enum:
                - epl-tx


    handshake-retry-count:
        $ref: "/schemas/types.yaml#/definitions/uint32"
        minimum: 0xc8
        maximum: 0xc8

    reg:
        $ref: "/schemas/types.yaml#/definitions/uint32-matrix"
        description: |
            Registers are given by a tuple of two values:
                - register address:
                - register block size.
        items:
            minItems: 4
            maxItems: 4
            items:
                - $ref: "/schemas/types.yaml#/definitions/uint32"
                  minimum: 0x0
                  maximum: 0x0
                - $ref: "/schemas/types.yaml#/definitions/uint32"
                  minimum: 0x110000
                  maximum: 0x170038
                - $ref: "/schemas/types.yaml#/definitions/uint32"
                  minimum: 0x0
                  maximum: 0x0
                - $ref: "/schemas/types.yaml#/definitions/uint32"
                  minimum: 0x4
                  maximum: 0x4

    client-misc-sw-generic-err0:
        $ref: "/schemas/types.yaml#/definitions/string-array"
        items:
            enum:
                - nvgpu


    client-misc-sw-generic-err1:
        $ref: "/schemas/types.yaml#/definitions/string-array"
        items:
            enum:
                - gk20b


    client-misc-sw-generic-err3:
        $ref: "/schemas/types.yaml#/definitions/string-array"
        items:
            enum:
                - gk20d


    client-misc-sw-generic-err4:
        $ref: "/schemas/types.yaml#/definitions/string-array"
        items:
            enum:
                - gk20e


required:
    - compatible
    - reg

examples:
    - |
        safetyservices_epl_client@110000 {
            compatible = "nvidia,tegra234-epl-client";
            mboxes = <&top_hsp3 TEGRA_HSP_MBOX_TYPE_SM_128BIT TEGRA_HSP_SM_TX(0)>;
            mbox-names = "epl-tx";
            handshake-retry-count = < 200 >;
            reg = <0x0 0x00110000 0x0 0x4>,
                  <0x0 0x00110004 0x0 0x4>,
                  <0x0 0x00120000 0x0 0x4>,
                  <0x0 0x00120004 0x0 0x4>,
                  <0x0 0x00130000 0x0 0x4>,
                  <0x0 0x00130004 0x0 0x4>,
                  <0x0 0x00140000 0x0 0x4>,
                  <0x0 0x00140004 0x0 0x4>,
                  <0x0 0x00150000 0x0 0x4>,
                  <0x0 0x00150004 0x0 0x4>,
                  <0x0 0x00170038 0x0 0x4>;
            client-misc-sw-generic-err0 = "fsicom_client";
            client-misc-sw-generic-err1 = "gk20b";
            client-misc-sw-generic-err3 = "gk20d";
            client-misc-sw-generic-err4 = "gk20e";
            enable-deinit-notify;
            status = "disabled";
        };
```

## source/nvidia-oot/Documentation/devicetree/bindings/platform/tegra/nvidia,tegra23x-hsierrrptinj.yaml
```yaml
# Copyright (c) 2024, NVIDIA CORPORATION & AFFILIATES.  All rights reserved.
#
# This program is free software; you can redistribute it and/or modify it
# under the terms and conditions of the GNU General Public License,
# version 2, as published by the Free Software Foundation.
#
# This program is distributed in the hope it will be useful, but WITHOUT
# ANY WARRANTY; without even the implied warranty of MERCHANTABILITY or
# FITNESS FOR A PARTICULAR PURPOSE.  See the GNU General Public License for
# more details.

%YAML 1.2
---
$id: http://devicetree.org/schemas/hsierrrptinj/nvidia,tegra23x-hsierrrptinj.yaml#
$schema: http://devicetree.org/meta-schemas/core.yaml#

title: Tegra HSI Error Report Injection driver

maintainers:
  - Harshraj Rao

description: |
     the compatability = nvidia,tegra23x-hsierrrptinj is mentioned in the following drivers
        - <TOP>/kernel/kernel-oot/drivers/platform/tegra/tegra-hsierrrptinj.c

     The following nodes use this compatibility
        - /hsierrrptinj

select:
  properties:
    compatible:
        minItems: 1
        maxItems: 1
        items:
            enum:
                - nvidia,tegra23x-hsierrrptinj

  required:
    - compatible

properties:

    mboxes:
        $ref: "/schemas/types.yaml#/definitions/uint32-matrix"
        items:
            minItems: 3
            maxItems: 3
            items:
                - $ref: "/schemas/types.yaml#/definitions/uint32"
                - $ref: "/schemas/types.yaml#/definitions/uint32"
                  minimum: 0x101
                  maximum: 0x101
                - $ref: "/schemas/types.yaml#/definitions/uint32"
                  minimum: 0x80000001
                  maximum: 0x80000001

    mbox-names:
        $ref: "/schemas/types.yaml#/definitions/string-array"
        items:
            enum:
                - hsierrrptinj-tx


required:
    - compatible

examples:
    - |
        hsierrrptinj {
            compatible = "nvidia,tegra23x-hsierrrptinj";
            mboxes = <&top_hsp0 (TEGRA_HSP_MBOX_TYPE_SM|TEGRA_HSP_MBOX_TYPE_SM_128BIT) TEGRA_HSP_SM_TX(1)>;
            mbox-names = "hsierrrptinj-tx";
            status = "disabled";
        };
```
