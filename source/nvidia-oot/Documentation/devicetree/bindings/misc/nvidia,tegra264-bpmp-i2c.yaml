## source/nvidia-oot/Documentation/devicetree/bindings/platform/tegra/nvidia,tegra264-cactmon-mc-all.yaml
```yaml
# Copyright (c) 2024, NVIDIA CORPORATION & AFFILIATES.  All rights reserved.
#
# This program is free software; you can redistribute it and/or modify it
# under the terms and conditions of the GNU General Public License,
# version 2, as published by the Free Software Foundation.
#
# This program is distributed in the hope it will be useful, but WITHOUT
# ANY WARRANTY; without even the implied warranty of MERCHANTABILITY or
# FITNESS FOR A PARTICULAR PURPOSE.  See the GNU General Public License for
# more details.

%YAML 1.2
---
$id: http://devicetree.org/schemas/actmon@d3f0000/nvidia,tegra264-cactmon-mc-all.yaml#
$schema: http://devicetree.org/meta-schemas/core.yaml#

title: Tegra MC_ALL Central Activity Monitor

maintainers:
  - Johnny Liu

description: |
     the compatability = nvidia,tegra264-cactmon-mc-all is mentioned in the following drivers
        - <TOP>/kernel/nvidia-oot/drivers/platform/tegra/tegra-cactmon-mc-all.c

     The following nodes use this compatibility
        - /bus@0/actmon@d3f0000

select:
  properties:
    compatible:
        minItems: 1
        maxItems: 1
        items:
            enum:
                - nvidia,tegra264-cactmon-mc-all

  required:
    - compatible

properties:

    reg:
        $ref: "/schemas/types.yaml#/definitions/uint32-matrix"
        description: |
            Registers are given by a tuple of two values:
                - register address:
                - register block size.
        items:
            minItems: 4
            maxItems: 4
            items:
                - $ref: "/schemas/types.yaml#/definitions/uint32"
                  minimum: 0x0
                  maximum: 0x0
                - $ref: "/schemas/types.yaml#/definitions/uint32"
                  minimum: 0xd3f0000
                  maximum: 0xd3f0000
                - $ref: "/schemas/types.yaml#/definitions/uint32"
                  minimum: 0x0
                  maximum: 0x0
                - $ref: "/schemas/types.yaml#/definitions/uint32"
                  minimum: 0x10000
                  maximum: 0x10000

    clocks:
        $ref: "/schemas/types.yaml#/definitions/uint32-matrix"
        description: |
            Clocks are given by a tuple of 2 values:
                - Phandle to the device
                - Clock ID
        items:
            minItems: 2
            maxItems: 2
            items:
                - $ref: "/schemas/types.yaml#/definitions/uint32"
                - $ref: "/schemas/types.yaml#/definitions/uint32"
                  minimum: 0x1
                  maximum: 0x1

    clock-names:
        $ref: "/schemas/types.yaml#/definitions/string-array"
        items:
            enum:
                - actmon


required:
    - compatible
    - reg
    - clocks
    - clock-names

examples:
    - |
        actmon@d3f0000 {
            compatible = "nvidia,tegra264-cactmon-mc-all";
            reg = <0x0 0xd3f0000 0x0 0x10000>;
            clocks = <&bpmp TEGRA264_CLK_OSC>;
            clock-names = "actmon";
            status = "disabled";
        };
```

## source/nvidia-oot/Documentation/devicetree/bindings/platform/tegra/psc/nvidia,tegra234-psc.yaml
```yaml
# Copyright (c) 2024, NVIDIA CORPORATION & AFFILIATES.  All rights reserved.
#
# This program is free software; you can redistribute it and/or modify it
# under the terms and conditions of the GNU General Public License,
# version 2, as published by the Free Software Foundation.
#
# This program is distributed in the hope it will be useful, but WITHOUT
# ANY WARRANTY; without even the implied warranty of MERCHANTABILITY or
# FITNESS FOR A PARTICULAR PURPOSE.  See the GNU General Public License for
# more details.

%YAML 1.2
---
$id: http://devicetree.org/schemas/psc@d8e0000/nvidia,tegra234-psc.yaml#
$schema: http://devicetree.org/meta-schemas/core.yaml#

title: Tegra PSC driver

maintainers:
  - Andy Sobczyk

description: |
     the compatability = nvidia,tegra234-psc is mentioned in the following drivers
        - <TOP>/kernel/nvidia-oot/drivers/platform/tegra/psc/tegra23x_psc_mailbox.c

     The following nodes use this compatibility
        - /bus@0/psc@d8e0000
        - /bus@0/psc@e0e0000
        - /bus@0/psc@e860000

select:
  properties:
    compatible:
        minItems: 1
        maxItems: 1
        items:
            enum:
                - nvidia,tegra234-psc

  required:
    - compatible

properties:

    reg:
        $ref: "/schemas/types.yaml#/definitions/uint32-matrix"
        description: |
            Registers are given by a tuple of two values:
                - register address:
                - register block size.
        items:
            minItems: 4
            maxItems: 4
            items:
                - $ref: "/schemas/types.yaml#/definitions/uint32"
                  minimum: 0x0
                  maximum: 0x0
                - $ref: "/schemas/types.yaml#/definitions/uint32"
                  minimum: 0xd8e0000
                  maximum: 0xe860000
                - $ref: "/schemas/types.yaml#/definitions/uint32"
                  minimum: 0x0
                  maximum: 0x0
                - $ref: "/schemas/types.yaml#/definitions/uint32"
                  minimum: 0x80000
                  maximum: 0x80000
                - $ref: "/schemas/types.yaml#/definitions/uint32"
                  minimum: 0x0
                  maximum: 0x0
                - $ref: "/schemas/types.yaml#/definitions/uint32"
                  minimum: 0xd80205c
                  maximum: 0xe80201c
                - $ref: "/schemas/types.yaml#/definitions/uint32"
                  minimum: 0x0
                  maximum: 0x0
                - $ref: "/schemas/types.yaml#/definitions/uint32"
                  minimum: 0x8
                  maximum: 0x8

    reg-names:
        $ref: "/schemas/types.yaml#/definitions/string-array"
        items:
            enum:
                - mbox-regs
                - extcfg


    interrupts:
        $ref: "/schemas/types.yaml#/definitions/uint32-matrix"
        description: |
            Interrupts are give by a tuple of 3 values:
                - interrupt specifier (GIC_SPI = 0, GIC_PPI = 1)
                  definitions in dt-bindings/interrupt-controller/arm-gic.h
                - interrupt number
                - trigger type (rising edge, falling edge, both, etc)
                  definitions in dt-bindings/interrupt-controller/irq.h
        items:
            items:
                - $ref: "/schemas/types.yaml#/definitions/uint32"
                  minimum: 0x0
                  maximum: 0x0
                - $ref: "/schemas/types.yaml#/definitions/uint32"
                  minimum: 0x2c3
                  maximum: 0x302
                - $ref: "/schemas/types.yaml#/definitions/uint32"
                  minimum: 0x4
                  maximum: 0x4

    nvidia,cpu-name:
        $ref: "/schemas/types.yaml#/definitions/string-array"
        items:
            enum:
                - sb
                - oesp
                - psc


    '#mbox-cells':
        $ref: "/schemas/types.yaml#/definitions/uint32"
        minimum: 0x1
        maximum: 0x1

    mboxes:
        $ref: "/schemas/types.yaml#/definitions/uint32-matrix"
        items:
            minItems: 2
            maxItems: 2
            items:
                - $ref: "/schemas/types.yaml#/definitions/uint32"
                - $ref: "/schemas/types.yaml#/definitions/uint32"
                  minimum: 0x0
                  maximum: 0x0

    nvidia,mailbox-mutex:
        $ref: "/schemas/types.yaml#/definitions/uint32"
        minimum: 0x1
        maximum: 0x1

    nvidia,sidconfig:
        $ref: "/schemas/types.yaml#/definitions/uint32"
        minimum: 0x0
        maximum: 0x0

    iommus:
        $ref: "/schemas/types.yaml#/definitions/uint32-matrix"
        description: |
            iommus are given by a tuple of 2 values:
                - Phandle to the device
                - Device ID
        items:
            minItems: 2
            maxItems: 2
            items:
                - $ref: "/schemas/types.yaml#/definitions/uint32"
                - $ref: "/schemas/types.yaml#/definitions/uint32"
                  minimum: 0x1c00
                  maximum: 0x2400

    nvidia,sidtable:
        $ref: "/schemas/types.yaml#/definitions/uint32"
        minimum: 0x0
        maximum: 0x0

    dma-coherent:
        $ref: "/schemas/types.yaml#/definitions/flag"

    numa-node-id:
        $ref: "/schemas/types.yaml#/definitions/uint32"
        minimum: 0x0
        maximum: 0x0

required:
    - compatible
    - reg
    - interrupts
    - iommus

examples:
    - |
        psc@d8e0000 {
            compatible = "nvidia,tegra234-psc";
            reg = <0x0 0xd8e0000 0x0 0x80000 0x0 0xd80205c 0x0 0x8>;
            reg-names = "mbox-regs, extcfg";
            interrupts = <GIC_SPI 763 IRQ_TYPE_LEVEL_HIGH>,
                         <GIC_SPI 764 IRQ_TYPE_LEVEL_HIGH>,
                         <GIC_SPI 765 IRQ_TYPE_LEVEL_HIGH>,
                         <GIC_SPI 766 IRQ_TYPE_LEVEL_HIGH>,
                         <GIC_SPI 767 IRQ_TYPE_LEVEL_HIGH>,
                         <GIC_SPI 768 IRQ_TYPE_LEVEL_HIGH>,
                         <GIC_SPI 769 IRQ_TYPE_LEVEL_HIGH>,
                         <GIC_SPI 770 IRQ_TYPE_LEVEL_HIGH>;
            nvidia,cpu-name = "sb";
            #mbox-cells = <1>;
            mboxes = <&soc_sb_cluster 0>;
            nvidia,mailbox-mutex = <1>;
            nvidia,sidconfig = <0x0>;
            iommus = <&smmu1_mmu 0x2400>;
            dma-coherent;
            numa-node-id = <0x0>;
            status = "disabled";
        };
```
