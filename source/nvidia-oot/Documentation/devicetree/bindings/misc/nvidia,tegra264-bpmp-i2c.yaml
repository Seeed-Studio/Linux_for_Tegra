## source/nvidia-oot/Documentation/devicetree/bindings/pci/controller/pci-host-ecam-generic.yaml
```yaml
# Copyright (c) 2024, NVIDIA CORPORATION & AFFILIATES.  All rights reserved.
#
# This program is free software; you can redistribute it and/or modify it
# under the terms and conditions of the GNU General Public License,
# version 2, as published by the Free Software Foundation.
#
# This program is distributed in the hope it will be useful, but WITHOUT
# ANY WARRANTY; without even the implied warranty of MERCHANTABILITY or
# FITNESS FOR A PARTICULAR PURPOSE.  See the GNU General Public License for
# more details.

%YAML 1.2
---
$id: http://devicetree.org/schemas/pcie@a8b0000000/pci-host-ecam-generic.yaml#
$schema: http://devicetree.org/meta-schemas/core.yaml#

title: Generic PCI Host Driver

maintainers:
  - Krishna Thota

description: |
     the compatability = pci-host-ecam-generic is mentioned in the following drivers
        - <TOP>/kernel/kernel-oot/drivers/pci/controller/pci-host-generic.c

     The following nodes use this compatibility
        - /bus@0/pcie@a8b0000000
        - /bus@0/pcie@b0b0000000
        - /bus@0/pcie@b8b0000000
        - /bus@0/pcie@c0b0000000
        - /bus@0/pcie@c8b0000000
        - /bus@0/pcie@d0b0000000

select:
  properties:
    compatible:
        minItems: 1
        maxItems: 1
        items:
            enum:
                - pci-host-ecam-generic

  required:
    - compatible

properties:

    reg:
        $ref: "/schemas/types.yaml#/definitions/uint32-matrix"
        description: |
            Registers are given by a tuple of two values:
                - register address:
                - register block size.
        items:
            minItems: 4
            maxItems: 4
            items:
                - $ref: "/schemas/types.yaml#/definitions/uint32"
                  minimum: 0xa8
                  maximum: 0xd0
                - $ref: "/schemas/types.yaml#/definitions/uint32"
                  minimum: 0x8520000
                  maximum: 0xb0000000
                - $ref: "/schemas/types.yaml#/definitions/uint32"
                  minimum: 0x0
                  maximum: 0x0
                - $ref: "/schemas/types.yaml#/definitions/uint32"
                  minimum: 0x10000
                  maximum: 0x10000000

    reg-names:
        $ref: "/schemas/types.yaml#/definitions/string-array"
        items:
            enum:
                - ecam
                - xdma


    '#address-cells':
        $ref: "/schemas/types.yaml#/definitions/uint32"
        minimum: 0x3
        maximum: 0x3

    '#size-cells':
        $ref: "/schemas/types.yaml#/definitions/uint32"
        minimum: 0x2
        maximum: 0x2

    device_type:
        $ref: "/schemas/types.yaml#/definitions/string-array"
        items:
            enum:
                - pci


    linux,pci-domain:
        $ref: "/schemas/types.yaml#/definitions/uint32"
        minimum: 0x0
        maximum: 0x5

    '#interrupt-cells':
        $ref: "/schemas/types.yaml#/definitions/uint32"
        minimum: 0x1
        maximum: 0x1

    interrupt-map-mask:
        $ref: "/schemas/types.yaml#/definitions/uint32-matrix"
        items:
            minItems: 4
            maxItems: 4
            items:
                - $ref: "/schemas/types.yaml#/definitions/uint32"
                  minimum: 0x0
                  maximum: 0x0
                - $ref: "/schemas/types.yaml#/definitions/uint32"
                  minimum: 0x0
                  maximum: 0x0
                - $ref: "/schemas/types.yaml#/definitions/uint32"
                  minimum: 0x0
                  maximum: 0x0
                - $ref: "/schemas/types.yaml#/definitions/uint32"
                  minimum: 0x7
                  maximum: 0x7

    iommu-map:
        $ref: "/schemas/types.yaml#/definitions/uint32-matrix"
        items:
            minItems: 4
            maxItems: 4
            items:
                - $ref: "/schemas/types.yaml#/definitions/uint32"
                  minimum: 0x0
                  maximum: 0x0
                - $ref: "/schemas/types.yaml#/definitions/uint32"
                - $ref: "/schemas/types.yaml#/definitions/uint32"
                  minimum: 0x10000
                  maximum: 0x50000
                - $ref: "/schemas/types.yaml#/definitions/uint32"
                  minimum: 0x10000
                  maximum: 0x10000

    dma-coherent:
        $ref: "/schemas/types.yaml#/definitions/flag"

    msi-map:
        $ref: "/schemas/types.yaml#/definitions/uint32-matrix"
        items:
            minItems: 4
            maxItems: 4
            items:
                - $ref: "/schemas/types.yaml#/definitions/uint32"
                  minimum: 0x0
                  maximum: 0x0
                - $ref: "/schemas/types.yaml#/definitions/uint32"
                - $ref: "/schemas/types.yaml#/definitions/uint32"
                  minimum: 0x110000
                  maximum: 0x210000
                - $ref: "/schemas/types.yaml#/definitions/uint32"
                  minimum: 0x10000
                  maximum: 0x10000

    bus-range:
        $ref: "/schemas/types.yaml#/definitions/uint32-matrix"
        items:
            minItems: 2
            maxItems: 2
            items:
                - $ref: "/schemas/types.yaml#/definitions/uint32"
                  minimum: 0x0
                  maximum: 0x0
                - $ref: "/schemas/types.yaml#/definitions/uint32"
                  minimum: 0xff
                  maximum: 0xff

    numa-node-id:
        $ref: "/schemas/types.yaml#/definitions/uint32"
        minimum: 0x0
        maximum: 0x0

    ats-supported:
        $ref: "/schemas/types.yaml#/definitions/flag"

required:
    - compatible
    - reg

examples:
    - |
        pcie@a8b0000000 {
            status = "disabled";
            compatible = "pci-host-ecam-generic";
            reg = <0xa8 0xb0000000 0x0 0x10000000>;
            reg-names = "ecam";
            #address-cells = <0x3>;
            #size-cells = <0x2>;
            device_type = "pci";
            linux,pci-domain = <0x1>;
            #interrupt-cells = <0x1>;
            interrupt-map-mask = <0x0 0x0 0x0 0x7>;
            interrupt-map = <0x0 0x0 0x0 0x1 &gic 0x0 0x0 GIC_SPI 0x38c IRQ_TYPE_LEVEL_HIGH0x0 0x0 0x0 0x2 &gic 0x0 0x0 GIC_SPI 0x38d IRQ_TYPE_LEVEL_HIGH0x0 0x0 0x0 0x3 &gic 0x0 0x0 GIC_SPI 0x38e IRQ_TYPE_LEVEL_HIGH0x0 0x0 0x0 0x4 &gic 0x0 0x0 GIC_SPI 0x38f IRQ_TYPE_LEVEL_HIGH>;
            iommu-map = <0x0 &smmu1_mmu 0x10000 0x10000>;
            dma-coherent;
            msi-map = <0x0 &its 0x110000 0x10000>;
            bus-range = <0x0 0xff>;
            ranges = <0x82000000 0x00 0x28000000 0x00 0x28000000 0x0 0x080000000xc3000000 0xa8 0xc0000000 0xa8 0xc0000000 0x7 0xc00000000x81000000 0xa8 0x82000000 0xa8 0x82000000 0x0 0x00200000>;
            numa-node-id = <0x0>;
        };
```

## source/nvidia-oot/Documentation/devicetree/bindings/pinctrl/pinctrl-max77851.yaml
```yaml
# SPDX-License-Identifier: GPL-2.0-only
# SPDX-FileCopyrightText: Copyright (c) 2022-2023 NVIDIA CORPORATION & AFFILIATES. All rights reserved.
%YAML 1.2
---
$id: http://devicetree.org/schemas/pinctrl/pinctrl-max77851.yaml#
$schema: http://devicetree.org/meta-schemas/core.yaml#

maintainers:
  - Joan Na<Joan.na@maximintegrated.com>
  - Shubhi Garg <shgarg@nvidia.com>

description: |
  Pincontrol driver for MAX77851 Power management IC from Maxim Semiconductor.

  Device has 8 GPIO pins & 4 FPSO pins which can be configured as GPIO as well as the
  special IO functions.

  Please refer file <devicetree/bindings/pinctrl/pinctrl-bindings.txt>
  for details of the common pinctrl bindings used by client devices,
  including the meaning of the phrase "pin configuration node".

properties:
# Optional Pinmux properties:
# --------------------------
# Following properties are required if default setting of pins are required
# at boot.

  pinctrl-names:
    description:
      A pinctrl state named per <pinctrl-bindings.txt>.

patternProperties:
  pinctrl-[0...n]:
    description:
      Properties to contain the phandle for pinctrl states per
        <pinctrl-bindings.txt>.

The pin configurations are defined as child of the pinctrl states node. Each
sub-node have following properties:

required:
- pins: List of pins. Valid values of pins properties are:
              gpio0, gpio1, gpio2, gpio3, gpio4, gpio5, gpio6, gpio7, fpso0, fpso1, fpso2, fpso3.

additionalProperties:
Following are optional properties defined as pinmux DT binding document
<pinctrl-bindings.txt>. Absence of properties will leave the configuration
on default.
    function,
    drive-push-pull,
    drive-open-drain,
    bias-pull-up,
    bias-pull-down.

Valid values for function properties are:
        gpio-high-z
        gpio-input
        gpio-output
        gpio-fps-digital-input
        gpio-fps-digital-output
        src-enable-digital-input
        src-boot-dvs-digital-input
        src-clock-digital-input
        src-fpwm-digital-input
        src-pok-gpio-digital-output
        clk-32k-out
        lb-alarm-output
        o-type-reset
        test-digital-input
        test-digital-output
        test-analog-in-out

        fpso-high-z
        fpso-digital-output
        fpso-fps-digital-output
        fpso-buck-sense

        nrstio-high-z
        nrstio-digital-input
        nrstio-digital-output
        nrstio-fps-digital-output
        nrstio-lb-digital-output

Theres is also customised properties for the GPIO1, GPIO2 and GPIO3. These
customised properties are required to configure FPS configuration parameters
of these GPIOs. Please refer <devicetree/bindings/mfd/max77851.txt> for more
detail of Flexible Power Sequence (FPS).

- maxim,pd-slpy-master-slot: FPS Master Power-Up / Sleep Exit
- maxim,pu-slpx-master-slot: FPS Master Power-Down / Sleep Entry.
                Valid values are:
                    - MAX77851_FPS_MASTER_SLOT_0
                        FPS Mater is FPS0.
                    - MAX77851_FPS_MASTER_SLOT_1
                        FPS Mater is FPS1
                    - MAX77851_FPS_MASTER_SLOT_2
                        FPS Mater is FPS2
                    - MAX77851_FPS_MASTER_SLOT_3.
                        FPS Mater is FPS2

- maxim,pu-slot:    FPS Power-Up Slot
- maxim,pd-slot:    FPS Power-Down Slot
- maxim,slpx-slot:    FPS Sleep Exit Slot
- maxim,slpy-slot:    FPS Sleep Enter Slot
                Valid values are 0 to F.

examples:
  - |
    #include <dt-bindings/mfd/max77851.h>
    ...
    max77851@3c {

        pinctrl-names = "default";
        pinctrl-0 = <&max77851_default>;

        max77851_default: pinmux@0 {
            pin_gpio0 {
                pins = "gpio0";
                function = "clk-32k-out";
                drive-push-pull = <1>;

                maxim,polarity = <MAX77851_PIN_ACTIVE_HIGH>;
                maxim,input_debounce_filter = <MAX77851_NO_RESYNC_NO_DEB>;
                maxim,input_suppy = <MAX77851_INPUT_VDD>;
            };
            pin_gpio1 {
                pins = "gpio1";
                function = "gpio-fps-digital-output";
                drive-open-drain = <1>;

                maxim,polarity = <MAX77851_PIN_ACTIVE_LOW>;
                maxim,input_debounce_filter = <MAX77851_RESYNC_NO_DEB>;
                maxim,input_suppy = <MAX77851_INPUT_VDD>;

                maxim,pu-slpx-master-slot = <MAX77851_FPS_MASTER_SLOT_1>;
                maxim,pd-slpy-master-slot = <MAX77851_FPS_MASTER_SLOT_1>;
                maxim,pu-slot = <MAX77851_FPS_SLOT_3>;
                maxim,pd-slot = <MAX77851_FPS_SLOT_7>;
                maxim,slpx-slot = <MAX77851_FPS_SLOT_0>;
                maxim,slpy-slot = <MAX77851_FPS_SLOT_1>;
            };
        };
    };
    ...
```

## source/nvidia-oot/Documentation/devicetree/bindings/pinctrl/pinctrl-tegra234-dpaux.yaml
```yaml
# SPDX-License-Identifier: GPL-2.0-only OR BSD-2-Clause
%YAML 1.2
---
$id: http://devicetree.org/schemas/pinctrl/pinctrl-tegra234-dpaux.yaml#
$schema: http://devicetree.org/meta-schemas/core.yaml#

title: NVIDIA Tegra234 DPAUX pin controller

maintainers:
  - Laxman Dewangan <ldewangan@nvidia.com>
  - Prathamesh Shete <pshete@nvidia.com>

description:
  Bindings for NVIDIA Tegra234 DPAUX pin controller

properties:
  compatible:
    const: nvidia,tegra234-misc-dpaux-padctl

  reg:
    maxItems: 1
    description: |
       Base address and size of the DP auxillary pin controller.

required:
  - compatible
  - reg


patternProperties:
  'pinmux-[0-9]*$':
    type: object
    patternProperties:
      '-pins*$':
        type: object
        description: |
          A pinctrl node should contain at least one subnodes representing the
          pinctrl groups available on the machine. Each subnode will list the
          pins it needs, and how they should be configured either in display or i2c mode.
        $ref: "/schemas/pinctrl/pincfg-node.yaml"

        properties:
          function:
            enum: [ i2c, display ]
            description:
              Functionality of the pins.
          pins:
            enum: [ dpaux-0 ]
            description:
              Name of pins.

additionalProperties: false

examples:
  - |
    soc {
        #address-cells = <2>;
        #size-cells = <2>;

        pinctrl@155F0000 {
           compatible = "nvidia,tegra234-misc-dpaux-padctl";
           reg = <0x0 0x155F0000 0x0 0x00040000>;

           dpaux_default: pinmux-0 {
              dpaux0-pins {
                  pins = "dpaux-0";
                  function = "i2c";
              };
           };
        };
     };
...
```
