## Documentation/devicetree/bindings/ras/arm,armv8.yaml
```yaml
# Copyright (c) 2024, NVIDIA CORPORATION & AFFILIATES.  All rights reserved.
#
# This program is free software; you can redistribute it and/or modify it
# under the terms and conditions of the GNU General Public License,
# version 2, as published by the Free Software Foundation.
#
# This program is distributed in the hope it will be useful, but WITHOUT
# ANY WARRANTY; without even the implied warranty of MERCHANTABILITY or
# FITNESS FOR A PARTICULAR PURPOSE.  See the GNU General Public License for
# more details.

%YAML 1.2
---
$id: http://devicetree.org/schemas/cpu@0/arm,armv8.yaml#
$schema: http://devicetree.org/meta-schemas/core.yaml#

title: ARM64 RAS Driver / FHI handler

maintainers:
  - Rich Wiley

description: |
     the compatability = arm,armv8 is mentioned in the following drivers
        - <TOP>/kernel/nvidia-oot/drivers/ras/arm64-ras.c

     The following nodes use this compatibility
        - /cpus/cpu@0
        - /cpus/cpu@1
        - /cpus/cpu@2
        - /cpus/cpu@3
        - /cpus/cpu@4
        - /cpus/cpu@5
        - /cpus/cpu@6
        - /cpus/cpu@7
        - /cpus/cpu@8
        - /cpus/cpu@9
        - /cpus/cpu@10
        - /cpus/cpu@11
        - /cpus/cpu@12
        - /cpus/cpu@13

select:
  properties:
    compatible:
        minItems: 1
        maxItems: 1
        items:
            enum:
                - arm,armv8

  required:
    - compatible

properties:

    device_type:
        $ref: "/schemas/types.yaml#/definitions/string-array"
        items:
            enum:
                - cpu


    reg:
        $ref: "/schemas/types.yaml#/definitions/uint32-matrix"
        description: |
            Registers are given by a tuple of two values:
                - register address:
                - register block size.
        items:
            minItems: 4
            maxItems: 4
            items:
                - $ref: "/schemas/types.yaml#/definitions/uint32"
                  minimum: 0x0
                  maximum: 0x0
                - $ref: "/schemas/types.yaml#/definitions/uint32"
                  minimum: 0x0
                  maximum: 0xd0000

    enable-method:
        $ref: "/schemas/types.yaml#/definitions/string-array"
        items:
            enum:
                - psci


    numa-node-id:
        $ref: "/schemas/types.yaml#/definitions/uint32"
        minimum: 0x0
        maximum: 0x0

    cpu-idle-states:
        $ref: "/schemas/types.yaml#/definitions/uint32"

    i-cache-size:
        $ref: "/schemas/types.yaml#/definitions/uint32"
        minimum: 0x10000
        maximum: 0x10000

    i-cache-line-size:
        $ref: "/schemas/types.yaml#/definitions/uint32"
        minimum: 0x40
        maximum: 0x40

    i-cache-sets:
        $ref: "/schemas/types.yaml#/definitions/uint32"
        minimum: 0x100
        maximum: 0x100

    d-cache-size:
        $ref: "/schemas/types.yaml#/definitions/uint32"
        minimum: 0x10000
        maximum: 0x10000

    d-cache-line-size:
        $ref: "/schemas/types.yaml#/definitions/uint32"
        minimum: 0x40
        maximum: 0x40

    d-cache-sets:
        $ref: "/schemas/types.yaml#/definitions/uint32"
        minimum: 0x100
        maximum: 0x100

    next-level-cache:
        $ref: "/schemas/types.yaml#/definitions/uint32"

required:
    - compatible
    - reg

examples:
    - |
        cpu@0 {
            compatible = "arm,armv8";
            status = "disabled";
            device_type = "cpu";
            reg = <0x0 0x0>;
            enable-method = "psci";
            numa-node-id = <0>;
            cpu-idle-states = <&cc7>;
            i-cache-size = <65536>;
            i-cache-line-size = <64>;
            i-cache-sets = <256>;
            d-cache-size = <65536>;
            d-cache-line-size = <64>;
            d-cache-sets = <256>;
            next-level-cache = <&l2c_0>;
        };
```

## Documentation/devicetree/bindings/soc/tegra/cbb/nvidia,tegra264-sys-cbb-fabric.yaml
```yaml
# Copyright (c) 2024, NVIDIA CORPORATION & AFFILIATES.  All rights reserved.
#
# This program is free software; you can redistribute it and/or modify it
# under the terms and conditions of the GNU General Public License,
# version 2, as published by the Free Software Foundation.
#
# This program is distributed in the hope it will be useful, but WITHOUT
# ANY WARRANTY; without even the implied warranty of MERCHANTABILITY or
# FITNESS FOR A PARTICULAR PURPOSE.  See the GNU General Public License for
# more details.

%YAML 1.2
---
$id: http://devicetree.org/schemas/sys-cbb-fabric@800000/nvidia,tegra264-sys-cbb-fabric.yaml#
$schema: http://devicetree.org/meta-schemas/core.yaml#

title: Control Backbone 2.0 error handling driver for Tegra

maintainers:
  - Sumit Gupta

description: |
     the compatability = nvidia,tegra264-sys-cbb-fabric is mentioned in the following drivers
        - <TOP>/kernel/kernel-oot/drivers/soc/tegra/cbb/tegra234-cbb.c

     The following nodes use this compatibility
        - /bus@0/sys-cbb-fabric@800000

select:
  properties:
    compatible:
        minItems: 1
        maxItems: 1
        items:
            enum:
                - nvidia,tegra264-sys-cbb-fabric

  required:
    - compatible

properties:

    reg:
        $ref: "/schemas/types.yaml#/definitions/uint32-matrix"
        description: |
            Registers are given by a tuple of two values:
                - register address:
                - register block size.
        items:
            minItems: 4
            maxItems: 4
            items:
                - $ref: "/schemas/types.yaml#/definitions/uint32"
                  minimum: 0x0
                  maximum: 0x0
                - $ref: "/schemas/types.yaml#/definitions/uint32"
                  minimum: 0x800000
                  maximum: 0x800000
                - $ref: "/schemas/types.yaml#/definitions/uint32"
                  minimum: 0x0
                  maximum: 0x0
                - $ref: "/schemas/types.yaml#/definitions/uint32"
                  minimum: 0x800000
                  maximum: 0x800000

    interrupts:
        $ref: "/schemas/types.yaml#/definitions/uint32-matrix"
        description: |
            Interrupts are give by a tuple of 3 values:
                - interrupt specifier (GIC_SPI = 0, GIC_PPI = 1)
                  definitions in dt-bindings/interrupt-controller/arm-gic.h
                - interrupt number
                - trigger type (rising edge, falling edge, both, etc)
                  definitions in dt-bindings/interrupt-controller/irq.h
        items:
            items:
                - $ref: "/schemas/types.yaml#/definitions/uint32"
                  minimum: 0x0
                  maximum: 0x0
                - $ref: "/schemas/types.yaml#/definitions/uint32"
                  minimum: 0x245
                  maximum: 0x245
                - $ref: "/schemas/types.yaml#/definitions/uint32"
                  minimum: 0x4
                  maximum: 0x4

    numa-node-id:
        $ref: "/schemas/types.yaml#/definitions/uint32"
        minimum: 0x0
        maximum: 0x0

required:
    - compatible
    - reg
    - interrupts

examples:
    - |
        sys-cbb-fabric@800000 {
            compatible = "nvidia,tegra264-sys-cbb-fabric";
            reg = <0x0 0x800000 0x0 0x800000>;
            interrupts = <GIC_SPI 581 IRQ_TYPE_LEVEL_HIGH>;
            numa-node-id = <0x0>;
            status = "disabled";
        };
```

## Documentation/devicetree/bindings/soc/tegra/nvidia,tegra264-pmc.yaml
```yaml
# Copyright (c) 2024, NVIDIA CORPORATION & AFFILIATES.  All rights reserved.
#
# This program is free software; you can redistribute it and/or modify it
# under the terms and conditions of the GNU General Public License,
# version 2, as published by the Free Software Foundation.
#
# This program is distributed in the hope it will be useful, but WITHOUT
# ANY WARRANTY; without even the implied warranty of MERCHANTABILITY or
# FITNESS FOR A PARTICULAR PURPOSE.  See the GNU General Public License for
# more details.

%YAML 1.2
---
$id: http://devicetree.org/schemas/pmc@c800000/nvidia,tegra264-pmc.yaml#
$schema: http://devicetree.org/meta-schemas/core.yaml#

title: Tegra PMC Module

maintainers:
  - Suresh Mangipudi

description: |
     the compatability = nvidia,tegra264-pmc is mentioned in the following drivers
        - <TOP>/kernel/kernel-oot/drivers/soc/tegra/tegra264-pmc.c
        - <TOP>/kernel/kernel-oot/drivers/gpio/gpio-tegra186.c

     The following nodes use this compatibility
        - /bus@0/pmc@c800000

select:
  properties:
    compatible:
        minItems: 1
        maxItems: 1
        items:
            enum:
                - nvidia,tegra264-pmc

  required:
    - compatible

properties:

    reg:
        $ref: "/schemas/types.yaml#/definitions/uint32-matrix"
        description: |
            Registers are given by a tuple of two values:
                - register address:
                - register block size.
        items:
            minItems: 4
            maxItems: 4
            items:
                - $ref: "/schemas/types.yaml#/definitions/uint32"
                  minimum: 0x0
                  maximum: 0x0
                - $ref: "/schemas/types.yaml#/definitions/uint32"
                  minimum: 0xc800000
                  maximum: 0xc9c0000
                - $ref: "/schemas/types.yaml#/definitions/uint32"
                  minimum: 0x0
                  maximum: 0x0
                - $ref: "/schemas/types.yaml#/definitions/uint32"
                  minimum: 0x10000
                  maximum: 0x100000

    reg-names:
        $ref: "/schemas/types.yaml#/definitions/string-array"
        items:
            enum:
                - pmc
                - wake
                - scratch
                - misc


    '#interrupt-cells':
        $ref: "/schemas/types.yaml#/definitions/uint32"
        minimum: 0x2
        maximum: 0x2

    interrupt-controller:
        $ref: "/schemas/types.yaml#/definitions/flag"

    '#padcontroller-cells':
        $ref: "/schemas/types.yaml#/definitions/uint32"
        minimum: 0x1
        maximum: 0x1

    nvidia,restrict-voltage-switch:
        $ref: "/schemas/types.yaml#/definitions/flag"

    pinctrl-names:
        $ref: "/schemas/types.yaml#/definitions/string-array"
        items:
            enum:
                - default


    pinctrl-0:
        $ref: "/schemas/types.yaml#/definitions/uint32"

required:
    - compatible
    - reg

examples:
    - |
        pmc@c800000 {
            compatible = "nvidia,tegra264-pmc";
            status = "disabled";
            reg = <0x0 0x0c800000 0x0 0x100000>,
                  <0x0 0x0c990000 0x0 0x10000>,
                  <0x0 0x0c980000 0x0 0x10000>,
                  <0x0 0x0c9c0000 0x0 0x40000>;
            reg-names = "pmc, wake, scratch, misc";
            #interrupt-cells = <2>;
            interrupt-controller;
            #padcontroller-cells = <1>;
            nvidia,restrict-voltage-switch;
            pinctrl-names = "default";
            pinctrl-0 = <&iopad_defaults>;
        };
```
