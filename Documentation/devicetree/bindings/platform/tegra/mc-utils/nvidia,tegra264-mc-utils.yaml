## Documentation/devicetree/bindings/platform/tegra/rtcpu/nvidia,tegra-camrtc-hsp-vm.yaml
```yaml
# Copyright (c) 2024, NVIDIA CORPORATION & AFFILIATES.  All rights reserved.
#
# This program is free software; you can redistribute it and/or modify it
# under the terms and conditions of the GNU General Public License,
# version 2, as published by the Free Software Foundation.
#
# This program is distributed in the hope it will be useful, but WITHOUT
# ANY WARRANTY; without even the implied warranty of MERCHANTABILITY or
# FITNESS FOR A PARTICULAR PURPOSE.  See the GNU General Public License for
# more details.

%YAML 1.2
---
$id: http://devicetree.org/schemas/hsp-vm1/nvidia,tegra-camrtc-hsp-vm.yaml#
$schema: http://devicetree.org/meta-schemas/core.yaml#

title: Tegra Hypervisor HSP Client Mailbox

maintainers:
  - Evgeny Kornev

description: |
     the compatability = nvidia,tegra-camrtc-hsp-vm is mentioned in the following drivers
        - <TOP>/kernel/nvidia-oot/drivers/platform/tegra/rtcpu/hsp-mailbox-client.c

     The following nodes use this compatibility
        - /rtcpu@81893d0000/hsp-vm1
        - /rtcpu@81893d0000/hsp-vm2
        - /rtcpu@81893d0000/hsp-vm3
        - /rtcpu@81893d0000/hsp-vm4

select:
  properties:
    compatible:
        minItems: 1
        maxItems: 1
        items:
            enum:
                - nvidia,tegra-camrtc-hsp-vm

  required:
    - compatible

properties:

    mboxes:
        $ref: "/schemas/types.yaml#/definitions/uint32-matrix"
        items:
            minItems: 3
            maxItems: 3
            items:
                - $ref: "/schemas/types.yaml#/definitions/uint32"
                - $ref: "/schemas/types.yaml#/definitions/uint32"
                  minimum: 0x1
                  maximum: 0x2
                - $ref: "/schemas/types.yaml#/definitions/uint32"
                  minimum: 0x0
                  maximum: 0x80000007

    mbox-names:
        $ref: "/schemas/types.yaml#/definitions/string-array"
        items:
            enum:
                - vm-tx
                - vm-rx
                - vm-ss


required:
    - compatible

examples:
    - |
        hsp-vm1 {
            compatible = "nvidia,tegra-camrtc-hsp-vm";
            mboxes = <&rce_hsp0 TEGRA_HSP_MBOX_TYPE_SM TEGRA_HSP_SM_TX(0)>,
                     <&rce_hsp0 TEGRA_HSP_MBOX_TYPE_SM TEGRA_HSP_SM_RX(1)>,
                     <&rce_hsp0 TEGRA_HSP_MBOX_TYPE_SS 0>;
            mbox-names = "vm-tx, vm-rx, vm-ss";
            status = "disabled";
        };
```

## Documentation/devicetree/bindings/platform/tegra/rtcpu/nvidia,tegra186-camera-diagnostics.yaml
```yaml
# Copyright (c) 2024, NVIDIA CORPORATION & AFFILIATES.  All rights reserved.
#
# This program is free software; you can redistribute it and/or modify it
# under the terms and conditions of the GNU General Public License,
# version 2, as published by the Free Software Foundation.
#
# This program is distributed in the hope it will be useful, but WITHOUT
# ANY WARRANTY; without even the implied warranty of MERCHANTABILITY or
# FITNESS FOR A PARTICULAR PURPOSE.  See the GNU General Public License for
# more details.

%YAML 1.2
---
$id: http://devicetree.org/schemas/diag@5/nvidia,tegra186-camera-diagnostics.yaml#
$schema: http://devicetree.org/meta-schemas/core.yaml#

title: Dummy device driver for Camera Diagnostics IVC Channel

maintainers:
  - Evgeny Kornev

description: |
     the compatability = nvidia,tegra186-camera-diagnostics is mentioned in the following drivers
        - <TOP>/kernel/nvidia-oot/drivers/platform/tegra/rtcpu/camera-diagnostics.c

     The following nodes use this compatibility
        - /camera-ivc-channels/diag@5

select:
  properties:
    compatible:
        minItems: 1
        maxItems: 1
        items:
            enum:
                - nvidia,tegra186-camera-diagnostics

  required:
    - compatible

properties:

    nvidia,service:
        $ref: "/schemas/types.yaml#/definitions/string-array"
        items:
            enum:
                - diag


    nvidia,version:
        $ref: "/schemas/types.yaml#/definitions/uint32"
        minimum: 0x0
        maximum: 0x0

    nvidia,group:
        $ref: "/schemas/types.yaml#/definitions/uint32"
        minimum: 0x1
        maximum: 0x1

    nvidia,frame-count:
        $ref: "/schemas/types.yaml#/definitions/uint32"
        minimum: 0x1
        maximum: 0x1

    nvidia,frame-size:
        $ref: "/schemas/types.yaml#/definitions/uint32"
        minimum: 0x40
        maximum: 0x40

required:
    - compatible

examples:
    - |
        diag@5 {
            compatible = "nvidia,tegra186-camera-diagnostics";
            nvidia,service = "diag";
            nvidia,version = <0>;
            nvidia,group = <1>;
            nvidia,frame-count = <1>;
            nvidia,frame-size = <64>;
            status = "disabled";
        };
```

## Documentation/devicetree/bindings/platform/tegra/rtcpu/nvidia,tegra186-camera-ivc-protocol-capture.yaml
```yaml
# Copyright (c) 2024, NVIDIA CORPORATION & AFFILIATES.  All rights reserved.
#
# This program is free software; you can redistribute it and/or modify it
# under the terms and conditions of the GNU General Public License,
# version 2, as published by the Free Software Foundation.
#
# This program is distributed in the hope it will be useful, but WITHOUT
# ANY WARRANTY; without even the implied warranty of MERCHANTABILITY or
# FITNESS FOR A PARTICULAR PURPOSE.  See the GNU General Public License for
# more details.

%YAML 1.2
---
$id: http://devicetree.org/schemas/ivccapture@4/nvidia,tegra186-camera-ivc-protocol-capture.yaml#
$schema: http://devicetree.org/meta-schemas/core.yaml#

title: NVIDIA Tegra Capture IVC driver

maintainers:
  - Evgeny Kornev

description: |
     the compatability = nvidia,tegra186-camera-ivc-protocol-capture is mentioned in the following drivers
        - <TOP>/kernel/nvidia-oot/drivers/platform/tegra/rtcpu/capture-ivc.c

     The following nodes use this compatibility
        - /camera-ivc-channels/ivccapture@4

select:
  properties:
    compatible:
        minItems: 1
        maxItems: 1
        items:
            enum:
                - nvidia,tegra186-camera-ivc-protocol-capture

  required:
    - compatible

properties:

    nvidia,service:
        $ref: "/schemas/types.yaml#/definitions/string-array"
        items:
            enum:
                - capture


    nvidia,version:
        $ref: "/schemas/types.yaml#/definitions/uint32"
        minimum: 0x0
        maximum: 0x0

    nvidia,group:
        $ref: "/schemas/types.yaml#/definitions/uint32"
        minimum: 0x1
        maximum: 0x1

    nvidia,frame-count:
        $ref: "/schemas/types.yaml#/definitions/uint32"
        minimum: 0x200
        maximum: 0x200

    nvidia,frame-size:
        $ref: "/schemas/types.yaml#/definitions/uint32"
        minimum: 0x40
        maximum: 0x40

required:
    - compatible

examples:
    - |
        ivccapture@4 {
            compatible = "nvidia,tegra186-camera-ivc-protocol-capture";
            nvidia,service = "capture";
            nvidia,version = <0>;
            nvidia,group = <1>;
            nvidia,frame-count = <512>;
            nvidia,frame-size = <64>;
            status = "disabled";
        };
```

## Documentation/devicetree/bindings/platform/tegra/rtcpu/nvidia,tegra186-camera-ivc-protocol-echo.yaml
```yaml
# Copyright (c) 2024, NVIDIA CORPORATION & AFFILIATES.  All rights reserved.
#
# This program is free software; you can redistribute it and/or modify it
# under the terms and conditions of the GNU General Public License,
# version 2, as published by the Free Software Foundation.
#
# This program is distributed in the hope it will be useful, but WITHOUT
# ANY WARRANTY; without even the implied warranty of MERCHANTABILITY or
# FITNESS FOR A PARTICULAR PURPOSE.  See the GNU General Public License for
# more details.

%YAML 1.2
---
$id: http://devicetree.org/schemas/echo@0/nvidia,tegra186-camera-ivc-protocol-echo.yaml#
$schema: http://devicetree.org/meta-schemas/core.yaml#

title: The character device for ivc-bus

maintainers:
  - Evgeny Kornev

description: |
     the compatability = nvidia,tegra186-camera-ivc-protocol-echo is mentioned in the following drivers
        - <TOP>/kernel/nvidia-oot/drivers/platform/tegra/rtcpu/camchar.c

     The following nodes use this compatibility
        - /camera-ivc-channels/echo@0

select:
  properties:
    compatible:
        minItems: 1
        maxItems: 1
        items:
            enum:
                - nvidia,tegra186-camera-ivc-protocol-echo

  required:
    - compatible

properties:

    nvidia,service:
        $ref: "/schemas/types.yaml#/definitions/string-array"
        items:
            enum:
                - echo


    nvidia,version:
        $ref: "/schemas/types.yaml#/definitions/uint32"
        minimum: 0x0
        maximum: 0x0

    nvidia,group:
        $ref: "/schemas/types.yaml#/definitions/uint32"
        minimum: 0x1
        maximum: 0x1

    nvidia,frame-count:
        $ref: "/schemas/types.yaml#/definitions/uint32"
        minimum: 0x10
        maximum: 0x10

    nvidia,frame-size:
        $ref: "/schemas/types.yaml#/definitions/uint32"
        minimum: 0x40
        maximum: 0x40

required:
    - compatible

examples:
    - |
        echo@0 {
            compatible = "nvidia,tegra186-camera-ivc-protocol-echo";
            nvidia,service = "echo";
            nvidia,version = <0>;
            nvidia,group = <1>;
            nvidia,frame-count = <16>;
            nvidia,frame-size = <64>;
            status = "disabled";
        };
```

## Documentation/devicetree/bindings/platform/tegra/tegra-fsicom-client.yaml
```yaml
# Copyright (c) 2024, NVIDIA CORPORATION & AFFILIATES.  All rights reserved.
#
# This program is free software; you can redistribute it and/or modify it
# under the terms and conditions of the GNU General Public License,
# version 2, as published by the Free Software Foundation.
#
# This program is distributed in the hope it will be useful, but WITHOUT
# ANY WARRANTY; without even the implied warranty of MERCHANTABILITY or
# FITNESS FOR A PARTICULAR PURPOSE.  See the GNU General Public License for
# more details.

%YAML 1.2
---
$id: http://devicetree.org/schemas/fsicom_client/tegra-fsicom-client.yaml#
$schema: http://devicetree.org/meta-schemas/core.yaml#

title: FSI-CCPLEX-COM driver

maintainers:
  - Rahul Bedarkar

description: |
     The compatibility = nvidia,tegra234-fsicom-client is mentioned in the following drivers
        - <TOP>/kernel/nvidia-oot/drivers/platform/tegra/tegra-fsicom.c

     The following nodes use this compatibility
        - /fsicom_client
        - /fsicom_client_inst1
        - /fsicom_client_inst2
        - /fsicom_client_inst3

select:
  properties:
    compatible:
        minItems: 1
        maxItems: 1
        items:
            enum:
                - nvidia,tegra234-fsicom-client

  required:
    - compatible

properties:

    mboxes:
        $ref: "/schemas/types.yaml#/definitions/uint32-matrix"
        description: |
            Mailbox channels for communication between FSI and CCPLEX.
            Each entry must contain 3 values: phandle, mailbox type, and channel.

    mbox-names:
        $ref: "/schemas/types.yaml#/definitions/string-array"
        description: Names for the mailbox channels defined in the mboxes property.

    memory-region:
        $ref: "/schemas/types.yaml#/definitions/phandle"
        description: Reference to a reserved memory region for FSI-CCPLEX communication.

    dma-coherent:
        $ref: "/schemas/types.yaml#/definitions/flag"
        description: Flag to indicate DMA memory should be coherent.

    enable-deinit-notify:
        $ref: "/schemas/types.yaml#/definitions/flag"
        description: Flag to enable sending notifications to FSI during driver shutdown.

    smmu_inst:
        $ref: "/schemas/types.yaml#/definitions/uint32"
        description: SMMU instance number.
        minimum: 0x0
        maximum: 0x3

    max_fsi_core:
        $ref: "/schemas/types.yaml#/definitions/uint32"
        description: Maximum number of FSI cores.
        minimum: 0x1
        maximum: 0x4

    fsi_core_notify:
        $ref: "/schemas/types.yaml#/definitions/uint32"
        description: FSI core notification configuration.
        minimum: 0x0
        maximum: 0x2

    fsi_core_polling:
        $ref: "/schemas/types.yaml#/definitions/uint32"
        description: FSI core polling configuration.
        minimum: 0x1
        maximum: 0x4

    iommus:
        $ref: "/schemas/types.yaml#/definitions/uint32-array"
        description: |
            iommus is given by a tuple of 2 values:
                - pHandle[Pointer in DT to the SMMU node the client is connected to]
                - stream id
        items:
            minItems: 2
            maxItems: 2
            items:
                - $ref: "/schemas/types.yaml#/definitions/phandle"
                - $ref: "/schemas/types.yaml#/definitions/uint32"
                minimum: 0xf10
                maximum: 0xf13

required:
    - compatible
    - mboxes
    - mbox-names
    - memory-region
    - dma-coherent
    - enable-deinit-notify
    - smmu_inst
    - max_fsi_core
    - fsi_core_notify
    - fsi_core_polling

examples:
    - |
      #include <dt-bindings/mailbox/tegra186-hsp.h>
      #define TEGRA_HSP_MBOX_TYPE_SM_128BIT (1 << 8)

      soc {
          fsicom_client {
              compatible = "nvidia,tegra234-fsicom-client";
              mboxes = <&top_hsp2 (TEGRA_HSP_MBOX_TYPE_SM|TEGRA_HSP_MBOX_TYPE_SM_128BIT) TEGRA_HSP_SM_TX(2)>,
                      <&top_hsp2 (TEGRA_HSP_MBOX_TYPE_SM|TEGRA_HSP_MBOX_TYPE_SM_128BIT) TEGRA_HSP_SM_RX(1)>,
                      <&top_hsp2 (TEGRA_HSP_MBOX_TYPE_SM|TEGRA_HSP_MBOX_TYPE_SM_128BIT) TEGRA_HSP_SM_TX(5)>,
                      <&top_hsp2 (TEGRA_HSP_MBOX_TYPE_SM|TEGRA_HSP_MBOX_TYPE_SM_128BIT) TEGRA_HSP_SM_RX(4)>;
              mbox-names = "fsi-tx-cpu0", "fsi-rx-cpu0", "fsi-tx-cpu1", "fsi-rx-cpu1";
              memory-region = <&fsicom_resv>;
              dma-coherent;
              enable-deinit-notify;
              smmu_inst = <0>;
              max_fsi_core = <1>;
              fsi_core_notify = <0>;
              fsi_core_polling = <>;
              status = "disabled";
          };

       };
...
```
