## Documentation/devicetree/bindings/spi/nvidia,tegra186-spi-slave.yaml
```yaml
# Copyright (c) 2024-2025, NVIDIA CORPORATION & AFFILIATES.  All rights reserved.
#
# This program is free software; you can redistribute it and/or modify it
# under the terms and conditions of the GNU General Public License,
# version 2, as published by the Free Software Foundation.
#
# This program is distributed in the hope it will be useful, but WITHOUT
# ANY WARRANTY; without even the implied warranty of MERCHANTABILITY or
# FITNESS FOR A PARTICULAR PURPOSE.  See the GNU General Public License for
# more details.

%YAML 1.2
---
$id: http://devicetree.org/schemas/spi@810c460000/nvidia,tegra186-spi-slave.yaml#
$schema: http://devicetree.org/meta-schemas/core.yaml#

title: NVIDIA Tegra SPI Controller Driver

maintainers:
  - Suresh Mangipudi

description: |
     the compatability = nvidia,tegra186-spi-slave is mentioned in the following drivers
        - <TOP>/kernel/nvidia-oot/drivers/spi/spi-tegra124-slave.c

     The following nodes use this compatibility
        - /bus@0/spi@810c460000

select:
  properties:
    compatible:
        minItems: 1
        maxItems: 1
        items:
            enum:
                - nvidia,tegra186-spi-slave

  required:
    - compatible

properties:

    reg:
        $ref: "/schemas/types.yaml#/definitions/uint32-matrix"
        description: |
            Registers are given by a tuple of two values:
                - register address:
                - register block size.
        items:
            minItems: 4
            maxItems: 4
            items:
                - $ref: "/schemas/types.yaml#/definitions/uint32"
                  minimum: 0x81
                  maximum: 0x81
                - $ref: "/schemas/types.yaml#/definitions/uint32"
                  minimum: 0xc460000
                  maximum: 0xc460000
                - $ref: "/schemas/types.yaml#/definitions/uint32"
                  minimum: 0x0
                  maximum: 0x0
                - $ref: "/schemas/types.yaml#/definitions/uint32"
                  minimum: 0x10000
                  maximum: 0x10000

    interrupts:
        $ref: "/schemas/types.yaml#/definitions/uint32-matrix"
        description: |
            Interrupts are give by a tuple of 3 values:
                - interrupt specifier (GIC_SPI = 0, GIC_PPI = 1)
                  definitions in dt-bindings/interrupt-controller/arm-gic.h
                - interrupt number
                - trigger type (rising edge, falling edge, both, etc)
                  definitions in dt-bindings/interrupt-controller/irq.h
        items:
            items:
                - $ref: "/schemas/types.yaml#/definitions/uint32"
                  minimum: 0x0
                  maximum: 0x0
                - $ref: "/schemas/types.yaml#/definitions/uint32"
                  minimum: 0xa7
                  maximum: 0xa7
                - $ref: "/schemas/types.yaml#/definitions/uint32"
                  minimum: 0x4
                  maximum: 0x4

    dma-coherent:
        $ref: "/schemas/types.yaml#/definitions/flag"

    dma-names:
        $ref: "/schemas/types.yaml#/definitions/string-array"
        items:
            enum:
                - rx
                - tx


    dmas:
        $ref: "/schemas/types.yaml#/definitions/uint32-matrix"
        items:
            minItems: 4
            maxItems: 4
            items:
                - $ref: "/schemas/types.yaml#/definitions/uint32"
                - $ref: "/schemas/types.yaml#/definitions/uint32"
                  minimum: 0x10
                  maximum: 0x10
                - $ref: "/schemas/types.yaml#/definitions/uint32"
                  minimum: 0x10
                  maximum: 0x1a
                - $ref: "/schemas/types.yaml#/definitions/uint32"
                  minimum: 0x810
                  maximum: 0x810

    iommus:
        $ref: "/schemas/types.yaml#/definitions/uint32-matrix"
        description: |
            iommus are given by a tuple of 2 values:
                - Phandle to the device
                - Device ID
        items:
            minItems: 2
            maxItems: 2
            items:
                - $ref: "/schemas/types.yaml#/definitions/uint32"
                - $ref: "/schemas/types.yaml#/definitions/uint32"
                  minimum: 0x810
                  maximum: 0x810

    clocks:
        $ref: "/schemas/types.yaml#/definitions/uint32-matrix"
        description: |
            Clocks are given by a tuple of 2 values:
                - Phandle to the device
                - Clock ID
        items:
            minItems: 2
            maxItems: 2
            items:
                - $ref: "/schemas/types.yaml#/definitions/uint32"
                - $ref: "/schemas/types.yaml#/definitions/uint32"
                  minimum: 0x16
                  maximum: 0x2e

    clock-names:
        $ref: "/schemas/types.yaml#/definitions/string-array"
        items:
            enum:
                - spi


    assigned-clocks:
        $ref: "/schemas/types.yaml#/definitions/uint32-matrix"
        items:
            minItems: 2
            maxItems: 2
            items:
                - $ref: "/schemas/types.yaml#/definitions/uint32"
                - $ref: "/schemas/types.yaml#/definitions/uint32"
                  minimum: 0x2e
                  maximum: 0x2e

    assigned-clock-parents:
        $ref: "/schemas/types.yaml#/definitions/uint32-matrix"
        items:
            minItems: 2
            maxItems: 2
            items:
                - $ref: "/schemas/types.yaml#/definitions/uint32"
                - $ref: "/schemas/types.yaml#/definitions/uint32"
                  minimum: 0x16
                  maximum: 0x16

    resets:
        $ref: "/schemas/types.yaml#/definitions/uint32-matrix"
        description: |
            Resets are given by a tuple of 2 values:
                - Phandle to the device
                - Reset ID
        items:
            minItems: 2
            maxItems: 2
            items:
                - $ref: "/schemas/types.yaml#/definitions/uint32"
                - $ref: "/schemas/types.yaml#/definitions/uint32"
                  minimum: 0x28
                  maximum: 0x28

    reset-names:
        $ref: "/schemas/types.yaml#/definitions/string-array"
        items:
            enum:
                - spi


required:
    - compatible
    - reg
    - interrupts
    - iommus
    - clocks
    - clock-names
    - resets
    - reset-names

examples:
    - |
        spi@810c460000 {
            compatible = "nvidia,tegra186-spi-slave";
            status = "disabled";
            reg = <0x81 0x0c460000 0x0 0x10000>;
            interrupts = <GIC_SPI 167 IRQ_TYPE_LEVEL_HIGH>;
            dma-coherent;
            dma-names = "rx, tx";
            dmas = <&gpcdma 16 16 TEGRA264_GPCDMA_SID_SPI5>,
                   <&gpcdma 16 26 TEGRA264_GPCDMA_SID_SPI5>;
            iommus = <&smmu1_mmu TEGRA264_GPCDMA_SID_SPI5>;
            clocks = <&bpmp TEGRA264_CLK_SPI5>,
                     <&bpmp TEGRA264_CLK_PLLP_OUT0>;
            clock-names = "spi";
            assigned-clocks = <&bpmp TEGRA264_CLK_SPI5>;
            assigned-clock-parents = <&bpmp TEGRA264_CLK_PLLP_OUT0>;
            resets = <&bpmp TEGRA264_RESET_SPI5>;
            reset-names = "spi";
        };
```

## Documentation/devicetree/bindings/spi/nvidia,tegra234-qspi.yaml
```yaml
# Copyright (c) 2024, NVIDIA CORPORATION & AFFILIATES.  All rights reserved.
#
# This program is free software; you can redistribute it and/or modify it
# under the terms and conditions of the GNU General Public License,
# version 2, as published by the Free Software Foundation.
#
# This program is distributed in the hope it will be useful, but WITHOUT
# ANY WARRANTY; without even the implied warranty of MERCHANTABILITY or
# FITNESS FOR A PARTICULAR PURPOSE.  See the GNU General Public License for
# more details.

%YAML 1.2
---
$id: http://devicetree.org/schemas/spi@810c5b0000/nvidia,tegra234-qspi.yaml#
$schema: http://devicetree.org/meta-schemas/core.yaml#

title: NVIDIA Tegra QSPI Controller Driver

maintainers:
  - Suresh Mangipudi

description: |
     the compatability = nvidia,tegra234-qspi is mentioned in the following drivers
        - <TOP>/kernel/nvidia-oot/drivers/spi/spi-tegra210-quad.c

     The following nodes use this compatibility
        - /bus@0/spi@810c5b0000

select:
  properties:
    compatible:
        minItems: 1
        maxItems: 1
        items:
            enum:
                - nvidia,tegra234-qspi

  required:
    - compatible

properties:

    reg:
        $ref: "/schemas/types.yaml#/definitions/uint32-matrix"
        description: |
            Registers are given by a tuple of two values:
                - register address:
                - register block size.
        items:
            minItems: 4
            maxItems: 4
            items:
                - $ref: "/schemas/types.yaml#/definitions/uint32"
                  minimum: 0x81
                  maximum: 0x81
                - $ref: "/schemas/types.yaml#/definitions/uint32"
                  minimum: 0xc5b0000
                  maximum: 0xc5b0000
                - $ref: "/schemas/types.yaml#/definitions/uint32"
                  minimum: 0x0
                  maximum: 0x0
                - $ref: "/schemas/types.yaml#/definitions/uint32"
                  minimum: 0x10000
                  maximum: 0x10000

    interrupts:
        $ref: "/schemas/types.yaml#/definitions/uint32-matrix"
        description: |
            Interrupts are give by a tuple of 3 values:
                - interrupt specifier (GIC_SPI = 0, GIC_PPI = 1)
                  definitions in dt-bindings/interrupt-controller/arm-gic.h
                - interrupt number
                - trigger type (rising edge, falling edge, both, etc)
                  definitions in dt-bindings/interrupt-controller/irq.h
        items:
            items:
                - $ref: "/schemas/types.yaml#/definitions/uint32"
                  minimum: 0x0
                  maximum: 0x0
                - $ref: "/schemas/types.yaml#/definitions/uint32"
                  minimum: 0xa1
                  maximum: 0xa1
                - $ref: "/schemas/types.yaml#/definitions/uint32"
                  minimum: 0x4
                  maximum: 0x4

    iommus:
        $ref: "/schemas/types.yaml#/definitions/uint32-matrix"
        description: |
            iommus are given by a tuple of 2 values:
                - Phandle to the device
                - Device ID
        items:
            minItems: 2
            maxItems: 2
            items:
                - $ref: "/schemas/types.yaml#/definitions/uint32"
                - $ref: "/schemas/types.yaml#/definitions/uint32"
                  minimum: 0x2500
                  maximum: 0x2500

    dma-coherent:
        $ref: "/schemas/types.yaml#/definitions/flag"

    dma-names:
        $ref: "/schemas/types.yaml#/definitions/string-array"
        items:
            enum:
                - rx
                - tx


    nvidia,clk-parents:
        $ref: "/schemas/types.yaml#/definitions/string-array"
        items:
            enum:
                - pllc0
                - pll_p


    clocks:
        $ref: "/schemas/types.yaml#/definitions/uint32-matrix"
        description: |
            Clocks are given by a tuple of 2 values:
                - Phandle to the device
                - Clock ID
        items:
            minItems: 2
            maxItems: 2
            items:
                - $ref: "/schemas/types.yaml#/definitions/uint32"
                - $ref: "/schemas/types.yaml#/definitions/uint32"
                  minimum: 0x16
                  maximum: 0x98

    clock-names:
        $ref: "/schemas/types.yaml#/definitions/string-array"
        items:
            enum:
                - qspi
                - qspi_out
                - pllc0
                - pll_p


    resets:
        $ref: "/schemas/types.yaml#/definitions/uint32-matrix"
        description: |
            Resets are given by a tuple of 2 values:
                - Phandle to the device
                - Reset ID
        items:
            minItems: 2
            maxItems: 2
            items:
                - $ref: "/schemas/types.yaml#/definitions/uint32"
                - $ref: "/schemas/types.yaml#/definitions/uint32"
                  minimum: 0x1d
                  maximum: 0x1d

    assigned-clocks:
        $ref: "/schemas/types.yaml#/definitions/uint32-matrix"
        items:
            minItems: 2
            maxItems: 2
            items:
                - $ref: "/schemas/types.yaml#/definitions/uint32"
                - $ref: "/schemas/types.yaml#/definitions/uint32"
                  minimum: 0x20
                  maximum: 0x98

    assigned-clock-parents:
        $ref: "/schemas/types.yaml#/definitions/uint32-matrix"
        items:
            minItems: 2
            maxItems: 2
            items:
                - $ref: "/schemas/types.yaml#/definitions/uint32"
                - $ref: "/schemas/types.yaml#/definitions/uint32"
                  minimum: 0x98
                  maximum: 0x98

    assigned-clock-rates:
        $ref: "/schemas/types.yaml#/definitions/uint32-matrix"
        items:
            minItems: 2
            maxItems: 2
            items:
                - $ref: "/schemas/types.yaml#/definitions/uint32"
                  minimum: 0xbebc1ff
                  maximum: 0xbebc1ff
                - $ref: "/schemas/types.yaml#/definitions/uint32"
                  minimum: 0xbebc1ff
                  maximum: 0xbebc1ff

    reset-names:
        $ref: "/schemas/types.yaml#/definitions/string-array"
        items:
            enum:
                - qspi


required:
    - compatible
    - reg
    - interrupts
    - iommus
    - clocks
    - clock-names
    - resets
    - reset-names

examples:
    - |
        spi@810c5b0000 {
            compatible = "nvidia,tegra234-qspi";
            status = "disabled";
            reg = <0x81 0x0c5b0000 0x0 0x10000>;
            interrupts = <GIC_SPI 161 IRQ_TYPE_LEVEL_HIGH>;
            iommus = <&smmu2_mmu TEGRA_SID_XSPI0>;
            dma-coherent;
            dma-names = "rx, tx";
            nvidia,clk-parents = "pllc0, pll_p";
            clocks = <&bpmp TEGRA264_CLK_QSPI0_2X_PM>,
                     <&bpmp TEGRA264_CLK_QSPI0>,
                     <&bpmp TEGRA264_CLK_PLLC0>,
                     <&bpmp TEGRA264_CLK_PLLP_OUT0>;
            clock-names = "qspi, qspi_out, pllc0, pll_p";
            resets = <&bpmp TEGRA264_RESET_QSPI0>;
            assigned-clocks = <&bpmp  TEGRA264_CLK_QSPI0_2X_PM>,
                              <&bpmp TEGRA264_CLK_PLLC0>;
            assigned-clock-parents = <&bpmp TEGRA264_CLK_PLLC0>;
            assigned-clock-rates = <199999999 199999999>;
            reset-names = "qspi";
        };
```
