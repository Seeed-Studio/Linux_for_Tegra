## Documentation/devicetree/bindings/platform/tegra/tegra23x_perf_uncore.yaml
```yaml
# SPDX-License-Identifier: (GPL-2.0 OR BSD-2-Clause)
# Copyright (c) 2022, NVIDIA CORPORATION & AFFILIATES. All rights reserved.
%YAML 1.2
---
$id: http://devicetree.org/schemas/platform/tegra/tegra23x_perf_uncore.yaml#
$schema: http://devicetree.org/meta-schemas/core.yaml#

title: Device tree binding for NVIDIA Tegra23x Perf Uncore

maintainers:
  - Eric Funsten <efunsten@nvidia.com>

description: |
   The tegra23x_perf_uncore driver provides an interface to the
   scf-pmu device in order to set up PMU counters.

properties:
  compatible:
    enum:
      - nvidia,scf-pmu

  interrupts:
    maxItems: 1
    description: |
       Specifies the interrupt for the scf-pmu device.

  interrupt-affinity:
    maxItems: 1
    description: |
       Describes how to map the interrupt to cpu.

required:
  - compatible
  - interrupts
  - interrupt-affinity

additionalProperties: false

examples:
  - |
    #include <dt-bindings/gpio/tegra234-gpio.h>
    #include <dt-bindings/interrupt-controller/arm-gic.h>

    scf-pmu {
				compatible = "nvidia,scf-pmu";
				interrupts = <GIC_SPI 551 IRQ_TYPE_LEVEL_HIGH>;
				interrupt-affinity = <&cpu0_0>;
		};
...
```

## Documentation/devicetree/bindings/platform/tegra/tegra_bootloader_debug.yaml
```yaml
# SPDX-License-Identifier: (GPL-2.0 OR BSD-2-Clause)
%YAML 1.2
---
$id: http://devicetree.org/schemas/platform/tegra/tegra_bootloader_debug.yaml#
$schema: http://devicetree.org/meta-schemas/core.yaml#

title: Device tree binding for NVIDIA Tegra Bootloader Debug

maintainers:
  - Deepak Nibade <dnibade@nvidia.com>

description: |
   The tegra_bootloader_debug driver provides infrastructure to profile Boot and Resume KPIs

properties:
  compatible:
    enum:
      - nvidia,tegra_bl_debug

  usec_timer_reg_base:
    $ref: /schemas/types.yaml#/definitions/uint32
    description: |
      Base address of the Tegra USEC timer register.
      If not specified, driver will fallback to use ARM generic timer.

required:
  - compatible

additionalProperties: false

examples:
  - |
    profiler_device {
        compatible = "nvidia,tegra_bl_debug";
        usec_timer_reg_base = <0x0C240000>; /* USEC_CNTR_USECCVR_0 */
        status = "okay";
    };
...
```

## Documentation/devicetree/bindings/pwm/nvidia,pwm-tegra264-tachometer.yaml
```yaml
# Copyright (c) 2024, NVIDIA CORPORATION & AFFILIATES.  All rights reserved.
#
# This program is free software; you can redistribute it and/or modify it
# under the terms and conditions of the GNU General Public License,
# version 2, as published by the Free Software Foundation.
#
# This program is distributed in the hope it will be useful, but WITHOUT
# ANY WARRANTY; without even the implied warranty of MERCHANTABILITY or
# FITNESS FOR A PARTICULAR PURPOSE.  See the GNU General Public License for
# more details.

%YAML 1.2
---
$id: http://devicetree.org/schemas/tachometer@810c5c0000/nvidia,pwm-tegra264-tachometer.yaml#
$schema: http://devicetree.org/meta-schemas/core.yaml#

title: PWM based NVIDIA Tegra Tachometer driver

maintainers:
  - Suresh Mangipudi

description: |
     the compatability = nvidia,pwm-tegra264-tachometer is mentioned in the following drivers
        - <TOP>/kernel/nvidia-oot/drivers/pwm/pwm-tegra-tachometer.c

     The following nodes use this compatibility
        - /bus@0/tachometer@810c5c0000

select:
  properties:
    compatible:
        minItems: 1
        maxItems: 1
        items:
            enum:
                - nvidia,pwm-tegra264-tachometer

  required:
    - compatible

properties:

    reg:
        $ref: "/schemas/types.yaml#/definitions/uint32-matrix"
        description: |
            Registers are given by a tuple of two values:
                - register address:
                - register block size.
        items:
            minItems: 4
            maxItems: 4
            items:
                - $ref: "/schemas/types.yaml#/definitions/uint32"
                  minimum: 0x81
                  maximum: 0x81
                - $ref: "/schemas/types.yaml#/definitions/uint32"
                  minimum: 0xc5c0000
                  maximum: 0xc5c0000
                - $ref: "/schemas/types.yaml#/definitions/uint32"
                  minimum: 0x0
                  maximum: 0x0
                - $ref: "/schemas/types.yaml#/definitions/uint32"
                  minimum: 0x10
                  maximum: 0x10

    '#pwm-cells':
        $ref: "/schemas/types.yaml#/definitions/uint32"
        minimum: 0x2
        maximum: 0x2

    clocks:
        $ref: "/schemas/types.yaml#/definitions/uint32-matrix"
        description: |
            Clocks are given by a tuple of 2 values:
                - Phandle to the device
                - Clock ID
        items:
            minItems: 2
            maxItems: 2
            items:
                - $ref: "/schemas/types.yaml#/definitions/uint32"
                - $ref: "/schemas/types.yaml#/definitions/uint32"
                  minimum: 0x158
                  maximum: 0x158

    resets:
        $ref: "/schemas/types.yaml#/definitions/uint32-matrix"
        description: |
            Resets are given by a tuple of 2 values:
                - Phandle to the device
                - Reset ID
        items:
            minItems: 2
            maxItems: 2
            items:
                - $ref: "/schemas/types.yaml#/definitions/uint32"
                - $ref: "/schemas/types.yaml#/definitions/uint32"
                  minimum: 0x2c
                  maximum: 0x2c

    clock-names:
        $ref: "/schemas/types.yaml#/definitions/string-array"
        items:
            enum:
                - tach


    reset-names:
        $ref: "/schemas/types.yaml#/definitions/string-array"
        items:
            enum:
                - tach


    pulse-per-rev:
        $ref: "/schemas/types.yaml#/definitions/uint32"
        minimum: 0x2
        maximum: 0x2

    capture-window-length:
        $ref: "/schemas/types.yaml#/definitions/uint32"
        minimum: 0x2
        maximum: 0x2

    disable-clk-gate:
        $ref: "/schemas/types.yaml#/definitions/flag"

required:
    - compatible
    - reg
    - clocks
    - resets
    - clock-names
    - reset-names

examples:
    - |
        tachometer@810c5c0000 {
            compatible = "nvidia,pwm-tegra264-tachometer";
            status = "disabled";
            reg = <0x81 0x0c5c0000 0x0 0x10>;
            #pwm-cells = <2>;
            clocks = <&bpmp TEGRA264_CLK_CLK1M>;
            resets = <&bpmp TEGRA264_RESET_TACH0>;
            clock-names = "tach";
            reset-names = "tach";
            pulse-per-rev = <2>;
            capture-window-length = <2>;
            disable-clk-gate;
        };
```

## Documentation/devicetree/bindings/pwm/nvidia,tegra264-pwm.yaml
```yaml
# Copyright (c) 2024, NVIDIA CORPORATION & AFFILIATES.  All rights reserved.
#
# This program is free software; you can redistribute it and/or modify it
# under the terms and conditions of the GNU General Public License,
# version 2, as published by the Free Software Foundation.
#
# This program is distributed in the hope it will be useful, but WITHOUT
# ANY WARRANTY; without even the implied warranty of MERCHANTABILITY or
# FITNESS FOR A PARTICULAR PURPOSE.  See the GNU General Public License for
# more details.

%YAML 1.2
---
$id: http://devicetree.org/schemas/pwm@c6a0000/nvidia,tegra264-pwm.yaml#
$schema: http://devicetree.org/meta-schemas/core.yaml#

title: Tegra Pulse Width Modulation Module

maintainers:
  - Suresh Mangipudi

description: |
     the compatability = nvidia,tegra264-pwm is mentioned in the following drivers
        - <TOP>/kernel/kernel-oot/drivers/pwm/pwm-tegra.c

     The following nodes use this compatibility
        - /bus@0/pwm@c6a0000
        - /bus@0/pwm@810c5e0000
        - /bus@0/pwm@810c5f0000
        - /bus@0/pwm@810c600000
        - /bus@0/pwm@810c610000
        - /bus@0/pwm@810c620000

select:
  properties:
    compatible:
        minItems: 1
        maxItems: 1
        items:
            enum:
                - nvidia,tegra264-pwm

  required:
    - compatible

properties:

    reg:
        $ref: "/schemas/types.yaml#/definitions/uint32-matrix"
        description: |
            Registers are given by a tuple of two values:
                - register address:
                - register block size.
        items:
            minItems: 4
            maxItems: 4
            items:
                - $ref: "/schemas/types.yaml#/definitions/uint32"
                  minimum: 0x0
                  maximum: 0x81
                - $ref: "/schemas/types.yaml#/definitions/uint32"
                  minimum: 0xc5e0000
                  maximum: 0xc6a0000
                - $ref: "/schemas/types.yaml#/definitions/uint32"
                  minimum: 0x0
                  maximum: 0x0
                - $ref: "/schemas/types.yaml#/definitions/uint32"
                  minimum: 0x10000
                  maximum: 0x10000

    nvidia,hw-instance-id:
        $ref: "/schemas/types.yaml#/definitions/uint32"
        minimum: 0x2
        maximum: 0xa

    clocks:
        $ref: "/schemas/types.yaml#/definitions/uint32-matrix"
        description: |
            Clocks are given by a tuple of 2 values:
                - Phandle to the device
                - Clock ID
        items:
            minItems: 2
            maxItems: 2
            items:
                - $ref: "/schemas/types.yaml#/definitions/uint32"
                - $ref: "/schemas/types.yaml#/definitions/uint32"
                  minimum: 0x16
                  maximum: 0xa0

    '#pwm-cells':
        $ref: "/schemas/types.yaml#/definitions/uint32"
        minimum: 0x2
        maximum: 0x2

    resets:
        $ref: "/schemas/types.yaml#/definitions/uint32-matrix"
        description: |
            Resets are given by a tuple of 2 values:
                - Phandle to the device
                - Reset ID
        items:
            minItems: 2
            maxItems: 2
            items:
                - $ref: "/schemas/types.yaml#/definitions/uint32"
                - $ref: "/schemas/types.yaml#/definitions/uint32"
                  minimum: 0x17
                  maximum: 0x1c

    reset-names:
        $ref: "/schemas/types.yaml#/definitions/string-array"
        items:
            enum:
                - pwm


    clock-names:
        $ref: "/schemas/types.yaml#/definitions/string-array"
        items:
            enum:
                - pwm
                - pll_aon
                - parent


required:
    - compatible
    - reg
    - clocks
    - resets
    - reset-names
    - clock-names

examples:
    - |
        pwm@c6a0000 {
            compatible = "nvidia,tegra264-pwm";
            status = "disabled";
            reg = <0x0 0xc6a0000 0x0 0x10000>;
            nvidia,hw-instance-id = <0x4>;
            clocks = <&bpmp TEGRA264_CLK_PWM4>;
            #pwm-cells = <2>;
            resets = <&bpmp TEGRA264_RESET_PWM4>;
            reset-names = "pwm";
        };
```

## Documentation/devicetree/bindings/pwm/pwm-tegra-tachometer.yaml
```yaml
# SPDX-License-Identifier: GPL-2.0
%YAML 1.2
---
$id: http://devicetree.org/schemas/pwm/pwm-tegra-tachometer.yaml#
$schema: http://devicetree.org/meta-schemas/core.yaml#

title: NVIDIA Tegra PWM based tachometer

maintainers:
  - Laxman Dewangan <ldewangan@nvidia.com>
  - Vishwaroop A <va@nvidia.com>

description: |+
  Nvidia SoCs Tegra contains PWM based tachometer which captrues the PWM signal
  and reports this as RPM.

properties:
  compatible:
    enum:
      - nvidia,pwm-tegra234-tachometer
      - nvidia,pwm-tegra194-tachometer
      - nvidia,pwm-tegra186-tachometer

  reg:
    maxItems: 1
    description: Base address and size of the Tachometer controller.

  clocks:
    maxItems: 1

  clock-names:
    description: |
      Should contain all following required clock names:
      - "tach" - Base clock for the tachometer to measure the timing of PWM period.

  resets:
    maxItems: 1

  reset-names:
    description: |
      Should contain all following required reset names:
      - "tach" - Reset name for the tachometer controller.

  interrupts:
    description:
      Interrupt from the tachometer if speed of wheel crosses the upper/lowe threshold.

  "#pwm-cells":
    description:
      The only third cell flag supported by this binding
      is PWM_POLARITY_INVERTED.
    const: 2

  pulse-per-rev:
    $ref: /schemas/types.yaml#/definitions/uint32
    description: |
      Number of PWM pusles per revolution of the wheel.

  capture-window-length:
    $ref: /schemas/types.yaml#/definitions/uint32
    description: |
      Number of window for which PWM signal needs to capture for calculating the speed in RPM.

  disable-clk-gate:
    $ref: /schemas/types.yaml#/definitions/flag
    description: |
      If present than disable the clock gating to continuously provide the clock to the controller.
  
  upper-threshold:
    $ref: /schemas/types.yaml#/definitions/uint32
    description: |
      Upper threshold of RPM for which interrupt is generated.

  lower-threshold:
    $ref: /schemas/types.yaml#/definitions/uint32
    description: |
      Lower threshold of RPM for which interrupt is generated.

required:
  - compatible
  - reg
  - clocks
  - clock-names
  - resets
  - reset-names
  - "#pwm-cells"
  - pulse-per-rev
  - capture-window-length

additionalProperties: false

allOf:
  - $ref: pwm.yaml#

  - if:
      properties:
        compatible:
          contains:
            enum:
              - nvidia,pwm-tegra234-tachometer
    then:
      required:
        - interrupts
        - upper-threshold
        - lower-threshold

examples:
  - |
    #define TEGRA234_RESET_TACH0                   95U
    #define TEGRA234_CLK_TACH0                     152U


    soc {
        #address-cells = <2>;
        #size-cells = <2>;

        tegra_tachometer: pwm@39c0000 {
                compatible = "nvidia,pwm-tegra194-tachometer";
                reg = <0x0 0x039c0000 0x0 0x10>;
                #pwm-cells = <2>;
                clocks = <&bpmp_clks TEGRA234_CLK_TACH0>;
                clock-names = "tach";
                resets = <&bpmp_resets TEGRA234_RESET_TACH0>;
                reset-names = "tach";
                pulse-per-rev = <2>;
                capture-window-length = <2>;
                disable-clk-gate;
        };
     };
...
```
