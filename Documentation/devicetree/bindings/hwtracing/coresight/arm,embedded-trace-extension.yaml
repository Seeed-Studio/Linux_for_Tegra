## Documentation/devicetree/bindings/memory/tegra/private-soc/nvidia,tegra-t264-mc-hwpm.yaml
```yaml
# Copyright (c) 2024, NVIDIA CORPORATION & AFFILIATES.  All rights reserved.
#
# This program is free software; you can redistribute it and/or modify it
# under the terms and conditions of the GNU General Public License,
# version 2, as published by the Free Software Foundation.
#
# This program is distributed in the hope it will be useful, but WITHOUT
# ANY WARRANTY; without even the implied warranty of MERCHANTABILITY or
# FITNESS FOR A PARTICULAR PURPOSE.  See the GNU General Public License for
# more details.

%YAML 1.2
---
$id: http://devicetree.org/schemas/memory-controller-hwpm@8108020000/nvidia,tegra-t264-mc-hwpm.yaml#
$schema: http://devicetree.org/meta-schemas/core.yaml#

title: FIXME -- add title

maintainers:
  - FIXME -- add maintainers

description: |
     the compatability = nvidia,tegra-t264-mc-hwpm is mentioned in the following drivers
        - <TOP>/kernel/nvidia-oot/drivers/memory/tegra/private-soc/tegra264-mc-hwpm.c

     The following nodes use this compatibility
        - /bus@0/memory-controller-hwpm@8108020000

select:
  properties:
    compatible:
        minItems: 1
        maxItems: 1
        items:
            enum:
                - nvidia,tegra-t264-mc-hwpm

  required:
    - compatible

properties:

    reg:
        $ref: "/schemas/types.yaml#/definitions/uint32-matrix"
        description: |
            Registers are given by a tuple of two values:
                - register address:
                - register block size.
        items:
            minItems: 4
            maxItems: 4
            items:
                - $ref: "/schemas/types.yaml#/definitions/uint32"
                  minimum: 0x81
                  maximum: 0x81
                - $ref: "/schemas/types.yaml#/definitions/uint32"
                  minimum: 0x8020000
                  maximum: 0x8220000
                - $ref: "/schemas/types.yaml#/definitions/uint32"
                  minimum: 0x0
                  maximum: 0x0
                - $ref: "/schemas/types.yaml#/definitions/uint32"
                  minimum: 0x20000
                  maximum: 0x20000

required:
    - compatible
    - reg

examples:
    - |
        memory-controller-hwpm@8108020000 {
            compatible = "nvidia,tegra-t264-mc-hwpm";
            reg = <0x81 0x8020000 0x0 0x20000>,
                  <0x81 0x8040000 0x0 0x20000>,
                  <0x81 0x8060000 0x0 0x20000>,
                  <0x81 0x8080000 0x0 0x20000>,
                  <0x81 0x80a0000 0x0 0x20000>,
                  <0x81 0x80c0000 0x0 0x20000>,
                  <0x81 0x80e0000 0x0 0x20000>,
                  <0x81 0x8100000 0x0 0x20000>,
                  <0x81 0x8120000 0x0 0x20000>,
                  <0x81 0x8140000 0x0 0x20000>,
                  <0x81 0x8160000 0x0 0x20000>,
                  <0x81 0x8180000 0x0 0x20000>,
                  <0x81 0x81a0000 0x0 0x20000>,
                  <0x81 0x81c0000 0x0 0x20000>,
                  <0x81 0x81e0000 0x0 0x20000>,
                  <0x81 0x8200000 0x0 0x20000>,
                  <0x81 0x8220000 0x0 0x20000>;
            status = "disabled";
        };
```

## Documentation/devicetree/bindings/memory/tegra/private-soc/nvidia,tegra-t264-mem-qual.yaml
```yaml
# Copyright (c) 2024, NVIDIA CORPORATION & AFFILIATES.  All rights reserved.
#
# This program is free software; you can redistribute it and/or modify it
# under the terms and conditions of the GNU General Public License,
# version 2, as published by the Free Software Foundation.
#
# This program is distributed in the hope it will be useful, but WITHOUT
# ANY WARRANTY; without even the implied warranty of MERCHANTABILITY or
# FITNESS FOR A PARTICULAR PURPOSE.  See the GNU General Public License for
# more details.

%YAML 1.2
---
$id: http://devicetree.org/schemas/memqual@f020000/nvidia,tegra-t264-mem-qual.yaml#
$schema: http://devicetree.org/meta-schemas/core.yaml#

title: FIXME -- add title

maintainers:
  - FIXME -- add maintainers

description: |
     the compatability = nvidia,tegra-t264-mem-qual is mentioned in the following drivers
        - <TOP>/kernel/nvidia-oot/drivers/memory/tegra/private-soc/mem-qual.c

     The following nodes use this compatibility
        - /bus@0/memqual@f020000
        - /bus@0/memqual@a808730000
        - /bus@0/memqual@818d020000
        - /bus@0/memqual@a808750000
        - /bus@0/memqual@818d030000

select:
  properties:
    compatible:
        minItems: 1
        maxItems: 1
        items:
            enum:
                - nvidia,tegra-t264-mem-qual

  required:
    - compatible

properties:

    reg:
        $ref: "/schemas/types.yaml#/definitions/uint32-matrix"
        description: |
            Registers are given by a tuple of two values:
                - register address:
                - register block size.
        items:
            minItems: 4
            maxItems: 4
            items:
                - $ref: "/schemas/types.yaml#/definitions/uint32"
                  minimum: 0x0
                  maximum: 0xa8
                - $ref: "/schemas/types.yaml#/definitions/uint32"
                  minimum: 0x8730000
                  maximum: 0x8d030000
                - $ref: "/schemas/types.yaml#/definitions/uint32"
                  minimum: 0x0
                  maximum: 0x0
                - $ref: "/schemas/types.yaml#/definitions/uint32"
                  minimum: 0x10000
                  maximum: 0x10000

    iommus:
        $ref: "/schemas/types.yaml#/definitions/uint32-matrix"
        description: |
            iommus are given by a tuple of 2 values:
                - Phandle to the device
                - Device ID
        items:
            minItems: 2
            maxItems: 2
            items:
                - $ref: "/schemas/types.yaml#/definitions/uint32"
                - $ref: "/schemas/types.yaml#/definitions/uint32"
                  minimum: 0x0
                  maximum: 0x3f00

    dma-coherent:
        $ref: "/schemas/types.yaml#/definitions/flag"

required:
    - compatible
    - reg
    - iommus

examples:
    - |
        memqual@f020000 {
            compatible = "nvidia,tegra-t264-mem-qual";
            status = "disabled";
            reg = <0x0 0x0f020000 0x0 0x10000>;
            iommus = <&smmu1_mmu TEGRA_SID_MIU0>,
                     <&smmu1_mmu TEGRA_SID_MIU1>;
            dma-coherent;
        };
```

## Documentation/devicetree/bindings/misc/nvidia,fsi-carveout.yaml
```yaml
# Copyright (c) 2024, NVIDIA CORPORATION & AFFILIATES.  All rights reserved.
#
# This program is free software; you can redistribute it and/or modify it
# under the terms and conditions of the GNU General Public License,
# version 2, as published by the Free Software Foundation.
#
# This program is distributed in the hope it will be useful, but WITHOUT
# ANY WARRANTY; without even the implied warranty of MERCHANTABILITY or
# FITNESS FOR A PARTICULAR PURPOSE.  See the GNU General Public License for
# more details.

%YAML 1.2
---
$id: http://devicetree.org/schemas/fsi-carveout/nvidia,fsi-carveout.yaml#
$schema: http://devicetree.org/meta-schemas/core.yaml#

title: Nvidia FSI Carveout

maintainers:
  - Sachin Nikam

description: |
     The following nodes use this compatibility
        - /reserved-memory/fsi-carveout

select:
  properties:
    compatible:
        minItems: 1
        maxItems: 1
        items:
            enum:
                - nvidia,fsi-carveout

  required:
    - compatible

properties:

    size:
        $ref: "/schemas/types.yaml#/definitions/uint32-matrix"
        items:
            minItems: 2
            maxItems: 2
            items:
                - $ref: "/schemas/types.yaml#/definitions/uint32"
                  minimum: 0x0
                  maximum: 0x0
                - $ref: "/schemas/types.yaml#/definitions/uint32"
                  minimum: 0x2000000
                  maximum: 0x2000000

    alignment:
        $ref: "/schemas/types.yaml#/definitions/uint32-matrix"
        items:
            minItems: 2
            maxItems: 2
            items:
                - $ref: "/schemas/types.yaml#/definitions/uint32"
                  minimum: 0x0
                  maximum: 0x0
                - $ref: "/schemas/types.yaml#/definitions/uint32"
                  minimum: 0x1000
                  maximum: 0x1000

    no-map:
        $ref: "/schemas/types.yaml#/definitions/flag"

    alloc-ranges:
        $ref: "/schemas/types.yaml#/definitions/uint32-matrix"
        items:
            minItems: 4
            maxItems: 4
            items:
                - $ref: "/schemas/types.yaml#/definitions/uint32"
                  minimum: 0x0
                  maximum: 0x0
                - $ref: "/schemas/types.yaml#/definitions/uint32"
                  minimum: 0x0
                  maximum: 0x0
                - $ref: "/schemas/types.yaml#/definitions/uint32"
                  minimum: 0x1
                  maximum: 0x1
                - $ref: "/schemas/types.yaml#/definitions/uint32"
                  minimum: 0x0
                  maximum: 0x0

required:
    - compatible

examples:
    - |
        fsi-carveout {
            compatible = "nvidia,fsi-carveout";
            status = "disabled";
            size = <0 0x2000000>;
            alignment = <0 0x1000>;
            no-map;
            alloc-ranges = <0x0 0x0 0x1 0x0>;
        };
```

## drivers/media/i2c/stereolabs/max9295/Kconfig
```kconfig
config SL_SER_MAX9295
	tristate "ZED-X serializer support"
	depends on I2C && VIDEO_V4L2 && VIDEO_V4L2_SUBDEV_API && ( SL_DESER_MAX96712 || SL_DESER_MAX9296 )
	help
	  This is an I2C communication driver to setup the MAX9295 serializer
	  for Stereolabs ZED-X camera lineup.

	  To compile this driver as a module, choose M here: the module
	  will be called sl_max9295.
```

## drivers/media/i2c/stereolabs/zedx/Kconfig
```kconfig
config SL_VIDEO_ZEDX
	tristate "ZED-X AR0234 camera sensor support"
	depends on I2C && VIDEO_V4L2 && VIDEO_V4L2_SUBDEV_API && ( SL_DESER_MAX96712 || SL_DESER_MAX9296 )
	help
	  This is a Video4Linux2 sensor-level driver for Stereolabs ZED-X
	  camera.

	  To compile this driver as a module, choose M here: the module
	  will be called sl_zedx.
config TEGRA_L4T_351
	bool "L4T R35.1 compatible"
	depends on SL_VIDEO_ZEDX
	default n
	help
		If you wish to compile for L4T R35.1, please check this option.
```
