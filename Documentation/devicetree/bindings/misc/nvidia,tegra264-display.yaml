## Documentation/devicetree/bindings/pci/controller/nvidia,tegra264-pcie.yaml
```yaml
# Copyright (c) 2024-2025, NVIDIA CORPORATION & AFFILIATES.  All rights reserved.
#
# This program is free software; you can redistribute it and/or modify it
# under the terms and conditions of the GNU General Public License,
# version 2, as published by the Free Software Foundation.
#
# This program is distributed in the hope it will be useful, but WITHOUT
# ANY WARRANTY; without even the implied warranty of MERCHANTABILITY or
# FITNESS FOR A PARTICULAR PURPOSE.  See the GNU General Public License for
# more details.

%YAML 1.2
---
$id: http://devicetree.org/schemas/pcie@810c000000/nvidia,tegra264-pcie.yaml#
$schema: http://devicetree.org/meta-schemas/core.yaml#

title: NVIDIA Tegra264 PCIe host controller driver

maintainers:
  - Manikanta Maddireddy

description: |
     the compatability = nvidia,tegra264-pcie is mentioned in the following drivers
        - <TOP>/kernel/nvidia-oot/drivers/pci/controller/pcie-tegra264.c

select:
  properties:
    compatible:
        minItems: 1
        maxItems: 1
        items:
            enum:
                - nvidia,tegra264-pcie

  required:
    - compatible

properties:

    compatible:
        minItems: 1
        maxItems: 1
        items:
            enum:
                - nvidia,tegra264-pcie

    reg:
        $ref: "/schemas/types.yaml#/definitions/uint32-matrix"
        description: |
            Registers are given by a tuple of two values:
                - register address:
                - register block size.
        items:
            minItems: 4
            maxItems: 4
            items:
                - $ref: "/schemas/types.yaml#/definitions/uint32"
                  minimum: 0x81
                  maximum: 0xd0
                - $ref: "/schemas/types.yaml#/definitions/uint32"
                  minimum: 0x8400000
                  maximum: 0xb0000000
                - $ref: "/schemas/types.yaml#/definitions/uint32"
                  minimum: 0x0
                  maximum: 0x0
                - $ref: "/schemas/types.yaml#/definitions/uint32"
                  minimum: 0x1000
                  maximum: 0x10000000

    reg-names:
        $ref: "/schemas/types.yaml#/definitions/string-array"
        items:
            enum:
                - xal
                - xtl
                - xtl-pri
                - ecam
                - xpl
                - xdma


    '#address-cells':
        $ref: "/schemas/types.yaml#/definitions/uint32"
        minimum: 0x3
        maximum: 0x3

    '#size-cells':
        $ref: "/schemas/types.yaml#/definitions/uint32"
        minimum: 0x2
        maximum: 0x2

    device_type:
        $ref: "/schemas/types.yaml#/definitions/string-array"
        items:
            enum:
                - pci


    linux,pci-domain:
        $ref: "/schemas/types.yaml#/definitions/uint32"
        minimum: 0x0
        maximum: 0x5

    '#interrupt-cells':
        $ref: "/schemas/types.yaml#/definitions/uint32"
        minimum: 0x1
        maximum: 0x1

    interrupt-map-mask:
        $ref: "/schemas/types.yaml#/definitions/uint32-matrix"
        items:
            minItems: 4
            maxItems: 4
            items:
                - $ref: "/schemas/types.yaml#/definitions/uint32"
                  minimum: 0x0
                  maximum: 0x0
                - $ref: "/schemas/types.yaml#/definitions/uint32"
                  minimum: 0x0
                  maximum: 0x0
                - $ref: "/schemas/types.yaml#/definitions/uint32"
                  minimum: 0x0
                  maximum: 0x0
                - $ref: "/schemas/types.yaml#/definitions/uint32"
                  minimum: 0x7
                  maximum: 0x7

    iommu-map:
        $ref: "/schemas/types.yaml#/definitions/uint32-matrix"
        items:
            minItems: 4
            maxItems: 4
            items:
                - $ref: "/schemas/types.yaml#/definitions/uint32"
                  minimum: 0x0
                  maximum: 0x0
                - $ref: "/schemas/types.yaml#/definitions/uint32"
                - $ref: "/schemas/types.yaml#/definitions/uint32"
                  minimum: 0x10000
                  maximum: 0x50000
                - $ref: "/schemas/types.yaml#/definitions/uint32"
                  minimum: 0x10000
                  maximum: 0x10000

    dma-coherent:
        $ref: "/schemas/types.yaml#/definitions/flag"

    msi-map:
        $ref: "/schemas/types.yaml#/definitions/uint32-matrix"
        items:
            minItems: 4
            maxItems: 4
            items:
                - $ref: "/schemas/types.yaml#/definitions/uint32"
                  minimum: 0x0
                  maximum: 0x0
                - $ref: "/schemas/types.yaml#/definitions/uint32"
                - $ref: "/schemas/types.yaml#/definitions/uint32"
                  minimum: 0x110000
                  maximum: 0x210000
                - $ref: "/schemas/types.yaml#/definitions/uint32"
                  minimum: 0x10000
                  maximum: 0x10000

    bus-range:
        $ref: "/schemas/types.yaml#/definitions/uint32-matrix"
        items:
            minItems: 2
            maxItems: 2
            items:
                - $ref: "/schemas/types.yaml#/definitions/uint32"
                  minimum: 0x0
                  maximum: 0x0
                - $ref: "/schemas/types.yaml#/definitions/uint32"
                  minimum: 0xff
                  maximum: 0xff

    nvidia,bpmp:
        $ref: "/schemas/types.yaml#/definitions/uint32-matrix"
        items:
            minItems: 2
            maxItems: 2
            items:
                - $ref: "/schemas/types.yaml#/definitions/uint32"
                - $ref: "/schemas/types.yaml#/definitions/uint32"
                  minimum: 0x0
                  maximum: 0x5

    numa-node-id:
        $ref: "/schemas/types.yaml#/definitions/uint32"
        minimum: 0x0
        maximum: 0x0

    ats-supported:
        $ref: "/schemas/types.yaml#/definitions/flag"

    nvidia,host1x:
        $ref: "/schemas/types.yaml#/definitions/uint32"
        minimum: 0x19
        maximum: 0x19

required:
    - compatible
    - reg

examples:
    - |
        pcie@810c000000 {
            status = "disabled";
            compatible = "nvidia,tegra264-pcie";
            reg = <0x81 0x0c000000 0x0 0x00004000>,
                  <0x81 0x0c004000 0x0 0x00001000>,
                  <0x81 0x0c005000 0x0 0x00001000>,
                  <0xd0 0xb0000000 0x0 0x10000000>;
            reg-names = "xal, xtl, xtl-pri, ecam";
            #address-cells = <0x3>;
            #size-cells = <0x2>;
            device_type = "pci";
            linux,pci-domain = <0x0>;
            #interrupt-cells = <0x1>;
            interrupt-map-mask = <0x0 0x0 0x0 0x7>;
            interrupt-map = <0x0 0x0 0x0 0x1 &gic 0x0 0x0 GIC_SPI 0x9b IRQ_TYPE_LEVEL_HIGH0x0 0x0 0x0 0x2 &gic 0x0 0x0 GIC_SPI 0x9c IRQ_TYPE_LEVEL_HIGH0x0 0x0 0x0 0x3 &gic 0x0 0x0 GIC_SPI 0x9d IRQ_TYPE_LEVEL_HIGH0x0 0x0 0x0 0x4 &gic 0x0 0x0 GIC_SPI 0x9e IRQ_TYPE_LEVEL_HIGH>;
            iommu-map = <0x0 &smmu2_mmu 0x10000 0x10000>;
            dma-coherent;
            msi-map = <0x0 &its 0x210000 0x10000>;
            bus-range = <0x0 0xff>;
            ranges = <0x82000000 0x00 0x20000000 0x00 0x20000000 0x0 0x080000000xc3000000 0xd0 0xc0000000 0xd0 0xc0000000 0x7 0xc00000000x81000000 0xd0 0x82000000 0xd0 0x82000000 0x0 0x00200000>;
            nvidia,bpmp = <&bpmp 0x0>;
            numa-node-id = <0x0>;
            ats-supported;
            nvidia,host1x = <&host1x>;
        };
```

## Documentation/devicetree/bindings/perf/arm,smmu-v3-pmcg.yaml
```yaml
# Copyright (c) 2024, NVIDIA CORPORATION & AFFILIATES.  All rights reserved.
#
# This program is free software; you can redistribute it and/or modify it
# under the terms and conditions of the GNU General Public License,
# version 2, as published by the Free Software Foundation.
#
# This program is distributed in the hope it will be useful, but WITHOUT
# ANY WARRANTY; without even the implied warranty of MERCHANTABILITY or
# FITNESS FOR A PARTICULAR PURPOSE.  See the GNU General Public License for
# more details.

%YAML 1.2
---
$id: http://devicetree.org/schemas/pmu_tcu_smmu0@810a000000/arm,smmu-v3-pmcg.yaml#
$schema: http://devicetree.org/meta-schemas/core.yaml#

title: PMU driver for ARM SMMUv3 Performance Monitors Extension

maintainers:
  - Sachin Nikam

description: |
     the compatability = arm,smmu-v3-pmcg is mentioned in the following drivers
        - <TOP>/kernel/kernel-oot/drivers/perf/arm_smmuv3_pmu.c

select:
  properties:
    compatible:
        minItems: 1
        maxItems: 1
        items:
            enum:
                - arm,smmu-v3-pmcg

  required:
    - compatible

properties:

    compatible:
        minItems: 1
        maxItems: 1
        items:
            enum:
                - arm,smmu-v3-pmcg

    reg:
        $ref: "/schemas/types.yaml#/definitions/uint32-matrix"
        description: |
            Registers are given by a tuple of two values:
                - register address:
                - register block size.
        items:
            minItems: 4
            maxItems: 4
            items:
                - $ref: "/schemas/types.yaml#/definitions/uint32"
                  minimum: 0x81
                  maximum: 0x88
                - $ref: "/schemas/types.yaml#/definitions/uint32"
                  minimum: 0x5002000
                  maximum: 0xb1b3000
                - $ref: "/schemas/types.yaml#/definitions/uint32"
                  minimum: 0x0
                  maximum: 0x0
                - $ref: "/schemas/types.yaml#/definitions/uint32"
                  minimum: 0x1000
                  maximum: 0x1000

    interrupts:
        $ref: "/schemas/types.yaml#/definitions/uint32-matrix"
        description: |
            Interrupts are give by a tuple of 3 values:
                - interrupt specifier (GIC_SPI = 0, GIC_PPI = 1)
                  definitions in dt-bindings/interrupt-controller/arm-gic.h
                - interrupt number
                - trigger type (rising edge, falling edge, both, etc)
                  definitions in dt-bindings/interrupt-controller/irq.h
        items:
            items:
                - $ref: "/schemas/types.yaml#/definitions/uint32"
                  minimum: 0x0
                  maximum: 0x0
                - $ref: "/schemas/types.yaml#/definitions/uint32"
                  minimum: 0x6
                  maximum: 0x341
                - $ref: "/schemas/types.yaml#/definitions/uint32"
                  minimum: 0x1
                  maximum: 0x1

    ceid0-override:
        $ref: "/schemas/types.yaml#/definitions/uint32-matrix"
        items:
            minItems: 2
            maxItems: 2
            items:
                - $ref: "/schemas/types.yaml#/definitions/uint32"
                  minimum: 0x0
                  maximum: 0x0
                - $ref: "/schemas/types.yaml#/definitions/uint32"
                  minimum: 0x7
                  maximum: 0x7

required:
    - compatible
    - reg
    - interrupts

examples:
    - |
        pmu_tcu_smmu0@810a000000 {
            compatible = "arm,smmu-v3-pmcg";
            status = "disabled";
            reg = <0x81 0x0a002000 0x0 0x1000>,
                  <0x81 0x0a022000 0x0 0x1000>;
            interrupts = <GIC_SPI 26 IRQ_TYPE_EDGE_RISING>;
        };
```

## Documentation/devicetree/bindings/perf/arm,smmu-v3.yaml
```yaml
# Copyright (c) 2024, NVIDIA CORPORATION & AFFILIATES.  All rights reserved.
#
# This program is free software; you can redistribute it and/or modify it
# under the terms and conditions of the GNU General Public License,
# version 2, as published by the Free Software Foundation.
#
# This program is distributed in the hope it will be useful, but WITHOUT
# ANY WARRANTY; without even the implied warranty of MERCHANTABILITY or
# FITNESS FOR A PARTICULAR PURPOSE.  See the GNU General Public License for
# more details.

%YAML 1.2
---
$id: http://devicetree.org/schemas/iommu@8105000000/arm,smmu-v3.yaml#
$schema: http://devicetree.org/meta-schemas/core.yaml#

title: IOMMU API for ARM architected SMMUv3 implementations

maintainers:
  - Ketan Patil

description: |
     the compatability = arm,smmu-v3 is mentioned in the following drivers
        - <TOP>/kernel/kernel-oot/drivers/perf/arm_smmuv3_pmu.c
        - <TOP>/kernel/kernel-oot/drivers/iommu/arm/arm-smmu-v3/arm-smmu-v3.c

     The following nodes use this compatibility
        - /bus@0/iommu@8105000000
        - /bus@0/iommu@8106000000
        - /bus@0/iommu@810a000000
        - /bus@0/iommu@810b000000
        - /bus@0/iommu@8806000000

select:
  properties:
    compatible:
        minItems: 1
        maxItems: 1
        items:
            enum:
                - arm,smmu-v3

  required:
    - compatible

properties:

    reg:
        $ref: "/schemas/types.yaml#/definitions/uint32-matrix"
        description: |
            Registers are given by a tuple of two values:
                - register address:
                - register block size.
        items:
            minItems: 4
            maxItems: 4
            items:
                - $ref: "/schemas/types.yaml#/definitions/uint32"
                  minimum: 0x81
                  maximum: 0x88
                - $ref: "/schemas/types.yaml#/definitions/uint32"
                  minimum: 0x5000000
                  maximum: 0xb000000
                - $ref: "/schemas/types.yaml#/definitions/uint32"
                  minimum: 0x0
                  maximum: 0x0
                - $ref: "/schemas/types.yaml#/definitions/uint32"
                  minimum: 0x200000
                  maximum: 0x200000

    interrupts:
        $ref: "/schemas/types.yaml#/definitions/uint32-matrix"
        description: |
            Interrupts are give by a tuple of 3 values:
                - interrupt specifier (GIC_SPI = 0, GIC_PPI = 1)
                  definitions in dt-bindings/interrupt-controller/arm-gic.h
                - interrupt number
                - trigger type (rising edge, falling edge, both, etc)
                  definitions in dt-bindings/interrupt-controller/irq.h
        items:
            items:
                - $ref: "/schemas/types.yaml#/definitions/uint32"
                  minimum: 0x0
                  maximum: 0x0
                - $ref: "/schemas/types.yaml#/definitions/uint32"
                  minimum: 0x1
                  maximum: 0xe2
                - $ref: "/schemas/types.yaml#/definitions/uint32"
                  minimum: 0x1
                  maximum: 0x1

    interrupt-names:
        $ref: "/schemas/types.yaml#/definitions/string-array"
        items:
            enum:
                - eventq
                - gerror


    dma-coherent:
        $ref: "/schemas/types.yaml#/definitions/flag"

    '#iommu-cells':
        $ref: "/schemas/types.yaml#/definitions/uint32"
        minimum: 0x1
        maximum: 0x1

    numa-node-id:
        $ref: "/schemas/types.yaml#/definitions/uint32"
        minimum: 0x0
        maximum: 0x0

required:
    - compatible
    - reg
    - interrupts
    - interrupt-names

examples:
    - |
        iommu@8105000000 {
            compatible = "arm,smmu-v3";
            status = "disabled";
            reg = <0x81 0x5000000 0x00 0x200000>;
            interrupts = <GIC_SPI 12 IRQ_TYPE_EDGE_RISING>,
                         <GIC_SPI 13 IRQ_TYPE_EDGE_RISING>;
            interrupt-names = "eventq",
                              "gerror";
            dma-coherent;
            #iommu-cells = <1>;
            numa-node-id = <0>;
        };
```
