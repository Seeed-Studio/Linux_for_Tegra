## Documentation/devicetree/bindings/perf/arm,statistical-profiling-extension-v1.yaml
```yaml
# Copyright (c) 2024, NVIDIA CORPORATION & AFFILIATES.  All rights reserved.
#
# This program is free software; you can redistribute it and/or modify it
# under the terms and conditions of the GNU General Public License,
# version 2, as published by the Free Software Foundation.
#
# This program is distributed in the hope it will be useful, but WITHOUT
# ANY WARRANTY; without even the implied warranty of MERCHANTABILITY or
# FITNESS FOR A PARTICULAR PURPOSE.  See the GNU General Public License for
# more details.

%YAML 1.2
---
$id: http://devicetree.org/schemas/spe-pmu/arm,statistical-profiling-extension-v1.yaml#
$schema: http://devicetree.org/meta-schemas/core.yaml#

title: Perf driver for the ARMv8.2 Statistical Profiling Extension

maintainers:
  - Besar Wicaksono

description: |
     the compatability = arm,statistical-profiling-extension-v1 is mentioned in the following drivers
        - <TOP>/kernel/kernel-oot/drivers/perf/arm_spe_pmu.c

     The following nodes use this compatibility
        - /spe-pmu

select:
  properties:
    compatible:
        minItems: 1
        maxItems: 1
        items:
            enum:
                - arm,statistical-profiling-extension-v1

  required:
    - compatible

properties:

    interrupts:
        $ref: "/schemas/types.yaml#/definitions/uint32-matrix"
        description: |
            Interrupts are give by a tuple of 3 values:
                - interrupt specifier (GIC_SPI = 0, GIC_PPI = 1)
                  definitions in dt-bindings/interrupt-controller/arm-gic.h
                - interrupt number
                - trigger type (rising edge, falling edge, both, etc)
                  definitions in dt-bindings/interrupt-controller/irq.h
        items:
            items:
                - $ref: "/schemas/types.yaml#/definitions/uint32"
                  minimum: 0x1
                  maximum: 0x1
                - $ref: "/schemas/types.yaml#/definitions/uint32"
                  minimum: 0x5
                  maximum: 0x5
                - $ref: "/schemas/types.yaml#/definitions/uint32"
                  minimum: 0x8
                  maximum: 0x8

required:
    - compatible
    - interrupts

examples:
    - |
        spe-pmu {
            compatible = "arm,statistical-profiling-extension-v1";
            interrupts = <GIC_PPI 5 8>;
            status = "disabled";
        };
```

## Documentation/devicetree/bindings/perf/arm_cspmu/arm,coresight-pmu.yaml
```yaml
# Copyright (c) 2024, NVIDIA CORPORATION & AFFILIATES.  All rights reserved.
#
# This program is free software; you can redistribute it and/or modify it
# under the terms and conditions of the GNU General Public License,
# version 2, as published by the Free Software Foundation.
#
# This program is distributed in the hope it will be useful, but WITHOUT
# ANY WARRANTY; without even the implied warranty of MERCHANTABILITY or
# FITNESS FOR A PARTICULAR PURPOSE.  See the GNU General Public License for
# more details.

%YAML 1.2
---
$id: http://devicetree.org/schemas/ucf_uapmu@140c0000/arm,coresight-pmu.yaml#
$schema: http://devicetree.org/meta-schemas/core.yaml#

title: Coresight Performance Monitoring Unit (PMU)

maintainers:
  - Besar Wicaksono

description: |
     the compatability = arm,coresight-pmu is mentioned in the following drivers
        - <TOP>/kernel/kernel-oot/drivers/perf/arm_cspmu/arm_cspmu.c

     The following nodes use this compatibility
        - /ucf_uapmu@140c0000
        - /disp_usb_apmu@8808900000
        - /ucf_gpu_apmu@810c248000
        - /uphy_apmu@a808880000
        - /vision_apmu@818a000000

select:
  properties:
    compatible:
        minItems: 1
        maxItems: 1
        items:
            enum:
                - arm,coresight-pmu

  required:
    - compatible

properties:

    reg:
        $ref: "/schemas/types.yaml#/definitions/uint32-matrix"
        description: |
            Registers are given by a tuple of two values:
                - register address:
                - register block size.
        items:
            minItems: 4
            maxItems: 4
            items:
                - $ref: "/schemas/types.yaml#/definitions/uint32"
                  minimum: 0x0
                  maximum: 0xa8
                - $ref: "/schemas/types.yaml#/definitions/uint32"
                  minimum: 0x8880000
                  maximum: 0x8a000000
                - $ref: "/schemas/types.yaml#/definitions/uint32"
                  minimum: 0x0
                  maximum: 0x0
                - $ref: "/schemas/types.yaml#/definitions/uint32"
                  minimum: 0x1000
                  maximum: 0x1000

    cpus:
        $ref: "/schemas/types.yaml#/definitions/uint32"

    interrupts:
        $ref: "/schemas/types.yaml#/definitions/uint32-matrix"
        description: |
            Interrupts are give by a tuple of 3 values:
                - interrupt specifier (GIC_SPI = 0, GIC_PPI = 1)
                  definitions in dt-bindings/interrupt-controller/arm-gic.h
                - interrupt number
                - trigger type (rising edge, falling edge, both, etc)
                  definitions in dt-bindings/interrupt-controller/irq.h
        items:
            items:
                - $ref: "/schemas/types.yaml#/definitions/uint32"
                  minimum: 0x0
                  maximum: 0x0
                - $ref: "/schemas/types.yaml#/definitions/uint32"
                  minimum: 0x33
                  maximum: 0x342
                - $ref: "/schemas/types.yaml#/definitions/uint32"
                  minimum: 0x4
                  maximum: 0x4

required:
    - compatible
    - reg
    - interrupts

examples:
    - |
        ucf_uapmu@140c0000 {
            compatible = "arm,coresight-pmu";
            status = "disabled";
            reg = <0x0 0x140c0000 0x0 0x1000>;
            cpus = <&cpu_0>,
                   < &cpu_1>,
                   < &cpu_2>,
                   < &cpu_3>,
                   <&cpu_4>,
                   < &cpu_5>,
                   < &cpu_6>,
                   < &cpu_7>,
                   <&cpu_8>,
                   < &cpu_9>,
                   < &cpu_10>,
                   < &cpu_11>,
                   <&cpu_12>,
                   < &cpu_13>;
            interrupts = <GIC_SPI 51 IRQ_TYPE_LEVEL_HIGH>;
        };
```

## Documentation/devicetree/bindings/phy/tegra/nvidia,tegra264-xusb-padctl.yaml
```yaml
# Copyright (c) 2024, NVIDIA CORPORATION & AFFILIATES.  All rights reserved.
#
# This program is free software; you can redistribute it and/or modify it
# under the terms and conditions of the GNU General Public License,
# version 2, as published by the Free Software Foundation.
#
# This program is distributed in the hope it will be useful, but WITHOUT
# ANY WARRANTY; without even the implied warranty of MERCHANTABILITY or
# FITNESS FOR A PARTICULAR PURPOSE.  See the GNU General Public License for
# more details.

%YAML 1.2
---
$id: http://devicetree.org/schemas/padctl@a808680000/nvidia,tegra264-xusb-padctl.yaml#
$schema: http://devicetree.org/meta-schemas/core.yaml#

title: Tegra XUSB Pad Controller driver

maintainers:
  - Sing HanChen

description: |
     the compatability = nvidia,tegra264-xusb-padctl is mentioned in the following drivers
        - <TOP>/kernel/kernel-oot/drivers/phy/tegra/xusb.c

     The following nodes use this compatibility
        - /bus@0/padctl@a808680000

select:
  properties:
    compatible:
        minItems: 1
        maxItems: 1
        items:
            enum:
                - nvidia,tegra264-xusb-padctl

  required:
    - compatible

properties:

    reg:
        $ref: "/schemas/types.yaml#/definitions/uint32-matrix"
        description: |
            Registers are given by a tuple of two values:
                - register address:
                - register block size.
        items:
            minItems: 4
            maxItems: 4
            items:
                - $ref: "/schemas/types.yaml#/definitions/uint32"
                  minimum: 0xa8
                  maximum: 0xa8
                - $ref: "/schemas/types.yaml#/definitions/uint32"
                  minimum: 0x8680000
                  maximum: 0x86a0000
                - $ref: "/schemas/types.yaml#/definitions/uint32"
                  minimum: 0x0
                  maximum: 0x0
                - $ref: "/schemas/types.yaml#/definitions/uint32"
                  minimum: 0x10000
                  maximum: 0x20000

    reg-names:
        $ref: "/schemas/types.yaml#/definitions/string-array"
        items:
            enum:
                - padctl
                - ao


    interrupts:
        $ref: "/schemas/types.yaml#/definitions/uint32-matrix"
        description: |
            Interrupts are give by a tuple of 3 values:
                - interrupt specifier (GIC_SPI = 0, GIC_PPI = 1)
                  definitions in dt-bindings/interrupt-controller/arm-gic.h
                - interrupt number
                - trigger type (rising edge, falling edge, both, etc)
                  definitions in dt-bindings/interrupt-controller/irq.h
        items:
            items:
                - $ref: "/schemas/types.yaml#/definitions/uint32"
                  minimum: 0x2
                  maximum: 0x2
                - $ref: "/schemas/types.yaml#/definitions/uint32"
                  minimum: 0x5
                  maximum: 0x5
                - $ref: "/schemas/types.yaml#/definitions/uint32"
                  minimum: 0x4
                  maximum: 0x4

    resets:
        $ref: "/schemas/types.yaml#/definitions/uint32-matrix"
        description: |
            Resets are given by a tuple of 2 values:
                - Phandle to the device
                - Reset ID
        items:
            minItems: 2
            maxItems: 2
            items:
                - $ref: "/schemas/types.yaml#/definitions/uint32"
                - $ref: "/schemas/types.yaml#/definitions/uint32"
                  minimum: 0x4d
                  maximum: 0x4d

    reset-names:
        $ref: "/schemas/types.yaml#/definitions/string-array"
        items:
            enum:
                - padctl


required:
    - compatible
    - reg
    - interrupts
    - resets
    - reset-names

examples:
    - |
        padctl@a808680000 {
            compatible = "nvidia,tegra264-xusb-padctl";
            reg = <0xa8 0x8680000 0x00 0x20000>,
                  <0xa8 0x86a0000 0x00 0x10000>;
            reg-names = "padctl, ao";
            interrupts = <2 5 IRQ_TYPE_LEVEL_HIGH>;
            resets = <&bpmp TEGRA264_RESET_XUSB1_PADCTL>;
            reset-names = "padctl";
            status = "disabled";
        };
```
