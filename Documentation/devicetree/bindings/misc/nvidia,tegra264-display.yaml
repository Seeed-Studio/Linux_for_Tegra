## Documentation/devicetree/bindings/pci/controller/arm,gic-v3-its.yaml
```yaml
# Copyright (c) 2024, NVIDIA CORPORATION & AFFILIATES.  All rights reserved.
#
# This program is free software; you can redistribute it and/or modify it
# under the terms and conditions of the GNU General Public License,
# version 2, as published by the Free Software Foundation.
#
# This program is distributed in the hope it will be useful, but WITHOUT
# ANY WARRANTY; without even the implied warranty of MERCHANTABILITY or
# FITNESS FOR A PARTICULAR PURPOSE.  See the GNU General Public License for
# more details.

%YAML 1.2
---
$id: http://devicetree.org/schemas/its@8146040000/arm,gic-v3-its.yaml#
$schema: http://devicetree.org/meta-schemas/core.yaml#

title: ARM GIC Interrupt Controller Chip

maintainers:
  - Suresh Mangipudi

description: |
     the compatability = arm,gic-v3-its is mentioned in the following drivers
        - <TOP>/kernel/kernel-oot/drivers/pci/controller/pcie-iproc.c
        - <TOP>/kernel/kernel-oot/drivers/irqchip/irq-gic-v3-its-fsl-mc-msi.c
        - <TOP>/kernel/kernel-oot/drivers/irqchip/irq-gic-v3-its-platform-msi.c
        - <TOP>/kernel/kernel-oot/drivers/irqchip/irq-gic-v3-its.c
        - <TOP>/kernel/kernel-oot/drivers/irqchip/irq-gic-v3-its-pci-msi.c

     The following nodes use this compatibility
        - /interrupt-controller@8146000000/its@8146040000

select:
  properties:
    compatible:
        minItems: 1
        maxItems: 1
        items:
            enum:
                - arm,gic-v3-its

  required:
    - compatible

properties:

    msi-controller:
        $ref: "/schemas/types.yaml#/definitions/flag"

    '#msi-cells':
        $ref: "/schemas/types.yaml#/definitions/uint32"
        minimum: 0x1
        maximum: 0x1

    reg:
        $ref: "/schemas/types.yaml#/definitions/uint32-matrix"
        description: |
            Registers are given by a tuple of two values:
                - register address:
                - register block size.
        items:
            minItems: 4
            maxItems: 4
            items:
                - $ref: "/schemas/types.yaml#/definitions/uint32"
                  minimum: 0x81
                  maximum: 0x81
                - $ref: "/schemas/types.yaml#/definitions/uint32"
                  minimum: 0x46040000
                  maximum: 0x46040000
                - $ref: "/schemas/types.yaml#/definitions/uint32"
                  minimum: 0x0
                  maximum: 0x0
                - $ref: "/schemas/types.yaml#/definitions/uint32"
                  minimum: 0x40000
                  maximum: 0x40000

    numa-node-id:
        $ref: "/schemas/types.yaml#/definitions/uint32"
        minimum: 0x0
        maximum: 0x0

required:
    - compatible
    - reg

examples:
    - |
        its@8146040000 {
            compatible = "arm,gic-v3-its";
            status = "disabled";
            msi-controller;
            reg = <0x81 0x46040000 0x0 0x40000>;
            numa-node-id = <0>;
        };
```

## Documentation/devicetree/bindings/pci/controller/arm,gic-v3.yaml
```yaml
# Copyright (c) 2024, NVIDIA CORPORATION & AFFILIATES.  All rights reserved.
#
# This program is free software; you can redistribute it and/or modify it
# under the terms and conditions of the GNU General Public License,
# version 2, as published by the Free Software Foundation.
#
# This program is distributed in the hope it will be useful, but WITHOUT
# ANY WARRANTY; without even the implied warranty of MERCHANTABILITY or
# FITNESS FOR A PARTICULAR PURPOSE.  See the GNU General Public License for
# more details.

%YAML 1.2
---
$id: http://devicetree.org/schemas/interrupt-controller@8146000000/arm,gic-v3.yaml#
$schema: http://devicetree.org/meta-schemas/core.yaml#

title: ARM GIC Interrupt Controller Chip

maintainers:
  - Suresh Mangipudi

description: |
     the compatability = arm,gic-v3 is mentioned in the following drivers
        - <TOP>/kernel/kernel-oot/drivers/pci/controller/pcie-iproc.c
        - <TOP>/kernel/kernel-oot/drivers/irqchip/irq-gic-v3-its-fsl-mc-msi.c
        - <TOP>/kernel/kernel-oot/drivers/irqchip/irq-gic-v3-its-platform-msi.c
        - <TOP>/kernel/kernel-oot/drivers/irqchip/irq-ti-sci-inta.c
        - <TOP>/kernel/kernel-oot/drivers/irqchip/irq-gic-v3-its.c
        - <TOP>/kernel/kernel-oot/drivers/irqchip/irq-gic-v3-its-pci-msi.c
        - <TOP>/kernel/kernel-oot/drivers/irqchip/irq-gic-v3.c
        - <TOP>/kernel/kernel-oot/drivers/irqchip/irq-ti-sci-intr.c

     The following nodes use this compatibility
        - /interrupt-controller@8146000000

select:
  properties:
    compatible:
        minItems: 1
        maxItems: 1
        items:
            enum:
                - arm,gic-v3

  required:
    - compatible

properties:

    '#interrupt-cells':
        $ref: "/schemas/types.yaml#/definitions/uint32"
        minimum: 0x3
        maximum: 0x3

    '#address-cells':
        $ref: "/schemas/types.yaml#/definitions/uint32"
        minimum: 0x2
        maximum: 0x2

    '#size-cells':
        $ref: "/schemas/types.yaml#/definitions/uint32"
        minimum: 0x2
        maximum: 0x2

    '#redistributor-regions':
        $ref: "/schemas/types.yaml#/definitions/uint32"
        minimum: 0x1
        maximum: 0x1

    interrupt-controller:
        $ref: "/schemas/types.yaml#/definitions/flag"

    reg:
        $ref: "/schemas/types.yaml#/definitions/uint32-matrix"
        description: |
            Registers are given by a tuple of two values:
                - register address:
                - register block size.
        items:
            minItems: 4
            maxItems: 4
            items:
                - $ref: "/schemas/types.yaml#/definitions/uint32"
                  minimum: 0x81
                  maximum: 0x81
                - $ref: "/schemas/types.yaml#/definitions/uint32"
                  minimum: 0x46000000
                  maximum: 0x46080000
                - $ref: "/schemas/types.yaml#/definitions/uint32"
                  minimum: 0x0
                  maximum: 0x0
                - $ref: "/schemas/types.yaml#/definitions/uint32"
                  minimum: 0x10000
                  maximum: 0x400000

    interrupt-parent:
        $ref: "/schemas/types.yaml#/definitions/uint32"

    interrupts:
        $ref: "/schemas/types.yaml#/definitions/uint32-matrix"
        description: |
            Interrupts are give by a tuple of 3 values:
                - interrupt specifier (GIC_SPI = 0, GIC_PPI = 1)
                  definitions in dt-bindings/interrupt-controller/arm-gic.h
                - interrupt number
                - trigger type (rising edge, falling edge, both, etc)
                  definitions in dt-bindings/interrupt-controller/irq.h
        items:
            items:
                - $ref: "/schemas/types.yaml#/definitions/uint32"
                  minimum: 0x1
                  maximum: 0x1
                - $ref: "/schemas/types.yaml#/definitions/uint32"
                  minimum: 0x9
                  maximum: 0x9
                - $ref: "/schemas/types.yaml#/definitions/uint32"
                  minimum: 0x8
                  maximum: 0x8

    redistributor-stride:
        $ref: "/schemas/types.yaml#/definitions/uint32-matrix"
        items:
            minItems: 2
            maxItems: 2
            items:
                - $ref: "/schemas/types.yaml#/definitions/uint32"
                  minimum: 0x0
                  maximum: 0x0
                - $ref: "/schemas/types.yaml#/definitions/uint32"
                  minimum: 0x40000
                  maximum: 0x40000

required:
    - compatible
    - reg
    - interrupts

examples:
    - |
        interrupt-controller@8146000000 {
            compatible = "arm,gic-v3";
            status = "disabled";
            #interrupt-cells = <3>;
            #address-cells = <2>;
            #size-cells = <2>;
            interrupt-controller;
            reg = <0x81 0x46000000 0x0 0x010000>,
                  <0x81 0x46080000 0x0 0x00400000>;
            interrupt-parent = <&gic>;
            interrupts = <GIC_PPI 9 8>;
            redistributor-stride = <0x00 0x40000>;
            ranges;
        };
```

## Documentation/devicetree/bindings/pci/controller/nvidia,tegra264-pcie-ep.yaml
```yaml
# Copyright (c) 2024-2025, NVIDIA CORPORATION & AFFILIATES.  All rights reserved.
#
# This program is free software; you can redistribute it and/or modify it
# under the terms and conditions of the GNU General Public License,
# version 2, as published by the Free Software Foundation.
#
# This program is distributed in the hope it will be useful, but WITHOUT
# ANY WARRANTY; without even the implied warranty of MERCHANTABILITY or
# FITNESS FOR A PARTICULAR PURPOSE.  See the GNU General Public License for
# more details.

%YAML 1.2
---
$id: http://devicetree.org/schemas/pcie-ep@a808420000/nvidia,tegra264-pcie-ep.yaml#
$schema: http://devicetree.org/meta-schemas/core.yaml#

title: NVIDIA Tegra264 PCIe EP controller driver

maintainers:
  - Manikanta Madireddy

description: |
     the compatability = nvidia,tegra264-pcie-ep is mentioned in the following drivers
        - <TOP>/kernel/nvidia-oot/drivers/pci/controller/pcie-tegra264-ep.c

select:
  properties:
    compatible:
        minItems: 1
        maxItems: 1
        items:
            enum:
                - nvidia,tegra264-pcie-ep

  required:
    - compatible

properties:

    compatible:
        minItems: 1
        maxItems: 1
        items:
            enum:
                - nvidia,tegra264-pcie-ep

    reg:
        $ref: "/schemas/types.yaml#/definitions/uint32-matrix"
        description: |
            Registers are given by a tuple of two values:
                - register address:
                - register block size.
        items:
            minItems: 4
            maxItems: 4
            items:
                - $ref: "/schemas/types.yaml#/definitions/uint32"
                  minimum: 0xa8
                  maximum: 0xc8
                - $ref: "/schemas/types.yaml#/definitions/uint32"
                  minimum: 0x8420000
                  maximum: 0x80000000
                - $ref: "/schemas/types.yaml#/definitions/uint32"
                  minimum: 0x0
                  maximum: 0x8
                - $ref: "/schemas/types.yaml#/definitions/uint32"
                  minimum: 0x0
                  maximum: 0x10000

    reg-names:
        $ref: "/schemas/types.yaml#/definitions/string-array"
        items:
            enum:
                - xal
                - xal-ep-dm
                - xtl-ep-pri
                - xtl-ep-cfg
                - xdma
                - xpl
                - addr_space


    interrupts:
        $ref: "/schemas/types.yaml#/definitions/uint32-matrix"
        description: |
            Interrupts are give by a tuple of 3 values:
                - interrupt specifier (GIC_SPI = 0, GIC_PPI = 1)
                  definitions in dt-bindings/interrupt-controller/arm-gic.h
                - interrupt number
                - trigger type (rising edge, falling edge, both, etc)
                  definitions in dt-bindings/interrupt-controller/irq.h
        items:
            items:
                - $ref: "/schemas/types.yaml#/definitions/uint32"
                  minimum: 0x0
                  maximum: 0x0
                - $ref: "/schemas/types.yaml#/definitions/uint32"
                  minimum: 0x392
                  maximum: 0x3ad
                - $ref: "/schemas/types.yaml#/definitions/uint32"
                  minimum: 0x4
                  maximum: 0x4

    interrupt-names:
        $ref: "/schemas/types.yaml#/definitions/string-array"
        items:
            enum:
                - intr


    '#address-cells':
        $ref: "/schemas/types.yaml#/definitions/uint32"
        minimum: 0x3
        maximum: 0x3

    '#size-cells':
        $ref: "/schemas/types.yaml#/definitions/uint32"
        minimum: 0x2
        maximum: 0x2

    pinctrl-names:
        $ref: "/schemas/types.yaml#/definitions/string-array"
        items:
            enum:
                - default


    pinctrl-0:
        $ref: "/schemas/types.yaml#/definitions/uint32"
        minimum: 0x1d
        maximum: 0x1d

    reset-gpios:
        $ref: "/schemas/types.yaml#/definitions/uint32-matrix"
        items:
            minItems: 3
            maxItems: 3
            items:
                - $ref: "/schemas/types.yaml#/definitions/uint32"
                - $ref: "/schemas/types.yaml#/definitions/uint32"
                  minimum: 0xb
                  maximum: 0x1b
                - $ref: "/schemas/types.yaml#/definitions/uint32"
                  minimum: 0x1
                  maximum: 0x1

    iommus:
        $ref: "/schemas/types.yaml#/definitions/uint32-matrix"
        items:
            minItems: 2
            maxItems: 2
            items:
                - $ref: "/schemas/types.yaml#/definitions/uint32"
                - $ref: "/schemas/types.yaml#/definitions/uint32"
                  minimum: 0x20000
                  maximum: 0x50000

    dma-coherent:
        $ref: "/schemas/types.yaml#/definitions/flag"

    msi-parent:
        $ref: "/schemas/types.yaml#/definitions/uint32-matrix"
        items:
            minItems: 2
            maxItems: 2
            items:
                - $ref: "/schemas/types.yaml#/definitions/uint32"
                - $ref: "/schemas/types.yaml#/definitions/uint32"
                  minimum: 0x120000
                  maximum: 0x150000

    linux,pci-domain:
        $ref: "/schemas/types.yaml#/definitions/uint32"
        minimum: 0x2
        maximum: 0x5

    nvidia,bpmp:
        $ref: "/schemas/types.yaml#/definitions/uint32-matrix"
        items:
            minItems: 2
            maxItems: 2
            items:
                - $ref: "/schemas/types.yaml#/definitions/uint32"
                - $ref: "/schemas/types.yaml#/definitions/uint32"
                  minimum: 0x2
                  maximum: 0x5

    numa-node-id:
        $ref: "/schemas/types.yaml#/definitions/uint32"
        minimum: 0x0
        maximum: 0x0

    nvidia,pex-prsnt-gpios:
        $ref: "/schemas/types.yaml#/definitions/uint32"
        minimum: 0x1
        maximum: 0x1e

required:
    - compatible
    - reg
    - interrupts
    - interrupt-names

examples:
    - |
        pcie-ep@a808420000 {
            status = "disabled";
            compatible = "nvidia,tegra264-pcie-ep";
            reg = <0xa8 0x08420000 0x0 0x00004000>,
                  <0xa8 0x08500000 0x0 0x00001000>,
                  <0xa8 0x08510000 0x0 0x00001000>,
                  <0xa8 0x08511000 0x0 0x00001000>,
                  <0xa8 0x08520000 0x0 0x00010000>,
                  <0xa8 0x08430000 0x0 0x00010000>,
                  <0xb0 0x80000000 0x8 0x00000000>;
            reg-names = "xal, xal-ep-dm, xtl-ep-pri, xtl-ep-cfg, xdma, xpl, addr_space";
            interrupts = <GIC_SPI 0x392 IRQ_TYPE_LEVEL_HIGH>;
            interrupt-names = "intr";
            #address-cells = <0x3>;
            #size-cells = <0x2>;
            pinctrl-names = "default";
            pinctrl-0 = <&pex_rst_c2_in_state>;
            reset-gpios = <&gpio_uphy TEGRA264_UPHY_GPIO(B3) GPIO_ACTIVE_LOW>;
            iommus = <&smmu1_mmu 0x20000>;
            dma-coherent;
            msi-parent = <&its 0x120000>;
            linux,pci-domain = <0x2>;
            nvidia,bpmp = <&bpmp 0x2>;
            numa-node-id = <0x0>;
        };
```
