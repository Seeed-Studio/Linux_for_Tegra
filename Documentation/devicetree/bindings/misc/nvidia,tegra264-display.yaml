## Documentation/devicetree/bindings/misc/nvscic2c-pcie/nvidia,tegra-nvscic2c-pcie-epf.yaml
```yaml
# Copyright (c) 2024, NVIDIA CORPORATION & AFFILIATES.  All rights reserved.
#
# This program is free software; you can redistribute it and/or modify it
# under the terms and conditions of the GNU General Public License,
# version 2, as published by the Free Software Foundation.
#
# This program is distributed in the hope it will be useful, but WITHOUT
# ANY WARRANTY; without even the implied warranty of MERCHANTABILITY or
# FITNESS FOR A PARTICULAR PURPOSE.  See the GNU General Public License for
# more details.

%YAML 1.2
---
$id: http://devicetree.org/schemas/nvscic2c-pcie-s0-c4-epf/nvidia,tegra-nvscic2c-pcie-epf.yaml#
$schema: http://devicetree.org/meta-schemas/core.yaml#

title: NVIDIA Chip-to-Chip transfer module for PCIeEP

maintainers:
  - Manikanta Maddireddy

description: |
     the compatability = nvidia,tegra-nvscic2c-pcie-epf is mentioned in the following drivers
        - <TOP>/kernel/nvidia-oot/drivers/misc/nvscic2c-pcie/dt.c

     The following nodes use this compatibility
        - /nvscic2c-pcie-s0-c4-epf

select:
  properties:
    compatible:
        minItems: 1
        maxItems: 1
        items:
            enum:
                - nvidia,tegra-nvscic2c-pcie-epf

  required:
    - compatible

properties:

    nvidia,host1x:
        $ref: "/schemas/types.yaml#/definitions/uint32"
        minimum: 0x19
        maximum: 0x19

    nvidia,pcie-edma:
        $ref: "/schemas/types.yaml#/definitions/uint32"
        minimum: 0x7c
        maximum: 0x7c

    nvidia,pci-dev-id:
        $ref: "/schemas/types.yaml#/definitions/uint32"
        minimum: 0x22cc
        maximum: 0x22cc

    nvidia,board-id:
        $ref: "/schemas/types.yaml#/definitions/uint32"
        minimum: 0x0
        maximum: 0x0

    nvidia,soc-id:
        $ref: "/schemas/types.yaml#/definitions/uint32"
        minimum: 0x0
        maximum: 0x0

    nvidia,cntrlr-id:
        $ref: "/schemas/types.yaml#/definitions/uint32"
        minimum: 0x4
        maximum: 0x5

    nvidia,bar-win-size:
        $ref: "/schemas/types.yaml#/definitions/uint32"
        minimum: 0x40000000
        maximum: 0x40000000

    nvidia,endpoint-db:
        $ref: "/schemas/types.yaml#/definitions/string-array"
        items:
            enum:
                - nvscic2c_pcie_s0_c4_1,   16,  00032768, 67108864, 26101
                - nvscic2c_pcie_s0_c4_2,   16,  00032768, 67108864, 26102
                - nvscic2c_pcie_s0_c4_3,   16,  00032768, 67108864, 26103
                - nvscic2c_pcie_s0_c4_4,   16,  00032768, 67108864, 26104
                - nvscic2c_pcie_s0_c4_5,   16,  00032768, 67108864, 26105
                - nvscic2c_pcie_s0_c4_6,   16,  00032768, 67108864, 26106
                - nvscic2c_pcie_s0_c4_7,   16,  00032768, 67108864, 26107
                - nvscic2c_pcie_s0_c4_8,   16,  00032768, 67108864, 26108
                - nvscic2c_pcie_s0_c4_9,   16,  00032768, 67108864, 26109
                - nvscic2c_pcie_s0_c4_10,  16,  00032768, 67108864, 26110
                - nvscic2c_pcie_s0_c4_11,  16,  00032768, 67108864, 26111
                - nvscic2c_pcie_s0_c4_12,  16,  00000064, 0, 26112


required:
    - compatible

examples:
    - |
        nvscic2c-pcie-s0-c4-epf {
        };
```

## Documentation/devicetree/bindings/mtd/devices/nvidia,tegra-virt-mtd-storage.yaml
```yaml
# Copyright (c) 2024, NVIDIA CORPORATION & AFFILIATES.  All rights reserved.
#
# This program is free software; you can redistribute it and/or modify it
# under the terms and conditions of the GNU General Public License,
# version 2, as published by the Free Software Foundation.
#
# This program is distributed in the hope it will be useful, but WITHOUT
# ANY WARRANTY; without even the implied warranty of MERCHANTABILITY or
# FITNESS FOR A PARTICULAR PURPOSE.  See the GNU General Public License for
# more details.

%YAML 1.2
---
$id: http://devicetree.org/schemas/tegra_virt_storage83/nvidia,tegra-virt-mtd-storage.yaml#
$schema: http://devicetree.org/meta-schemas/core.yaml#

title: Nvidia Tegra t264 Hypervisor MTD Driver

maintainers:
  - Sreenivas Velpula

description: |
     the compatability = nvidia,tegra-virt-mtd-storage is mentioned in the following drivers
        - <TOP>/kernel/nvidia-oot/drivers/mtd/devices/tegra_hv_mtd.c

select:
  properties:
    compatible:
        minItems: 1
        maxItems: 1
        items:
            enum:
                - nvidia,tegra-virt-mtd-storage

  required:
    - compatible

properties:

    compatible:
        minItems: 1
        maxItems: 1
        items:
            enum:
                - nvidia,tegra-virt-mtd-storage

    instance:
        $ref: "/schemas/types.yaml#/definitions/uint32"
        minimum: 0x0
        maximum: 0x0

    ivc:
        $ref: "/schemas/types.yaml#/definitions/uint32"
        minimum: 0xf
        maximum: 0x3f

    read-only:
        $ref: "/schemas/types.yaml#/definitions/flag"

    mempool:
        $ref: "/schemas/types.yaml#/definitions/uint32"
        minimum: 0x17
        maximum: 0x17

    partition-name:
        $ref: "/schemas/types.yaml#/definitions/string-array"
        items:
            enum:
                - board-info


required:
    - compatible

examples:
    - |
        tegra_virt_storage83 {
            compatible = "nvidia,tegra-virt-mtd-storage";
            status = "okay";
            instance = <0x00000000>;
            ivc = <0x0000000f>,
                  <0x0000003f>;
            read-only;
            mempool = <0x00000017>;
            partition-name = "board-info";
        };
```

## Documentation/devicetree/bindings/net/nvidia,nv-vsock.yaml
```yaml
# SPDX-License-Identifier: (GPL-2.0-only OR BSD-2-Clause)
# SPDX-FileCopyrightText: Copyright (c) 2025 NVIDIA CORPORATION & AFFILIATES. All rights reserved.
%YAML 1.2
---
$id: http://devicetree.org/schemas/net/nvidia,nv-vsock.yaml#
$schema: http://devicetree.org/meta-schemas/core.yaml#

title: NVIDIA Virtual Socket (nv_vsock) Transport

maintainers:
  - NVIDIA Corporation <linux-tegra@nvidia.com>

description: |
  The NVIDIA Virtual Socket (nv_vsock) transport provides a custom
  implementation of the AF_VSOCK protocol for NVIDIA platforms using
  Inter-VM Communication (IVC) channels for VM to VM communication.

properties:
  compatible:
    const: nvidia,nv-vsock

  guest-cid:
    $ref: /schemas/types.yaml#/definitions/uint32
    description: |
      Context ID (CID) for the guest VM. This is REQUIRED and specifies
      the CID that this VM will use for VSOCK communication. It is recommended
      to use guest-cids >= 3.

  max-rx-buffer-size:
    $ref: /schemas/types.yaml#/definitions/uint32
    description: |
      Maximum RX buffer size per socket in bytes. This controls the
      maximum amount of data that can be queued for each socket to
      prevent memory exhaustion. Must be a power of 2. If not specified,
      defaults to 256KB (262144 bytes).

  ivc-queues:
    type: object
    description: |
      REQUIRED: IVC queue mappings for different CIDs. Each entry specifies
      the IVC queue ID to use for communication with a specific CID.
      The driver will fail to load if this node is not present.
      Note: A guest does not need an IVC queue to itself (loopback).
    patternProperties:
      "^cid-[0-9]+$":
        $ref: /schemas/types.yaml#/definitions/uint32
        description: |
          IVC queue ID for the specified CID. The CID is extracted
          from the property name (e.g., "nvidia,cid-2" maps CID 2
          to the specified IVC queue ID). Do not specify a queue
          for the guest's own CID.

required:
  - compatible
  - guest-cid
  - ivc-queues

examples:
  - |
          nv_vsock: nv-vsock {
        compatible = "nvidia,nv-vsock";
        guest-cid = <3>;
        max-rx-buffer-size = <524288>;  /* 512KB per socket (power of 2) */

        ivc-queues {
            cid-2 = <&tegra_hv 410>;  /* IVC queue 410 for CID 2 */
            cid-4 = <&tegra_hv 412>;  /* IVC queue 412 for CID 4 */
            /* Note: No queue needed for CID 3 (this guest's own CID) */
        };
    };
```

## Documentation/devicetree/bindings/nvmem/nvidia,tegra264-efuse.yaml
```yaml
# Copyright (c) 2024, NVIDIA CORPORATION & AFFILIATES.  All rights reserved.
#
# This program is free software; you can redistribute it and/or modify it
# under the terms and conditions of the GNU General Public License,
# version 2, as published by the Free Software Foundation.
#
# This program is distributed in the hope it will be useful, but WITHOUT
# ANY WARRANTY; without even the implied warranty of MERCHANTABILITY or
# FITNESS FOR A PARTICULAR PURPOSE.  See the GNU General Public License for
# more details.

%YAML 1.2
---
$id: http://devicetree.org/schemas/efuse@1000000/nvidia,tegra264-efuse.yaml#
$schema: http://devicetree.org/meta-schemas/core.yaml#

title: Nvidia Tegra t264 efuse Driver

maintainers:
  - Suresh Mangipudi

description: |
     the compatability = nvidia,tegra264-efuse is mentioned in the following drivers
        - <TOP>/kernel/kernel-oot/drivers/nvmem/tegra-efuse.c

     The following nodes use this compatibility
        - /bus@0/efuse@1000000

select:
  properties:
    compatible:
        minItems: 1
        maxItems: 1
        items:
            enum:
                - nvidia,tegra264-efuse

  required:
    - compatible

properties:

    reg:
        $ref: "/schemas/types.yaml#/definitions/uint32-matrix"
        description: |
            Registers are given by a tuple of two values:
                - register address:
                - register block size.
        items:
            minItems: 4
            maxItems: 4
            items:
                - $ref: "/schemas/types.yaml#/definitions/uint32"
                  minimum: 0x0
                  maximum: 0x0
                - $ref: "/schemas/types.yaml#/definitions/uint32"
                  minimum: 0x1000000
                  maximum: 0x1000000
                - $ref: "/schemas/types.yaml#/definitions/uint32"
                  minimum: 0x0
                  maximum: 0x0
                - $ref: "/schemas/types.yaml#/definitions/uint32"
                  minimum: 0x20000
                  maximum: 0x20000

    clocks:
        $ref: "/schemas/types.yaml#/definitions/uint32-matrix"
        description: |
            Clocks are given by a tuple of 2 values:
                - Phandle to the device
                - Clock ID
        items:
            minItems: 2
            maxItems: 2
            items:
                - $ref: "/schemas/types.yaml#/definitions/uint32"
                - $ref: "/schemas/types.yaml#/definitions/uint32"
                  minimum: 0xc8
                  maximum: 0xc8

    clock-names:
        $ref: "/schemas/types.yaml#/definitions/string-array"
        items:
            enum:
                - fuse


required:
    - compatible
    - reg
    - clocks
    - clock-names

examples:
    - |
        efuse@1000000 {
            compatible = "nvidia,tegra264-efuse",
                         "nvidia,tegra234-efuse";
            status = "disabled";
            reg = <0x0 0x01000000 0x0 0x20000>;
            clocks = <&bpmp TEGRA264_CLK_FUSE>;
            clock-names = "fuse";
        };
```

## Documentation/devicetree/bindings/nvpmodel/nvidia,nvpmodel.yaml
```yaml
# Copyright (c) 2024, NVIDIA CORPORATION & AFFILIATES.  All rights reserved.
#
# This program is free software; you can redistribute it and/or modify it
# under the terms and conditions of the GNU General Public License,
# version 2, as published by the Free Software Foundation.
#
# This program is distributed in the hope it will be useful, but WITHOUT
# ANY WARRANTY; without even the implied warranty of MERCHANTABILITY or
# FITNESS FOR A PARTICULAR PURPOSE.  See the GNU General Public License for
# more details.

%YAML 1.2
---
$id: http://devicetree.org/schemas/nvpmodel/nvidia,nvpmodel.yaml#
$schema: http://devicetree.org/meta-schemas/core.yaml#

title: NVIDIA nvpmodel clock cap driver

maintainers:
  - Yi-Wei Wang

description: |
     the compatability = nvidia,nvpmodel is mentioned in the following drivers
        - <TOP>/kernel/nvidia-oot/drivers/nvpmodel/nvpmodel-clk-cap.c

     The following nodes use this compatibility
        - /nvpmodel

select:
  properties:
    compatible:
        minItems: 1
        maxItems: 1
        items:
            enum:
                - nvidia,nvpmodel

  required:
    - compatible

properties:

    nvidia,bpmp:
        $ref: "/schemas/types.yaml#/definitions/uint32"

    clocks:
        $ref: "/schemas/types.yaml#/definitions/uint32-matrix"
        description: |
            Clocks are given by a tuple of 2 values:
                - Phandle to the device
                - Clock ID
        items:
            minItems: 2
            maxItems: 2
            items:
                - $ref: "/schemas/types.yaml#/definitions/uint32"
                - $ref: "/schemas/types.yaml#/definitions/uint32"
                  minimum: 0x122
                  maximum: 0x122

    clock-names:
        $ref: "/schemas/types.yaml#/definitions/string-array"
        items:
            enum:
                - emc


required:
    - compatible
    - clocks
    - clock-names

examples:
    - |
        nvpmodel {
            compatible = "nvidia,nvpmodel";
            status = "disabled";
            nvidia,bpmp = <&bpmp>;
            clocks = <&bpmp TEGRA264_CLK_EMC>;
            clock-names = "emc";
        };
```
