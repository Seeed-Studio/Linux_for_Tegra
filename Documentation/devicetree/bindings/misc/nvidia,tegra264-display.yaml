## Documentation/devicetree/bindings/platform/tegra/dce/nvidia,tegra264-dce.yaml
```yaml
# Copyright (c) 2024, NVIDIA CORPORATION & AFFILIATES.  All rights reserved.
#
# This program is free software; you can redistribute it and/or modify it
# under the terms and conditions of the GNU General Public License,
# version 2, as published by the Free Software Foundation.
#
# This program is distributed in the hope it will be useful, but WITHOUT
# ANY WARRANTY; without even the implied warranty of MERCHANTABILITY or
# FITNESS FOR A PARTICULAR PURPOSE.  See the GNU General Public License for
# more details.

%YAML 1.2
---
$id: http://devicetree.org/schemas/dce@8808000000/nvidia,tegra264-dce.yaml#
$schema: http://devicetree.org/meta-schemas/core.yaml#

title: DCE Linux driver

maintainers:
  - Mahesh Kumar
  - Srijan Kumar Sharma

description: |
     the compatability = nvidia,tegra264-dce is mentioned in the following drivers
        - <TOP>/kernel/nvidia-oot/drivers/platform/tegra/dce/dce-module.c

     The following nodes use this compatibility
        - /dce@8808000000

select:
  properties:
    compatible:
        minItems: 1
        maxItems: 1
        items:
            enum:
                - nvidia,tegra264-dce

  required:
    - compatible

properties:

    reg:
        $ref: "/schemas/types.yaml#/definitions/uint32-matrix"
        description: |
            Registers are given by a tuple of two values:
                - register address:
                - register block size.
        items:
            minItems: 4
            maxItems: 4
            items:
                - $ref: "/schemas/types.yaml#/definitions/uint32"
                  minimum: 0x88
                  maximum: 0x88
                - $ref: "/schemas/types.yaml#/definitions/uint32"
                  minimum: 0x8000000
                  maximum: 0x8000000
                - $ref: "/schemas/types.yaml#/definitions/uint32"
                  minimum: 0x0
                  maximum: 0x0
                - $ref: "/schemas/types.yaml#/definitions/uint32"
                  minimum: 0x800000
                  maximum: 0x800000

    interrupts:
        $ref: "/schemas/types.yaml#/definitions/uint32-matrix"
        description: |
            Interrupts are give by a tuple of 3 values:
                - interrupt specifier (GIC_SPI = 0, GIC_PPI = 1)
                  definitions in dt-bindings/interrupt-controller/arm-gic.h
                - interrupt number
                - trigger type (rising edge, falling edge, both, etc)
                  definitions in dt-bindings/interrupt-controller/irq.h
        items:
            items:
                - $ref: "/schemas/types.yaml#/definitions/uint32"
                  minimum: 0x0
                  maximum: 0x0
                - $ref: "/schemas/types.yaml#/definitions/uint32"
                  minimum: 0xee
                  maximum: 0xee
                - $ref: "/schemas/types.yaml#/definitions/uint32"
                  minimum: 0x4
                  maximum: 0x4

    interrupt-names:
        $ref: "/schemas/types.yaml#/definitions/string-array"
        items:
            enum:
                - dce-smb-0
                - dce-smb-1
                - dce-smb-2
                - dce-smb-3


    iommus:
        $ref: "/schemas/types.yaml#/definitions/uint32-matrix"
        description: |
            iommus are given by a tuple of 2 values:
                - Phandle to the device
                - Device ID
        items:
            minItems: 2
            maxItems: 2
            items:
                - $ref: "/schemas/types.yaml#/definitions/uint32"
                - $ref: "/schemas/types.yaml#/definitions/uint32"
                  minimum: 0x500
                  maximum: 0x500

required:
    - compatible
    - reg
    - interrupts
    - interrupt-names
    - iommus

examples:
    - |
        dce@8808000000 {
            compatible = "nvidia,tegra264-dce";
            reg = <0x00000088 0x08000000 0x00000000 0x00800000>;
            interrupts = <GIC_SPI 238 IRQ_TYPE_LEVEL_HIGH>;
            interrupt-names = "dce-smb-0, dce-smb-1, dce-smb-2, dce-smb-3";
            iommus = <&smmu3_mmu TEGRA_SID_DCE>;
            status = "disabled";
        };
```
