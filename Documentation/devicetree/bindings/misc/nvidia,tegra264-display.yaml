## Documentation/devicetree/bindings/misc/nvidia,tegra264-rtc.yaml
```yaml
# Copyright (c) 2024-2025, NVIDIA CORPORATION & AFFILIATES.  All rights reserved.
#
# This program is free software; you can redistribute it and/or modify it
# under the terms and conditions of the GNU General Public License,
# version 2, as published by the Free Software Foundation.
#
# This program is distributed in the hope it will be useful, but WITHOUT
# ANY WARRANTY; without even the implied warranty of MERCHANTABILITY or
# FITNESS FOR A PARTICULAR PURPOSE.  See the GNU General Public License for
# more details.

%YAML 1.2
---
$id: http://devicetree.org/schemas/rtc@c2c0000/nvidia,tegra264-rtc.yaml#
$schema: http://devicetree.org/meta-schemas/core.yaml#

title: Nvidia Tegra T264 RTC Driver

maintainers:
  - Suresh Mangipudi

description: |
     The following nodes use this compatibility
        - /bus@0/rtc@c2c0000

select:
  properties:
    compatible:
        minItems: 3
        maxItems: 3
        items:
            enum:
                - nvidia,tegra264-rtc
                - nvidia,tegra234-rtc
                - nvidia,tegra20-rtc

  required:
    - compatible

properties:

    reg:
        $ref: "/schemas/types.yaml#/definitions/uint32-matrix"
        description: |
            Registers are given by a tuple of two values:
                - register address:
                - register block size.
        items:
            minItems: 4
            maxItems: 4
            items:
                - $ref: "/schemas/types.yaml#/definitions/uint32"
                  minimum: 0x0
                  maximum: 0x0
                - $ref: "/schemas/types.yaml#/definitions/uint32"
                  minimum: 0xc2c0000
                  maximum: 0xc2c0000
                - $ref: "/schemas/types.yaml#/definitions/uint32"
                  minimum: 0x0
                  maximum: 0x0
                - $ref: "/schemas/types.yaml#/definitions/uint32"
                  minimum: 0x10000
                  maximum: 0x10000

    interrupt-parent:
        $ref: "/schemas/types.yaml#/definitions/uint32"

    interrupts:
        $ref: "/schemas/types.yaml#/definitions/uint32-matrix"
        description: |
            Interrupts are give by a tuple of 2 values with interrupt-parent phandle:
                - interrupt number
                - trigger type (rising edge, falling edge, both, etc)
                  definitions in dt-bindings/interrupt-controller/irq.h
        items:
            items:
                - $ref: "/schemas/types.yaml#/definitions/uint32"
                  minimum: 0x41
                  maximum: 0x41
                - $ref: "/schemas/types.yaml#/definitions/uint32"
                  minimum: 0x4
                  maximum: 0x4

    clocks:
        $ref: "/schemas/types.yaml#/definitions/uint32-matrix"
        description: |
            Clocks are given by a tuple of 2 values:
                - Phandle to the device
                - Clock ID
        items:
            minItems: 2
            maxItems: 2
            items:
                - $ref: "/schemas/types.yaml#/definitions/uint32"
                - $ref: "/schemas/types.yaml#/definitions/uint32"
                  minimum: 0x2
                  maximum: 0x2

    clock-names:
        $ref: "/schemas/types.yaml#/definitions/string-array"
        items:
            enum:
                - rtc


required:
    - compatible
    - reg
    - interrupts
    - clocks
    - clock-names

examples:
    - |
        rtc@c2c0000 {
            compatible = "nvidia,tegra264-rtc",
                         "nvidia,tegra234-rtc",
                         "nvidia,tegra20-rtc";
            status = "disabled";
            reg = <0x0 0x0c2c0000 0x0 0x10000>;
            interrupt-parent = <&pmc>;
            interrupts = <65 IRQ_TYPE_LEVEL_HIGH>;
            clocks = <&bpmp TEGRA264_CLK_CLK_S>;
            clock-names = "rtc";
        };
```

## Documentation/devicetree/bindings/misc/nvidia,tegra264-tsec.yaml
```yaml
# Copyright (c) 2024, NVIDIA CORPORATION & AFFILIATES.  All rights reserved.
#
# This program is free software; you can redistribute it and/or modify it
# under the terms and conditions of the GNU General Public License,
# version 2, as published by the Free Software Foundation.
#
# This program is distributed in the hope it will be useful, but WITHOUT
# ANY WARRANTY; without even the implied warranty of MERCHANTABILITY or
# FITNESS FOR A PARTICULAR PURPOSE.  See the GNU General Public License for
# more details.

%YAML 1.2
---
$id: http://devicetree.org/schemas/tsec@8188150000/nvidia,tegra264-tsec.yaml#
$schema: http://devicetree.org/meta-schemas/core.yaml#

title: Nvidia Tegra t264 Host1X TSEC

maintainers:
  - Nikesh Oswal

description: |
     The following nodes use this compatibility
        - /bus@0/host1x@8181200000/tsec@8188150000

select:
  properties:
    compatible:
        minItems: 1
        maxItems: 1
        items:
            enum:
                - nvidia,tegra264-tsec

  required:
    - compatible

properties:

    reg:
        $ref: "/schemas/types.yaml#/definitions/uint32-matrix"
        description: |
            Registers are given by a tuple of two values:
                - register address:
                - register block size.
        items:
            minItems: 4
            maxItems: 4
            items:
                - $ref: "/schemas/types.yaml#/definitions/uint32"
                  minimum: 0x81
                  maximum: 0x81
                - $ref: "/schemas/types.yaml#/definitions/uint32"
                  minimum: 0x88150000
                  maximum: 0x88150000
                - $ref: "/schemas/types.yaml#/definitions/uint32"
                  minimum: 0x0
                  maximum: 0x0
                - $ref: "/schemas/types.yaml#/definitions/uint32"
                  minimum: 0x40000
                  maximum: 0x40000

    interrupts:
        $ref: "/schemas/types.yaml#/definitions/uint32-matrix"
        description: |
            Interrupts are give by a tuple of 3 values:
                - interrupt specifier (GIC_SPI = 0, GIC_PPI = 1)
                  definitions in dt-bindings/interrupt-controller/arm-gic.h
                - interrupt number
                - trigger type (rising edge, falling edge, both, etc)
                  definitions in dt-bindings/interrupt-controller/irq.h
        items:
            items:
                - $ref: "/schemas/types.yaml#/definitions/uint32"
                  minimum: 0x0
                  maximum: 0x0
                - $ref: "/schemas/types.yaml#/definitions/uint32"
                  minimum: 0x1bf
                  maximum: 0x1bf
                - $ref: "/schemas/types.yaml#/definitions/uint32"
                  minimum: 0x4
                  maximum: 0x4

    resets:
        $ref: "/schemas/types.yaml#/definitions/uint32-matrix"
        description: |
            Resets are given by a tuple of 2 values:
                - Phandle to the device
                - Reset ID
        items:
            minItems: 2
            maxItems: 2
            items:
                - $ref: "/schemas/types.yaml#/definitions/uint32"
                - $ref: "/schemas/types.yaml#/definitions/uint32"
                  minimum: 0x2d
                  maximum: 0x2d

    clocks:
        $ref: "/schemas/types.yaml#/definitions/uint32-matrix"
        description: |
            Clocks are given by a tuple of 2 values:
                - Phandle to the device
                - Clock ID
        items:
            minItems: 2
            maxItems: 2
            items:
                - $ref: "/schemas/types.yaml#/definitions/uint32"
                - $ref: "/schemas/types.yaml#/definitions/uint32"
                  minimum: 0x30
                  maximum: 0xc8

    clock-names:
        $ref: "/schemas/types.yaml#/definitions/string-array"
        items:
            enum:
                - tsec
                - efuse
                - tsec_pka


    iommus:
        $ref: "/schemas/types.yaml#/definitions/uint32-matrix"
        description: |
            iommus are given by a tuple of 2 values:
                - Phandle to the device
                - Device ID
        items:
            minItems: 2
            maxItems: 2
            items:
                - $ref: "/schemas/types.yaml#/definitions/uint32"
                - $ref: "/schemas/types.yaml#/definitions/uint32"
                  minimum: 0x2900
                  maximum: 0x2900

    dma-coherent:
        $ref: "/schemas/types.yaml#/definitions/flag"

required:
    - compatible
    - reg
    - interrupts
    - resets
    - clocks
    - clock-names
    - iommus

examples:
    - |
        tsec@8188150000 {
            compatible = "nvidia,tegra264-tsec";
            reg = <0x81 0x88150000 0x00 0x40000>;
            interrupts = <GIC_SPI 0x1bF IRQ_TYPE_LEVEL_HIGH>;
            resets = <&bpmp TEGRA264_RESET_TSEC>;
            clocks = <&bpmp TEGRA264_CLK_TSEC>,
                     <&bpmp TEGRA264_CLK_FUSE>,
                     <&bpmp TEGRA264_CLK_TSEC_PKA>;
            clock-names = "tsec, efuse, tsec_pka";
            iommus = <&smmu4_mmu TEGRA_SID_TSEC>;
            dma-coherent;
            status = "disabled";
        };
```

## Documentation/devicetree/bindings/misc/nvidia,tegra264-virt-pcm-oot.yaml
```yaml
# Copyright (c) 2024, NVIDIA CORPORATION & AFFILIATES.  All rights reserved.
#
# This program is free software; you can redistribute it and/or modify it
# under the terms and conditions of the GNU General Public License,
# version 2, as published by the Free Software Foundation.
#
# This program is distributed in the hope it will be useful, but WITHOUT
# ANY WARRANTY; without even the implied warranty of MERCHANTABILITY or
# FITNESS FOR A PARTICULAR PURPOSE.  See the GNU General Public License for
# more details.

%YAML 1.2
---
$id: http://devicetree.org/schemas/virt-alt-pcm-oot/nvidia,tegra264-virt-pcm-oot.yaml#
$schema: http://devicetree.org/meta-schemas/core.yaml#

title: Virtual Pulse Code Modulator

maintainers:
  - Mohan Kumar

description: |
     The following nodes use this compatibility
        - /virt-alt-pcm-oot

select:
  properties:
    compatible:
        minItems: 1
        maxItems: 1
        items:
            enum:
                - nvidia,tegra264-virt-pcm-oot

  required:
    - compatible

properties:

    iommus:
        $ref: "/schemas/types.yaml#/definitions/uint32-matrix"
        description: |
            iommus are given by a tuple of 2 values:
                - Phandle to the device
                - Device ID
        items:
            minItems: 2
            maxItems: 2
            items:
                - $ref: "/schemas/types.yaml#/definitions/uint32"
                - $ref: "/schemas/types.yaml#/definitions/uint32"

    cardname:
        $ref: "/schemas/types.yaml#/definitions/string-array"
        items:
            enum:
                - tegra-virt-pcm-vm1


    dmas:
        $ref: "/schemas/types.yaml#/definitions/uint32"
        minimum: 0x1
        maximum: 0x82

    dma-names:
        $ref: "/schemas/types.yaml#/definitions/string-array"
        items:
            enum:
                - rx1
                - tx1
                - rx2
                - tx2
                - rx3
                - tx3
                - rx4
                - tx4
                - rx5
                - tx5
                - rx6
                - tx6
                - rx7
                - tx7
                - rx8
                - tx8
                - rx9
                - tx9
                - rx10
                - tx10
                - rx11
                - tx11
                - rx12
                - tx12
                - rx13
                - tx13
                - rx14
                - tx14
                - rx15
                - tx15
                - rx16
                - tx16
                - rx17
                - tx17
                - rx18
                - tx18
                - rx19
                - tx19
                - rx20
                - tx20
                - rx21
                - tx21
                - rx22
                - tx22
                - rx23
                - tx23
                - rx24
                - tx24


    ivc_queue:
        $ref: "/schemas/types.yaml#/definitions/uint32"
        minimum: 0xf
        maximum: 0xa2

    admaif_ch_num:
        $ref: "/schemas/types.yaml#/definitions/uint32"
        minimum: 0x18
        maximum: 0x18

    admaif_ch_list:
        $ref: "/schemas/types.yaml#/definitions/uint32"
        minimum: 0x1
        maximum: 0x18

required:
    - compatible
    - iommus

examples:
    - |
        virt-alt-pcm-oot {
        };
```
