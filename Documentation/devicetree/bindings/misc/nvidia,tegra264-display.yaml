## Documentation/devicetree/bindings/phy/tegra/nvidia,tegra264-xusb.yaml
```yaml
# Copyright (c) 2024, NVIDIA CORPORATION & AFFILIATES.  All rights reserved.
#
# This program is free software; you can redistribute it and/or modify it
# under the terms and conditions of the GNU General Public License,
# version 2, as published by the Free Software Foundation.
#
# This program is distributed in the hope it will be useful, but WITHOUT
# ANY WARRANTY; without even the implied warranty of MERCHANTABILITY or
# FITNESS FOR A PARTICULAR PURPOSE.  See the GNU General Public License for
# more details.

%YAML 1.2
---
$id: http://devicetree.org/schemas/usb@a80aa10000/nvidia,tegra264-xusb.yaml#
$schema: http://devicetree.org/meta-schemas/core.yaml#

title: Tegra XUSB Pad Controller driver

maintainers:
  - Sing HanChen

description: |
     the compatability = nvidia,tegra264-xusb is mentioned in the following drivers
        - <TOP>/kernel/kernel-oot/drivers/phy/tegra/xusb.c
        - <TOP>/kernel/kernel-oot/drivers/usb/host/xhci-tegra.c

     The following nodes use this compatibility
        - /bus@0/usb@a80aa10000

select:
  properties:
    compatible:
        minItems: 1
        maxItems: 1
        items:
            enum:
                - nvidia,tegra264-xusb

  required:
    - compatible

properties:

    reg:
        $ref: "/schemas/types.yaml#/definitions/uint32-matrix"
        description: |
            Registers are given by a tuple of two values:
                - register address:
                - register block size.
        items:
            minItems: 4
            maxItems: 4
            items:
                - $ref: "/schemas/types.yaml#/definitions/uint32"
                  minimum: 0xa8
                  maximum: 0xa8
                - $ref: "/schemas/types.yaml#/definitions/uint32"
                  minimum: 0x2000000
                  maximum: 0xaa50000
                - $ref: "/schemas/types.yaml#/definitions/uint32"
                  minimum: 0x0
                  maximum: 0x0
                - $ref: "/schemas/types.yaml#/definitions/uint32"
                  minimum: 0x10000
                  maximum: 0x40000

    reg-names:
        $ref: "/schemas/types.yaml#/definitions/string-array"
        items:
            enum:
                - base
                - fpci
                - bar2
                - rst
                - pinmux


    interrupts:
        $ref: "/schemas/types.yaml#/definitions/uint32-matrix"
        description: |
            Interrupts are give by a tuple of 3 values:
                - interrupt specifier (GIC_SPI = 0, GIC_PPI = 1)
                  definitions in dt-bindings/interrupt-controller/arm-gic.h
                - interrupt number
                - trigger type (rising edge, falling edge, both, etc)
                  definitions in dt-bindings/interrupt-controller/irq.h
        items:
            items:
                - $ref: "/schemas/types.yaml#/definitions/uint32"
                  minimum: 0x0
                  maximum: 0x2
                - $ref: "/schemas/types.yaml#/definitions/uint32"
                  minimum: 0x0
                  maximum: 0x3b8
                - $ref: "/schemas/types.yaml#/definitions/uint32"
                  minimum: 0x4
                  maximum: 0x4

    interrupt-names:
        $ref: "/schemas/types.yaml#/definitions/string-array"
        items:
            enum:
                - xhci
                - mbox
                - padctl


    clocks:
        $ref: "/schemas/types.yaml#/definitions/uint32-matrix"
        description: |
            Clocks are given by a tuple of 2 values:
                - Phandle to the device
                - Clock ID
        items:
            minItems: 2
            maxItems: 2
            items:
                - $ref: "/schemas/types.yaml#/definitions/uint32"
                - $ref: "/schemas/types.yaml#/definitions/uint32"
                  minimum: 0x1
                  maximum: 0x12d

    clock-names:
        $ref: "/schemas/types.yaml#/definitions/string-array"
        items:
            enum:
                - xusb_host
                - xusb_falcon_src
                - xusb_ss
                - xusb_ss_src
                - xusb_hs_src
                - xusb_fs_src
                - pll_u_480m
                - clk_m
                - pll_e


    power-domains:
        $ref: "/schemas/types.yaml#/definitions/uint32-matrix"
        items:
            minItems: 2
            maxItems: 2
            items:
                - $ref: "/schemas/types.yaml#/definitions/uint32"
                - $ref: "/schemas/types.yaml#/definitions/uint32"
                  minimum: 0xa
                  maximum: 0xc

    power-domain-names:
        $ref: "/schemas/types.yaml#/definitions/string-array"
        items:
            enum:
                - xusb_host
                - xusb_ss


    nvidia,xusb-padctl:
        $ref: "/schemas/types.yaml#/definitions/uint32"

    iommus:
        $ref: "/schemas/types.yaml#/definitions/uint32-matrix"
        description: |
            iommus are given by a tuple of 2 values:
                - Phandle to the device
                - Device ID
        items:
            minItems: 2
            maxItems: 2
            items:
                - $ref: "/schemas/types.yaml#/definitions/uint32"
                - $ref: "/schemas/types.yaml#/definitions/uint32"
                  minimum: 0x3200
                  maximum: 0x3600

    dma-coherent:
        $ref: "/schemas/types.yaml#/definitions/flag"

    phys:
        $ref: "/schemas/types.yaml#/definitions/uint32"
        minimum: 0x29
        maximum: 0x2c

    phy-names:
        $ref: "/schemas/types.yaml#/definitions/string-array"
        items:
            enum:
                - usb2-1
                - usb2-2
                - usb2-3
                - usb3-2


required:
    - compatible
    - reg
    - interrupts
    - interrupt-names
    - clocks
    - clock-names
    - iommus

examples:
    - |
        usb@a80aa10000 {
            compatible = "nvidia,tegra264-xusb";
            reg = <0xa8 0xaa10000 0x00 0x40000>,
                  <0xa8 0xaa00000 0x00 0x10000>,
                  <0xa8 0xaa50000 0x00 0x10000>,
                  <0xa8 0x2000000 0x00 0x40000>,
                  <0xa8 0x82e0000 0x00 0x40000>;
            reg-names = "base, fpci, bar2, rst, pinmux";
            interrupts = <0 952 IRQ_TYPE_LEVEL_HIGH>,
                         <2 0 IRQ_TYPE_LEVEL_HIGH>,
                         <2 5 IRQ_TYPE_LEVEL_HIGH>;
            interrupt-names = "xhci, mbox, padctl";
            clocks = <&bpmp TEGRA264_CLK_XUSB1_CORE_HOST>,
                     <&bpmp TEGRA264_CLK_XUSB1_FALCON>,
                     <&bpmp TEGRA264_CLK_XUSB1_CORE_SUPERSPEED>,
                     <&bpmp TEGRA264_CLK_XUSB1_SS>,
                     <&bpmp TEGRA264_CLK_OSC>,
                     <&bpmp TEGRA264_CLK_XUSB1_FS>,
                     <&bpmp TEGRA264_CLK_UTMI_PLL1>,
                     <&bpmp TEGRA264_CLK_OSC>,
                     <&bpmp TEGRA264_CLK_PLLE0>;
            clock-names = "xusb_host, xusb_falcon_src",
                          "xusb_ss, xusb_ss_src, xusb_hs_src",
                          "xusb_fs_src, pll_u_480m, clk_m",
                          "pll_e";
            power-domains = <&bpmp TEGRA264_POWER_DOMAIN_XUSB_HOST>,
                            <&bpmp TEGRA264_POWER_DOMAIN_XUSB_SS>;
            power-domain-names = "xusb_host, xusb_ss";
            nvidia,xusb-padctl = <&xusb_padctl>;
            iommus = <&smmu1_mmu TEGRA_SID_XUSB_PF_HS_PORTS>,
                     <&smmu1_mmu TEGRA_SID_XUSB_PF_SS_PORT1>,
                     <&smmu1_mmu TEGRA_SID_XUSB_PF_SS_PORT2>,
                     <&smmu1_mmu TEGRA_SID_XUSB_PF_SS_PORT3>,
                     <&smmu1_mmu TEGRA_SID_XUSB_PF_SS_PORT4>;
            dma-coherent;
            status = "disabled";
        };
```

## Documentation/devicetree/bindings/pinctrl/nvidia,tegra264-misc-dpaux-padctl.yaml
```yaml
# Copyright (c) 2024, NVIDIA CORPORATION & AFFILIATES.  All rights reserved.
#
# This program is free software; you can redistribute it and/or modify it
# under the terms and conditions of the GNU General Public License,
# version 2, as published by the Free Software Foundation.
#
# This program is distributed in the hope it will be useful, but WITHOUT
# ANY WARRANTY; without even the implied warranty of MERCHANTABILITY or
# FITNESS FOR A PARTICULAR PURPOSE.  See the GNU General Public License for
# more details.

%YAML 1.2
---
$id: http://devicetree.org/schemas/miscreg-dpaux@00100000/nvidia,tegra264-misc-dpaux-padctl.yaml#
$schema: http://devicetree.org/meta-schemas/core.yaml#

title: NVIDIA Tegra dpaux pinctrl driver

maintainers:
  - Suresh Mangipudi

description: |
     the compatability = nvidia,tegra264-misc-dpaux-padctl is mentioned in the following drivers
        - <TOP>/kernel/nvidia-oot/drivers/pinctrl/pinctrl-tegra234-dpaux.c

     The following nodes use this compatibility
        - /bus@0/miscreg-dpaux@00100000

select:
  properties:
    compatible:
        minItems: 1
        maxItems: 1
        items:
            enum:
                - nvidia,tegra264-misc-dpaux-padctl

  required:
    - compatible

properties:

    reg:
        $ref: "/schemas/types.yaml#/definitions/uint32-matrix"
        description: |
            Registers are given by a tuple of two values:
                - register address:
                - register block size.
        items:
            minItems: 4
            maxItems: 4
            items:
                - $ref: "/schemas/types.yaml#/definitions/uint32"
                  minimum: 0x0
                  maximum: 0x0
                - $ref: "/schemas/types.yaml#/definitions/uint32"
                  minimum: 0x100000
                  maximum: 0x100000
                - $ref: "/schemas/types.yaml#/definitions/uint32"
                  minimum: 0x0
                  maximum: 0x0
                - $ref: "/schemas/types.yaml#/definitions/uint32"
                  minimum: 0x4010
                  maximum: 0x4010

required:
    - compatible
    - reg

examples:
    - |
        miscreg-dpaux@00100000 {
            compatible = "nvidia,tegra264-misc-dpaux-padctl";
            reg = <0x0 0x00100000 0x0 0x4010>;
            status = "disabled";
        };
```

## Documentation/devicetree/bindings/pinctrl/pinctrl-tegra194-pexclk-padctrl.yaml
```yaml
# SPDX-License-Identifier: GPL-2.0-only OR BSD-2-Clause
%YAML 1.2
---
$id: http://devicetree.org/schemas/pinctrl/pinctrl-tegra194-pexclk-padctrl.yaml#
$schema: http://devicetree.org/meta-schemas/core.yaml#

title: NVIDIA Tegra PEX pad controller.

maintainers:
  - Laxman Dewangan <ldewangan@nvidia.com>

description:
  Bindings for NVIDIA Tegra PEX pad controller.

properties:
  compatible:
    const: nvidia,tegra194-pexclk-padctl

  reg:
    items:
      - description: Base address and size of the MISC controller.
      - description: Base address and size of the PMC controller.

required:
  - compatible
  - reg


patternProperties:
  'pinmux-[0-9]*$':
    type: object
    patternProperties:
      '-pins*$':
        type: object
        description: |
          A pinctrl node should contain at least one subnodes representing the
          pinctrl groups available on the machine. Each subnode will list the
          pins it needs, and how they should be configured either in display or i2c mode.
        $ref: "/schemas/pinctrl/pincfg-node.yaml"

        properties:
          nvidia,pexclk-single-en:
            $ref: /schemas/types.yaml#/definitions/uint32
            description:
              Enable/disable the pex clock in the pad or not. 1 for enable and 0 for disable.
          pins:
            enum: [ pexclk ]
            description:
              Name of pins.

additionalProperties: false

examples:
  - |
    soc {
        #address-cells = <2>;
        #size-cells = <2>;

        pinctrl@3790000 {
           compatible = "nvidia,tegra194-pexclk-padctl";
           reg = <0x0 0x03790000 0x0 0x1000>,
                 <0x0 0x037a0000 0x0 0x1000>;

           pexclk_default: pinmux-0 {
              pexclk-pins {
                  pins = "pexclk";
                  nvidia,pexclk-single-en = <1>;
              };
           };
        };
     };
...
```

## Documentation/devicetree/bindings/pinctrl/tegra/nvidia,tegra264-pinmux-aon.yaml
```yaml
# Copyright (c) 2024, NVIDIA CORPORATION & AFFILIATES.  All rights reserved.
#
# This program is free software; you can redistribute it and/or modify it
# under the terms and conditions of the GNU General Public License,
# version 2, as published by the Free Software Foundation.
#
# This program is distributed in the hope it will be useful, but WITHOUT
# ANY WARRANTY; without even the implied warranty of MERCHANTABILITY or
# FITNESS FOR A PARTICULAR PURPOSE.  See the GNU General Public License for
# more details.

%YAML 1.2
---
$id: http://devicetree.org/schemas/pinmux@c7a2000/nvidia,tegra264-pinmux-aon.yaml#
$schema: http://devicetree.org/meta-schemas/core.yaml#

title: Pinctrl data for the NVIDIA Tegra234 pinmux

maintainers:
  - Suresh Mangipudi

description: |
     the compatability = nvidia,tegra264-pinmux-aon is mentioned in the following drivers
        - <TOP>/kernel/kernel-oot/drivers/pinctrl/tegra/pinctrl-tegra264-generic.c
        - <TOP>/kernel/kernel-oot/drivers/pinctrl/tegra/pinctrl-tegra264.c

     The following nodes use this compatibility
        - /bus@0/pinmux@c7a2000

select:
  properties:
    compatible:
        minItems: 1
        maxItems: 1
        items:
            enum:
                - nvidia,tegra264-pinmux-aon

  required:
    - compatible

properties:

    reg:
        $ref: "/schemas/types.yaml#/definitions/uint32-matrix"
        description: |
            Registers are given by a tuple of two values:
                - register address:
                - register block size.
        items:
            minItems: 4
            maxItems: 4
            items:
                - $ref: "/schemas/types.yaml#/definitions/uint32"
                  minimum: 0x0
                  maximum: 0x0
                - $ref: "/schemas/types.yaml#/definitions/uint32"
                  minimum: 0xc7a2000
                  maximum: 0xc7a2000
                - $ref: "/schemas/types.yaml#/definitions/uint32"
                  minimum: 0x0
                  maximum: 0x0
                - $ref: "/schemas/types.yaml#/definitions/uint32"
                  minimum: 0x2000
                  maximum: 0x2000

required:
    - compatible
    - reg

examples:
    - |
        pinmux@c7a2000 {
            compatible = "nvidia,tegra264-pinmux-aon";
            status = "disabled";
            reg = <0x0 0x0c7a2000 0x0 0x2000>;
        };
```
