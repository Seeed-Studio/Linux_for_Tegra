## Documentation/devicetree/bindings/dma/nvidia,tegra264-adma.yaml
```yaml
# Copyright (c) 2024, NVIDIA CORPORATION & AFFILIATES.  All rights reserved.
#
# This program is free software; you can redistribute it and/or modify it
# under the terms and conditions of the GNU General Public License,
# version 2, as published by the Free Software Foundation.
#
# This program is distributed in the hope it will be useful, but WITHOUT
# ANY WARRANTY; without even the implied warranty of MERCHANTABILITY or
# FITNESS FOR A PARTICULAR PURPOSE.  See the GNU General Public License for
# more details.

%YAML 1.2
---
$id: http://devicetree.org/schemas/dma-controller@9440000/nvidia,tegra264-adma.yaml#
$schema: http://devicetree.org/meta-schemas/core.yaml#

title: NVIDIA Tegra ADMA driver

maintainers:
  - Mohan Kumar

description: |
     the compatability = nvidia,tegra264-adma is mentioned in the following drivers
        - <TOP>/kernel/kernel-oot/drivers/dma/tegra210-adma.c

     The following nodes use this compatibility
        - /bus@0/aconnect@9000000/dma-controller@9440000

select:
  properties:
    compatible:
        minItems: 1
        maxItems: 1
        items:
            enum:
                - nvidia,tegra264-adma

  required:
    - compatible

properties:

    reg:
        $ref: "/schemas/types.yaml#/definitions/uint32-matrix"
        description: |
            Registers are given by a tuple of two values:
                - register address:
                - register block size.
        items:
            minItems: 4
            maxItems: 4
            items:
                - $ref: "/schemas/types.yaml#/definitions/uint32"
                  minimum: 0x0
                  maximum: 0x0
                - $ref: "/schemas/types.yaml#/definitions/uint32"
                  minimum: 0x9450000
                  maximum: 0x9450000
                - $ref: "/schemas/types.yaml#/definitions/uint32"
                  minimum: 0x0
                  maximum: 0x0
                - $ref: "/schemas/types.yaml#/definitions/uint32"
                  minimum: 0x10000
                  maximum: 0x10000

    interrupt-parent:
        $ref: "/schemas/types.yaml#/definitions/uint32"

    interrupts:
        $ref: "/schemas/types.yaml#/definitions/uint32-matrix"
        description: |
            Interrupts are give by a tuple of 3 values:
                - interrupt specifier (GIC_SPI = 0, GIC_PPI = 1)
                  definitions in dt-bindings/interrupt-controller/arm-gic.h
                - interrupt number
                - trigger type (rising edge, falling edge, both, etc)
                  definitions in dt-bindings/interrupt-controller/irq.h
        items:
            items:
                - $ref: "/schemas/types.yaml#/definitions/uint32"
                  minimum: 0x0
                  maximum: 0x0
                - $ref: "/schemas/types.yaml#/definitions/uint32"
                  minimum: 0x90
                  maximum: 0xbf
                - $ref: "/schemas/types.yaml#/definitions/uint32"
                  minimum: 0x4
                  maximum: 0x4

    '#dma-cells':
        $ref: "/schemas/types.yaml#/definitions/uint32"
        minimum: 0x1
        maximum: 0x1

    clocks:
        $ref: "/schemas/types.yaml#/definitions/uint32-matrix"
        description: |
            Clocks are given by a tuple of 2 values:
                - Phandle to the device
                - Clock ID
        items:
            minItems: 2
            maxItems: 2
            items:
                - $ref: "/schemas/types.yaml#/definitions/uint32"
                - $ref: "/schemas/types.yaml#/definitions/uint32"
                  minimum: 0xa3
                  maximum: 0xa3

    clock-names:
        $ref: "/schemas/types.yaml#/definitions/string-array"
        items:
            enum:
                - d_audio


    reg-names:
        $ref: "/schemas/types.yaml#/definitions/string-array"
        items:
            enum:
                - vm


    dma-channel-mask:
        $ref: "/schemas/types.yaml#/definitions/uint32"
        minimum: 0xffff
        maximum: 0xffffffff

required:
    - compatible
    - reg
    - interrupts
    - clocks
    - clock-names

examples:
    - |
        dma-controller@9440000 {
            compatible = "nvidia,tegra264-adma";
            reg = <0x0 0x9440000 0x0 0xb0000>;
            interrupt-parent = <&agic_page0>;
            interrupts = <GIC_SPI 0x90 IRQ_TYPE_LEVEL_HIGH>,
                         <GIC_SPI 0x91 IRQ_TYPE_LEVEL_HIGH>,
                         <GIC_SPI 0x92 IRQ_TYPE_LEVEL_HIGH>,
                         <GIC_SPI 0x93 IRQ_TYPE_LEVEL_HIGH>,
                         <GIC_SPI 0x94 IRQ_TYPE_LEVEL_HIGH>,
                         <GIC_SPI 0x95 IRQ_TYPE_LEVEL_HIGH>,
                         <GIC_SPI 0x96 IRQ_TYPE_LEVEL_HIGH>,
                         <GIC_SPI 0x97 IRQ_TYPE_LEVEL_HIGH>,
                         <GIC_SPI 0x98 IRQ_TYPE_LEVEL_HIGH>,
                         <GIC_SPI 0x99 IRQ_TYPE_LEVEL_HIGH>,
                         <GIC_SPI 0x9a IRQ_TYPE_LEVEL_HIGH>,
                         <GIC_SPI 0x9b IRQ_TYPE_LEVEL_HIGH>,
                         <GIC_SPI 0x9c IRQ_TYPE_LEVEL_HIGH>,
                         <GIC_SPI 0x9d IRQ_TYPE_LEVEL_HIGH>,
                         <GIC_SPI 0x9e IRQ_TYPE_LEVEL_HIGH>,
                         <GIC_SPI 0x9f IRQ_TYPE_LEVEL_HIGH>,
                         <GIC_SPI 0xa0 IRQ_TYPE_LEVEL_HIGH>,
                         <GIC_SPI 0xa1 IRQ_TYPE_LEVEL_HIGH>,
                         <GIC_SPI 0xa2 IRQ_TYPE_LEVEL_HIGH>,
                         <GIC_SPI 0xa3 IRQ_TYPE_LEVEL_HIGH>,
                         <GIC_SPI 0xa4 IRQ_TYPE_LEVEL_HIGH>,
                         <GIC_SPI 0xa5 IRQ_TYPE_LEVEL_HIGH>,
                         <GIC_SPI 0xa6 IRQ_TYPE_LEVEL_HIGH>,
                         <GIC_SPI 0xa7 IRQ_TYPE_LEVEL_HIGH>,
                         <GIC_SPI 0xa8 IRQ_TYPE_LEVEL_HIGH>,
                         <GIC_SPI 0xa9 IRQ_TYPE_LEVEL_HIGH>,
                         <GIC_SPI 0xaa IRQ_TYPE_LEVEL_HIGH>,
                         <GIC_SPI 0xab IRQ_TYPE_LEVEL_HIGH>,
                         <GIC_SPI 0xac IRQ_TYPE_LEVEL_HIGH>,
                         <GIC_SPI 0xad IRQ_TYPE_LEVEL_HIGH>,
                         <GIC_SPI 0xae IRQ_TYPE_LEVEL_HIGH>,
                         <GIC_SPI 0xaf IRQ_TYPE_LEVEL_HIGH>,
                         <GIC_SPI 0xb0 IRQ_TYPE_LEVEL_HIGH>,
                         <GIC_SPI 0xb1 IRQ_TYPE_LEVEL_HIGH>,
                         <GIC_SPI 0xb2 IRQ_TYPE_LEVEL_HIGH>,
                         <GIC_SPI 0xb3 IRQ_TYPE_LEVEL_HIGH>,
                         <GIC_SPI 0xb4 IRQ_TYPE_LEVEL_HIGH>,
                         <GIC_SPI 0xb5 IRQ_TYPE_LEVEL_HIGH>,
                         <GIC_SPI 0xb6 IRQ_TYPE_LEVEL_HIGH>,
                         <GIC_SPI 0xb7 IRQ_TYPE_LEVEL_HIGH>,
                         <GIC_SPI 0xb8 IRQ_TYPE_LEVEL_HIGH>,
                         <GIC_SPI 0xb9 IRQ_TYPE_LEVEL_HIGH>,
                         <GIC_SPI 0xba IRQ_TYPE_LEVEL_HIGH>,
                         <GIC_SPI 0xbb IRQ_TYPE_LEVEL_HIGH>,
                         <GIC_SPI 0xbc IRQ_TYPE_LEVEL_HIGH>,
                         <GIC_SPI 0xbd IRQ_TYPE_LEVEL_HIGH>,
                         <GIC_SPI 0xbe IRQ_TYPE_LEVEL_HIGH>,
                         <GIC_SPI 0xbf IRQ_TYPE_LEVEL_HIGH>,
                         <GIC_SPI 0xc0 IRQ_TYPE_LEVEL_HIGH>,
                         <GIC_SPI 0xc1 IRQ_TYPE_LEVEL_HIGH>,
                         <GIC_SPI 0xc2 IRQ_TYPE_LEVEL_HIGH>,
                         <GIC_SPI 0xc3 IRQ_TYPE_LEVEL_HIGH>,
                         <GIC_SPI 0xc4 IRQ_TYPE_LEVEL_HIGH>,
                         <GIC_SPI 0xc5 IRQ_TYPE_LEVEL_HIGH>,
                         <GIC_SPI 0xc6 IRQ_TYPE_LEVEL_HIGH>,
                         <GIC_SPI 0xc7 IRQ_TYPE_LEVEL_HIGH>,
                         <GIC_SPI 0xc8 IRQ_TYPE_LEVEL_HIGH>,
                         <GIC_SPI 0xc9 IRQ_TYPE_LEVEL_HIGH>,
                         <GIC_SPI 0xca IRQ_TYPE_LEVEL_HIGH>,
                         <GIC_SPI 0xcb IRQ_TYPE_LEVEL_HIGH>,
                         <GIC_SPI 0xcc IRQ_TYPE_LEVEL_HIGH>,
                         <GIC_SPI 0xcd IRQ_TYPE_LEVEL_HIGH>,
                         <GIC_SPI 0xce IRQ_TYPE_LEVEL_HIGH>,
                         <GIC_SPI 0xcf IRQ_TYPE_LEVEL_HIGH>;
            #dma-cells = <1>;
            clocks = <&bpmp TEGRA264_CLK_AHUB>;
            clock-names = "d_audio";
            status = "disabled";
        };
```

## Documentation/devicetree/bindings/dma/nvidia,tegra264-gpcdma.yaml
```yaml
# Copyright (c) 2024, NVIDIA CORPORATION & AFFILIATES.  All rights reserved.
#
# This program is free software; you can redistribute it and/or modify it
# under the terms and conditions of the GNU General Public License,
# version 2, as published by the Free Software Foundation.
#
# This program is distributed in the hope it will be useful, but WITHOUT
# ANY WARRANTY; without even the implied warranty of MERCHANTABILITY or
# FITNESS FOR A PARTICULAR PURPOSE.  See the GNU General Public License for
# more details.

%YAML 1.2
---
$id: http://devicetree.org/schemas/dma-controller@8400000/nvidia,tegra264-gpcdma.yaml#
$schema: http://devicetree.org/meta-schemas/core.yaml#

title: NVIDIA Tegra GPC DMA Controller driver

maintainers:
  - Suresh Mangipudi

description: |
     the compatability = nvidia,tegra264-gpcdma is mentioned in the following drivers
        - <TOP>/kernel/kernel-oot/drivers/dma/tegra186-gpc-dma.c

     The following nodes use this compatibility
        - /bus@0/dma-controller@8400000

select:
  properties:
    compatible:
        minItems: 1
        maxItems: 1
        items:
            enum:
                - nvidia,tegra264-gpcdma

  required:
    - compatible

properties:

    reg:
        $ref: "/schemas/types.yaml#/definitions/uint32-matrix"
        description: |
            Registers are given by a tuple of two values:
                - register address:
                - register block size.
        items:
            minItems: 4
            maxItems: 4
            items:
                - $ref: "/schemas/types.yaml#/definitions/uint32"
                  minimum: 0x0
                  maximum: 0x0
                - $ref: "/schemas/types.yaml#/definitions/uint32"
                  minimum: 0x8400000
                  maximum: 0x8400000
                - $ref: "/schemas/types.yaml#/definitions/uint32"
                  minimum: 0x0
                  maximum: 0x0
                - $ref: "/schemas/types.yaml#/definitions/uint32"
                  minimum: 0x210000
                  maximum: 0x210000

    interrupts:
        $ref: "/schemas/types.yaml#/definitions/uint32-matrix"
        description: |
            Interrupts are give by a tuple of 3 values:
                - interrupt specifier (GIC_SPI = 0, GIC_PPI = 1)
                  definitions in dt-bindings/interrupt-controller/arm-gic.h
                - interrupt number
                - trigger type (rising edge, falling edge, both, etc)
                  definitions in dt-bindings/interrupt-controller/irq.h
        items:
            items:
                - $ref: "/schemas/types.yaml#/definitions/uint32"
                  minimum: 0x0
                  maximum: 0x0
                - $ref: "/schemas/types.yaml#/definitions/uint32"
                  minimum: 0x248
                  maximum: 0x267
                - $ref: "/schemas/types.yaml#/definitions/uint32"
                  minimum: 0x4
                  maximum: 0x4

    '#dma-cells':
        $ref: "/schemas/types.yaml#/definitions/uint32"
        minimum: 0x3
        maximum: 0x3

    iommus:
        $ref: "/schemas/types.yaml#/definitions/uint32-matrix"
        description: |
            iommus are given by a tuple of 2 values:
                - Phandle to the device
                - Device ID
        items:
            minItems: 2
            maxItems: 2
            items:
                - $ref: "/schemas/types.yaml#/definitions/uint32"
                - $ref: "/schemas/types.yaml#/definitions/uint32"
                  minimum: 0x800
                  maximum: 0x800

    dma-coherent:
        $ref: "/schemas/types.yaml#/definitions/flag"

    dma-channel-mask:
        $ref: "/schemas/types.yaml#/definitions/uint32"
        minimum: 0xf70dc3fe
        maximum: 0xf70dc3fe

required:
    - compatible
    - reg
    - interrupts
    - iommus

examples:
    - |
        dma-controller@8400000 {
            compatible = "nvidia,tegra264-gpcdma";
            status = "disabled";
            reg = <0x0 0x08400000 0x0 0x210000>;
            interrupts = <GIC_SPI 584 IRQ_TYPE_LEVEL_HIGH>,
                         <GIC_SPI 585 IRQ_TYPE_LEVEL_HIGH>,
                         <GIC_SPI 586 IRQ_TYPE_LEVEL_HIGH>,
                         <GIC_SPI 587 IRQ_TYPE_LEVEL_HIGH>,
                         <GIC_SPI 588 IRQ_TYPE_LEVEL_HIGH>,
                         <GIC_SPI 589 IRQ_TYPE_LEVEL_HIGH>,
                         <GIC_SPI 590 IRQ_TYPE_LEVEL_HIGH>,
                         <GIC_SPI 591 IRQ_TYPE_LEVEL_HIGH>,
                         <GIC_SPI 592 IRQ_TYPE_LEVEL_HIGH>,
                         <GIC_SPI 593 IRQ_TYPE_LEVEL_HIGH>,
                         <GIC_SPI 594 IRQ_TYPE_LEVEL_HIGH>,
                         <GIC_SPI 595 IRQ_TYPE_LEVEL_HIGH>,
                         <GIC_SPI 596 IRQ_TYPE_LEVEL_HIGH>,
                         <GIC_SPI 597 IRQ_TYPE_LEVEL_HIGH>,
                         <GIC_SPI 598 IRQ_TYPE_LEVEL_HIGH>,
                         <GIC_SPI 599 IRQ_TYPE_LEVEL_HIGH>,
                         <GIC_SPI 600 IRQ_TYPE_LEVEL_HIGH>,
                         <GIC_SPI 601 IRQ_TYPE_LEVEL_HIGH>,
                         <GIC_SPI 602 IRQ_TYPE_LEVEL_HIGH>,
                         <GIC_SPI 603 IRQ_TYPE_LEVEL_HIGH>,
                         <GIC_SPI 604 IRQ_TYPE_LEVEL_HIGH>,
                         <GIC_SPI 605 IRQ_TYPE_LEVEL_HIGH>,
                         <GIC_SPI 606 IRQ_TYPE_LEVEL_HIGH>,
                         <GIC_SPI 607 IRQ_TYPE_LEVEL_HIGH>,
                         <GIC_SPI 608 IRQ_TYPE_LEVEL_HIGH>,
                         <GIC_SPI 609 IRQ_TYPE_LEVEL_HIGH>,
                         <GIC_SPI 610 IRQ_TYPE_LEVEL_HIGH>,
                         <GIC_SPI 611 IRQ_TYPE_LEVEL_HIGH>,
                         <GIC_SPI 612 IRQ_TYPE_LEVEL_HIGH>,
                         <GIC_SPI 613 IRQ_TYPE_LEVEL_HIGH>,
                         <GIC_SPI 614 IRQ_TYPE_LEVEL_HIGH>,
                         <GIC_SPI 615 IRQ_TYPE_LEVEL_HIGH>;
            #dma-cells = <3>;
            iommus = <&smmu1_mmu 0x00000800>;
            dma-coherent;
            dma-channel-mask = <0xfffffffe>;
        };
```

## Documentation/devicetree/bindings/gpio/gpio-max77851.yaml
```yaml
# SPDX-License-Identifier: GPL-2.0-only
# SPDX-FileCopyrightText: Copyright (c) 2022-2023 NVIDIA CORPORATION & AFFILIATES. All rights reserved.
%YAML 1.2
---
$id: http://devicetree.org/schemas/gpio/gpio-max77851.yaml#
$schema: http://devicetree.org/meta-schemas/core.yaml#

title: DT bindings MAX77851 Power Management IC GPIO

maintainers:
  - Joan Na<Joan.na@maximintegrated.com>
  - Shubhi Garg <shgarg@nvidia.com>

description: |
  DT bindings GPIO driver for MAX77851 Power management IC from Maxim Semiconductor.

  Device has 8 GPIO pins and 4 FPSO pins which can be configured as GPIO as well as the
  special IO functions.

  For more details, please refer generic GPIO DT binding document
  <devicetree/bindings/gpio/gpio.txt>.

properties:

  compatible:
    const: "maxim,max77851-pmic"

  gpio-controller: true

  '#gpio-cells':
    const: 2

examples:
  - |
    #include <dt-bindings/gpio/gpio.h>
    #include <dt-bindings/mfd/max77851.h>
    ...
    max77851: max77851@3c {
	compatible = "maxim,max77851-pmic";

	gpio-controller;
	#gpio-cells = <2>;
    };
    ...
```
