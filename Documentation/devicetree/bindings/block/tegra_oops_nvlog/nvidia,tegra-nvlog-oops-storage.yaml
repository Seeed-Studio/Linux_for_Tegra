## Documentation/devicetree/bindings/memory/tegra/nvidia,t264-smmu-hwpm.yaml
```yaml
# SPDX-License-Identifier: GPL-2.0-only
# SPDX-FileCopyrightText: Copyright (c) 2024-2025 NVIDIA CORPORATION & AFFILIATES. All rights reserved.

%YAML 1.2
---
$id: http://devicetree.org/schemas/smmu-hwpm@810aa30000/nvidia,t264-smmu-hwpm.yaml#
$schema: http://devicetree.org/meta-schemas/core.yaml#

title: Tegra264 SMMU-HWPM driver

maintainers:
  - Pritesh Raithatha
  - Ketan Patil

description: |
     the compatability = nvidia,t264-smmu-hwpm is mentioned in the following drivers
        - <TOP>/kernel/nvidia-oot/drivers/memory/tegra/smmu-hwpm.c

     The following nodes use this compatibility
        - /bus@0/smmu-hwpm@810aa30000
        - /bus@0/smmu-hwpm@8105a30000
        - /bus@0/smmu-hwpm@8106a30000
        - /bus@0/smmu-hwpm@8806a30000
        - /bus@0/smmu-hwpm@810ba30000

select:
  properties:
    compatible:
        minItems: 1
        maxItems: 1
        items:
            enum:
                - nvidia,t264-smmu-hwpm

  required:
    - compatible

properties:

    reg:
        $ref: "/schemas/types.yaml#/definitions/uint32-matrix"
        description: |
            Registers are given by a tuple of two values:
                - register address:
                - register block size.
        items:
            minItems: 4
            maxItems: 4
            items:
                - $ref: "/schemas/types.yaml#/definitions/uint32"
                  minimum: 0x81
                  maximum: 0x88
                - $ref: "/schemas/types.yaml#/definitions/uint32"
                  minimum: 0x5a30000
                  maximum: 0xba30000
                - $ref: "/schemas/types.yaml#/definitions/uint32"
                  minimum: 0x0
                  maximum: 0x0
                - $ref: "/schemas/types.yaml#/definitions/uint32"
                  minimum: 0x10000
                  maximum: 0x10000

required:
    - compatible
    - reg

examples:
    - |
        smmu-hwpm@810aa30000 {
            compatible = "nvidia,t264-smmu-hwpm";
            reg = <0x81 0x0aa30000 0x0 0x10000>;
            status = "disabled";
        };
```
