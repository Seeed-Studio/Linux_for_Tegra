## Documentation/devicetree/bindings/hwmon/ti,tmp451.yaml
```yaml
# Copyright (c) 2024, NVIDIA CORPORATION & AFFILIATES.  All rights reserved.
#
# This program is free software; you can redistribute it and/or modify it
# under the terms and conditions of the GNU General Public License,
# version 2, as published by the Free Software Foundation.
#
# This program is distributed in the hope it will be useful, but WITHOUT
# ANY WARRANTY; without even the implied warranty of MERCHANTABILITY or
# FITNESS FOR A PARTICULAR PURPOSE.  See the GNU General Public License for
# more details.

%YAML 1.2
---
$id: http://devicetree.org/schemas/temp-sensor@4c/ti,tmp451.yaml#
$schema: http://devicetree.org/meta-schemas/core.yaml#

title: LM90/ADM1032 driver

maintainers:
  - Yi-Wei Wang

description: |
     the compatability = ti,tmp451 is mentioned in the following drivers
        - <TOP>/kernel/kernel-oot/drivers/hwmon/lm90.c

     The following nodes use this compatibility
        - /bpmp/i2c/temp-sensor@4c

select:
  properties:
    compatible:
        minItems: 1
        maxItems: 1
        items:
            enum:
                - ti,tmp451

  required:
    - compatible

properties:

    reg:
        $ref: "/schemas/types.yaml#/definitions/uint32-matrix"
        description: |
            Registers are given by a tuple of two values:
                - register address:
                - register block size.
        items:
            minItems: 4
            maxItems: 4
            items:
                - $ref: "/schemas/types.yaml#/definitions/uint32"
                  minimum: 0x4c
                  maximum: 0x4c

    sensor-name:
        $ref: "/schemas/types.yaml#/definitions/string-array"
        items:
            enum:
                - tmp451-ext-soc


    '#thermal-sensor-cells':
        $ref: "/schemas/types.yaml#/definitions/uint32"
        minimum: 0x1
        maximum: 0x1

    interrupt-parent:
        $ref: "/schemas/types.yaml#/definitions/uint32"
        minimum: 0x4e
        maximum: 0x4e

    interrupts:
        $ref: "/schemas/types.yaml#/definitions/uint32-matrix"
        description: |
            Interrupts are give by a tuple of 3 values:
                - interrupt specifier (GIC_SPI = 0, GIC_PPI = 1)
                  definitions in dt-bindings/interrupt-controller/arm-gic.h
                - interrupt number
                - trigger type (rising edge, falling edge, both, etc)
                  definitions in dt-bindings/interrupt-controller/irq.h
        items:
            items:
                - $ref: "/schemas/types.yaml#/definitions/uint32"
                  minimum: 0x8
                  maximum: 0x9

    temp-alert-gpio:
        $ref: "/schemas/types.yaml#/definitions/uint32"
        minimum: 0x0
        maximum: 0x4e

    offset:
        $ref: "/schemas/types.yaml#/definitions/uint32"
        minimum: 0xfffff060
        maximum: 0xfffff060

required:
    - compatible
    - reg
    - interrupts

examples:
    - |
        temp-sensor@4c {
        };
```

## Documentation/devicetree/bindings/input/keyboard/gpio-keys.yaml
```yaml
# Copyright (c) 2024, NVIDIA CORPORATION & AFFILIATES.  All rights reserved.
#
# This program is free software; you can redistribute it and/or modify it
# under the terms and conditions of the GNU General Public License,
# version 2, as published by the Free Software Foundation.
#
# This program is distributed in the hope it will be useful, but WITHOUT
# ANY WARRANTY; without even the implied warranty of MERCHANTABILITY or
# FITNESS FOR A PARTICULAR PURPOSE.  See the GNU General Public License for
# more details.

%YAML 1.2
---
$id: http://devicetree.org/schemas/gpio-keys/gpio-keys.yaml#
$schema: http://devicetree.org/meta-schemas/core.yaml#

title: Keyboard driver for GPIOs

maintainers:
  - Suresh Mangipudi

description: |
     the compatability = gpio-keys is mentioned in the following drivers
        - <TOP>/kernel/kernel-oot/drivers/input/keyboard/gpio_keys.c
        - <TOP>/kernel/kernel-oot/drivers/input/keyboard/gpio_keys_polled.c
        - <TOP>/kernel/kernel-oot/drivers/input/misc/soc_button_array.c
        - <TOP>/kernel/kernel-oot/drivers/mfd/ucb1x00-assabet.c
        - <TOP>/kernel/kernel-oot/drivers/mfd/rohm-bd71828.c
        - <TOP>/kernel/kernel-oot/drivers/mfd/rohm-bd718x7.c
        - <TOP>/kernel/kernel-oot/drivers/platform/x86/barco-p50-gpio.c
        - <TOP>/kernel/kernel-oot/drivers/platform/x86/meraki-mx100.c
        - <TOP>/kernel/kernel-oot/drivers/platform/x86/pcengines-apuv2.c
        - <TOP>/kernel/kernel-oot/drivers/platform/x86/x86-android-tablets.c

     The following nodes use this compatibility
        - /gpio-keys

select:
  properties:
    compatible:
        minItems: 1
        maxItems: 1
        items:
            enum:
                - gpio-keys

  required:
    - compatible

properties:

required:
    - compatible

examples:
    - |
        gpio-keys {
            compatible = "gpio-keys";
            status = "okay";
        };
```

## Documentation/devicetree/bindings/media/platform/tegra/cam_fsync/nvidia,tegra264-cdi-tsc.yaml
```yaml
# Copyright (c) 2024, NVIDIA CORPORATION & AFFILIATES.  All rights reserved.
#
# This program is free software; you can redistribute it and/or modify it
# under the terms and conditions of the GNU General Public License,
# version 2, as published by the Free Software Foundation.
#
# This program is distributed in the hope it will be useful, but WITHOUT
# ANY WARRANTY; without even the implied warranty of MERCHANTABILITY or
# FITNESS FOR A PARTICULAR PURPOSE.  See the GNU General Public License for
# more details.

%YAML 1.2
---
$id: http://devicetree.org/schemas/tsc_sig_gen@c230000/nvidia,tegra264-cdi-tsc.yaml#
$schema: http://devicetree.org/meta-schemas/core.yaml#

title: Cam Fsync Driver

maintainers:
  - Mohit Ingale

description: |
     the compatability = nvidia,tegra264-cdi-tsc is mentioned in the following drivers
        - <TOP>/kernel/nvidia-oot/drivers/media/platform/tegra/cam_fsync/cam_fsync.c

     The following nodes use this compatibility
        - /tsc_sig_gen@c230000

select:
  properties:
    compatible:
        minItems: 1
        maxItems: 1
        items:
            enum:
                - nvidia,tegra264-cdi-tsc

  required:
    - compatible

properties:

    reg:
        $ref: "/schemas/types.yaml#/definitions/uint32-matrix"
        description: |
            Registers are given by a tuple of two values:
                - register address:
                - register block size.
        items:
            minItems: 4
            maxItems: 4
            items:
                - $ref: "/schemas/types.yaml#/definitions/uint32"
                  minimum: 0x0
                  maximum: 0x0
                - $ref: "/schemas/types.yaml#/definitions/uint32"
                  minimum: 0xc230000
                  maximum: 0xc230000
                - $ref: "/schemas/types.yaml#/definitions/uint32"
                  minimum: 0x0
                  maximum: 0x0
                - $ref: "/schemas/types.yaml#/definitions/uint32"
                  minimum: 0x18
                  maximum: 0x18

    '#address-cells':
        $ref: "/schemas/types.yaml#/definitions/uint32"
        minimum: 0x1
        maximum: 0x1

    '#size-cells':
        $ref: "/schemas/types.yaml#/definitions/uint32"
        minimum: 0x1
        maximum: 0x1

required:
    - compatible
    - reg

examples:
    - |
        tsc_sig_gen@c230000 {
            compatible = "nvidia,tegra264-cam-cdi-tsc";
            ranges = <0x0 0x0 0xc230000 0x10000>;
            reg = <0x0 0xc230000 0x0 0x18>;
            #address-cells = <1>;
            #size-cells = <1>;
            status = "disabled";
        };
```

## Documentation/devicetree/bindings/media/platform/tegra/camera/fusa-capture/nvidia,tegra-camrtc-capture-isp.yaml
```yaml
# Copyright (c) 2024, NVIDIA CORPORATION & AFFILIATES.  All rights reserved.
#
# This program is free software; you can redistribute it and/or modify it
# under the terms and conditions of the GNU General Public License,
# version 2, as published by the Free Software Foundation.
#
# This program is distributed in the hope it will be useful, but WITHOUT
# ANY WARRANTY; without even the implied warranty of MERCHANTABILITY or
# FITNESS FOR A PARTICULAR PURPOSE.  See the GNU General Public License for
# more details.

%YAML 1.2
---
$id: http://devicetree.org/schemas/tegra-capture-isp/nvidia,tegra-camrtc-capture-isp.yaml#
$schema: http://devicetree.org/meta-schemas/core.yaml#

title: Tegra Capture-ISP driver

maintainers:
  - Evgeny Kornev

description: |
     the compatability = nvidia,tegra-camrtc-capture-isp is mentioned in the following drivers
        - <TOP>/kernel/nvidia-oot/drivers/media/platform/tegra/camera/fusa-capture/capture-isp.c

     The following nodes use this compatibility
        - /tegra-capture-isp

select:
  properties:
    compatible:
        minItems: 1
        maxItems: 1
        items:
            enum:
                - nvidia,tegra-camrtc-capture-isp

  required:
    - compatible

properties:

    nvidia,isp-devices:
        $ref: "/schemas/types.yaml#/definitions/uint32-matrix"
        items:
            minItems: 2
            maxItems: 2
            items:
                - $ref: "/schemas/types.yaml#/definitions/uint32"
                - $ref: "/schemas/types.yaml#/definitions/uint32"

    nvidia,isp-max-channels:
        $ref: "/schemas/types.yaml#/definitions/uint32"
        minimum: 0x20
        maximum: 0x20

required:
    - compatible

examples:
    - |
        tegra-capture-isp {
            compatible = "nvidia,tegra-camrtc-capture-isp";
            nvidia,isp-devices = <&isp &isp1>;
            nvidia,isp-max-channels = <32>;
            status = "disabled";
        };
```

## Documentation/devicetree/bindings/media/platform/tegra/camera/fusa-capture/nvidia,tegra-camrtc-capture-vi.yaml
```yaml
# Copyright (c) 2024, NVIDIA CORPORATION & AFFILIATES.  All rights reserved.
#
# This program is free software; you can redistribute it and/or modify it
# under the terms and conditions of the GNU General Public License,
# version 2, as published by the Free Software Foundation.
#
# This program is distributed in the hope it will be useful, but WITHOUT
# ANY WARRANTY; without even the implied warranty of MERCHANTABILITY or
# FITNESS FOR A PARTICULAR PURPOSE.  See the GNU General Public License for
# more details.

%YAML 1.2
---
$id: http://devicetree.org/schemas/tegra-capture-vi/nvidia,tegra-camrtc-capture-vi.yaml#
$schema: http://devicetree.org/meta-schemas/core.yaml#

title: Tegra Capture-ISP driver

maintainers:
  - Evgeny Kornev

description: |
     the compatability = nvidia,tegra-camrtc-capture-vi is mentioned in the following drivers
        - <TOP>/kernel/nvidia-oot/drivers/media/platform/tegra/camera/fusa-capture/capture-vi.c

     The following nodes use this compatibility
        - /tegra-capture-vi

select:
  properties:
    compatible:
        minItems: 1
        maxItems: 1
        items:
            enum:
                - nvidia,tegra-camrtc-capture-vi

  required:
    - compatible

properties:

    nvidia,vi-devices:
        $ref: "/schemas/types.yaml#/definitions/uint32-matrix"
        items:
            minItems: 2
            maxItems: 2
            items:
                - $ref: "/schemas/types.yaml#/definitions/uint32"
                - $ref: "/schemas/types.yaml#/definitions/uint32"

    nvidia,vi-mapping-size:
        $ref: "/schemas/types.yaml#/definitions/uint32"
        minimum: 0x6
        maximum: 0x6

    nvidia,vi-mapping:
        $ref: "/schemas/types.yaml#/definitions/uint32-matrix"
        items:
            minItems: 2
            maxItems: 2
            items:
                - $ref: "/schemas/types.yaml#/definitions/uint32"
                  minimum: 0x0
                  maximum: 0x5
                - $ref: "/schemas/types.yaml#/definitions/uint32"
                  minimum: 0x0
                  maximum: 0x1

    nvidia,vi-mapping-names:
        $ref: "/schemas/types.yaml#/definitions/string-array"
        items:
            enum:
                - csi-stream-id
                - vi-unit-id


    nvidia,vi-max-channels:
        $ref: "/schemas/types.yaml#/definitions/uint32"
        minimum: 0x48
        maximum: 0x48

required:
    - compatible

examples:
    - |
        tegra-capture-vi {
            compatible = "nvidia,tegra-camrtc-capture-vi";
            nvidia,vi-devices = <&vi0 &vi1>;
            nvidia,vi-mapping-size = <6>;
            nvidia,vi-mapping = <0 0>,
                                <1 0>,
                                <2 1>,
                                <3 1>,
                                <4 0>,
                                <5 1>;
            nvidia,vi-mapping-names = "csi-stream-id, vi-unit-id";
            nvidia,vi-max-channels = <72>;
            status = "disabled";
        };
```

## Documentation/devicetree/bindings/media/platform/tegra/isc/nvidia,isc-mgr.yaml
```yaml
# Copyright (c) 2024, NVIDIA CORPORATION & AFFILIATES.  All rights reserved.
#
# This program is free software; you can redistribute it and/or modify it
# under the terms and conditions of the GNU General Public License,
# version 2, as published by the Free Software Foundation.
#
# This program is distributed in the hope it will be useful, but WITHOUT
# ANY WARRANTY; without even the implied warranty of MERCHANTABILITY or
# FITNESS FOR A PARTICULAR PURPOSE.  See the GNU General Public License for
# more details.

%YAML 1.2
---
$id: http://devicetree.org/schemas/isc-mgr.0/nvidia,isc-mgr.yaml#
$schema: http://devicetree.org/meta-schemas/core.yaml#

title: Tegra Autotive ISC Manager Driver

maintainers:
  - Frank Chen

description: |
     the compatability = nvidia,isc-mgr is mentioned in the following drivers
        - <TOP>/kernel/nvidia-oot/drivers/media/platform/tegra/isc/isc_mgr.c

     The following nodes use this compatibility
        - /isc-mgr.0
        - /isc-mgr.1
        - /isc-mgr.2
        - /isc-mgr.3
        - /isc-mgr.4

select:
  properties:
    compatible:
        minItems: 1
        maxItems: 1
        items:
            enum:
                - nvidia,isc-mgr

  required:
    - compatible

properties:

    i2c-bus:
        $ref: "/schemas/types.yaml#/definitions/uint32"
        minimum: 0x0
        maximum: 0xc

    csi-port:
        $ref: "/schemas/types.yaml#/definitions/uint32"
        minimum: 0x0
        maximum: 0x6

    cphy-map-trio0:
        $ref: "/schemas/types.yaml#/definitions/string-array"
        items:
            enum:
                - A_B_C


    cphy-map-trio1:
        $ref: "/schemas/types.yaml#/definitions/string-array"
        items:
            enum:
                - C_A_B


    cphy-map-trio2:
        $ref: "/schemas/types.yaml#/definitions/string-array"
        items:
            enum:
                - A_B_C


    cphy-map-trio3:
        $ref: "/schemas/types.yaml#/definitions/string-array"
        items:
            enum:
                - C_A_B


required:
    - compatible

examples:
    - |
        isc-mgr.0 {
            compatible = "nvidia,isc-mgr";                                                                                                                          7095 »   »   i2c-bus = <0x7>;
            csi-port = <0x0>;
            cphy-map-trio0 = "A_B_C";
            cphy-map-trio1 = "C_A_B";
            cphy-map-trio2 = "A_B_C";
            cphy-map-trio3 = "C_A_B";
            status = "okay";
        };
```
