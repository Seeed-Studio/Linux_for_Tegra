## source/nvidia-oot/Documentation/devicetree/bindings/clocksource/nvidia,tegra234-timer.yaml
```yaml
# Copyright (c) 2024, NVIDIA CORPORATION & AFFILIATES.  All rights reserved.
#
# This program is free software; you can redistribute it and/or modify it
# under the terms and conditions of the GNU General Public License,
# version 2, as published by the Free Software Foundation.
#
# This program is distributed in the hope it will be useful, but WITHOUT
# ANY WARRANTY; without even the implied warranty of MERCHANTABILITY or
# FITNESS FOR A PARTICULAR PURPOSE.  See the GNU General Public License for
# more details.

%YAML 1.2
---
$id: http://devicetree.org/schemas/timer@8000000/nvidia,tegra234-timer.yaml#
$schema: http://devicetree.org/meta-schemas/core.yaml#

title: NVIDIA Tegra Timers Module

maintainers:
  - Thierry Reding
  - Suresh Mangipudi

description: |
     the compatability = nvidia,tegra234-timer is mentioned in the following drivers
        - <TOP>/kernel/kernel-oot/drivers/clocksource/timer-tegra186.c

     The following nodes use this compatibility
        - /bus@0/timer@8000000

select:
  properties:
    compatible:
        minItems: 1
        maxItems: 1
        items:
            enum:
                - nvidia,tegra234-timer

  required:
    - compatible

properties:

    reg:
        $ref: "/schemas/types.yaml#/definitions/uint32-matrix"
        description: |
            Registers are given by a tuple of two values:
                - register address:
                - register block size.
        items:
            minItems: 4
            maxItems: 4
            items:
                - $ref: "/schemas/types.yaml#/definitions/uint32"
                  minimum: 0x0
                  maximum: 0x0
                - $ref: "/schemas/types.yaml#/definitions/uint32"
                  minimum: 0x8000000
                  maximum: 0x8000000
                - $ref: "/schemas/types.yaml#/definitions/uint32"
                  minimum: 0x0
                  maximum: 0x0
                - $ref: "/schemas/types.yaml#/definitions/uint32"
                  minimum: 0x140000
                  maximum: 0x140000

    interrupts:
        $ref: "/schemas/types.yaml#/definitions/uint32-matrix"
        description: |
            Interrupts are give by a tuple of 3 values:
                - interrupt specifier (GIC_SPI = 0, GIC_PPI = 1)
                  definitions in dt-bindings/interrupt-controller/arm-gic.h
                - interrupt number
                - trigger type (rising edge, falling edge, both, etc)
                  definitions in dt-bindings/interrupt-controller/irq.h
        items:
            items:
                - $ref: "/schemas/types.yaml#/definitions/uint32"
                  minimum: 0x0
                  maximum: 0x0
                - $ref: "/schemas/types.yaml#/definitions/uint32"
                  minimum: 0x305
                  maximum: 0x308
                - $ref: "/schemas/types.yaml#/definitions/uint32"
                  minimum: 0x4
                  maximum: 0x4

required:
    - compatible
    - reg
    - interrupts

examples:
    - |
        timer@8000000 {
            compatible = "nvidia,tegra234-timer";
            reg = <0x0 0x08000000 0x0 0x00140000>;
            interrupts = <GIC_SPI 773 IRQ_TYPE_LEVEL_HIGH>,
                         <GIC_SPI 774 IRQ_TYPE_LEVEL_HIGH>,
                         <GIC_SPI 775 IRQ_TYPE_LEVEL_HIGH>,
                         <GIC_SPI 776 IRQ_TYPE_LEVEL_HIGH>;
            status = "disabled";
        };
```
