## Documentation/devicetree/bindings/usb/gadget/udc/nvidia,tegra264-xudc.yaml
```yaml
# Copyright (c) 2024, NVIDIA CORPORATION & AFFILIATES.  All rights reserved.
#
# This program is free software; you can redistribute it and/or modify it
# under the terms and conditions of the GNU General Public License,
# version 2, as published by the Free Software Foundation.
#
# This program is distributed in the hope it will be useful, but WITHOUT
# ANY WARRANTY; without even the implied warranty of MERCHANTABILITY or
# FITNESS FOR A PARTICULAR PURPOSE.  See the GNU General Public License for
# more details.

%YAML 1.2
---
$id: http://devicetree.org/schemas/usb@a808670000/nvidia,tegra264-xudc.yaml#
$schema: http://devicetree.org/meta-schemas/core.yaml#

title: NVIDIA Tegra XUSB Device Controller

maintainers:
  - Sing HanChen

description: |
     the compatability = nvidia,tegra264-xudc is mentioned in the following drivers
        - <TOP>/kernel/kernel-oot/drivers/usb/gadget/udc/tegra-xudc.c

     The following nodes use this compatibility
        - /bus@0/usb@a808670000

select:
  properties:
    compatible:
        minItems: 1
        maxItems: 1
        items:
            enum:
                - nvidia,tegra264-xudc

  required:
    - compatible

properties:

    reg:
        $ref: "/schemas/types.yaml#/definitions/uint32-matrix"
        description: |
            Registers are given by a tuple of two values:
                - register address:
                - register block size.
        items:
            minItems: 4
            maxItems: 4
            items:
                - $ref: "/schemas/types.yaml#/definitions/uint32"
                  minimum: 0xa8
                  maximum: 0xa8
                - $ref: "/schemas/types.yaml#/definitions/uint32"
                  minimum: 0x8670000
                  maximum: 0x8678000
                - $ref: "/schemas/types.yaml#/definitions/uint32"
                  minimum: 0x0
                  maximum: 0x0
                - $ref: "/schemas/types.yaml#/definitions/uint32"
                  minimum: 0x8000
                  maximum: 0x8000

    reg-names:
        $ref: "/schemas/types.yaml#/definitions/string-array"
        items:
            enum:
                - base
                - fpci


    interrupts:
        $ref: "/schemas/types.yaml#/definitions/uint32-matrix"
        description: |
            Interrupts are give by a tuple of 3 values:
                - interrupt specifier (GIC_SPI = 0, GIC_PPI = 1)
                  definitions in dt-bindings/interrupt-controller/arm-gic.h
                - interrupt number
                - trigger type (rising edge, falling edge, both, etc)
                  definitions in dt-bindings/interrupt-controller/irq.h
        items:
            items:
                - $ref: "/schemas/types.yaml#/definitions/uint32"
                  minimum: 0x2
                  maximum: 0x2
                - $ref: "/schemas/types.yaml#/definitions/uint32"
                  minimum: 0x2
                  maximum: 0x2
                - $ref: "/schemas/types.yaml#/definitions/uint32"
                  minimum: 0x4
                  maximum: 0x4

    clocks:
        $ref: "/schemas/types.yaml#/definitions/uint32-matrix"
        description: |
            Clocks are given by a tuple of 2 values:
                - Phandle to the device
                - Clock ID
        items:
            minItems: 2
            maxItems: 2
            items:
                - $ref: "/schemas/types.yaml#/definitions/uint32"
                - $ref: "/schemas/types.yaml#/definitions/uint32"
                  minimum: 0x103
                  maximum: 0x10c

    clock-names:
        $ref: "/schemas/types.yaml#/definitions/string-array"
        items:
            enum:
                - dev
                - ss
                - ss_src
                - fs_src


    power-domains:
        $ref: "/schemas/types.yaml#/definitions/uint32-matrix"
        items:
            minItems: 2
            maxItems: 2
            items:
                - $ref: "/schemas/types.yaml#/definitions/uint32"
                - $ref: "/schemas/types.yaml#/definitions/uint32"
                  minimum: 0xa
                  maximum: 0xb

    power-domain-names:
        $ref: "/schemas/types.yaml#/definitions/string-array"
        items:
            enum:
                - dev
                - ss


    nvidia,xusb-padctl:
        $ref: "/schemas/types.yaml#/definitions/uint32"

    iommus:
        $ref: "/schemas/types.yaml#/definitions/uint32-matrix"
        description: |
            iommus are given by a tuple of 2 values:
                - Phandle to the device
                - Device ID
        items:
            minItems: 2
            maxItems: 2
            items:
                - $ref: "/schemas/types.yaml#/definitions/uint32"
                - $ref: "/schemas/types.yaml#/definitions/uint32"
                  minimum: 0x3708
                  maximum: 0x3708

    dma-coherent:
        $ref: "/schemas/types.yaml#/definitions/flag"

    phys:
        $ref: "/schemas/types.yaml#/definitions/uint32"
        minimum: 0x27
        maximum: 0x28

    phy-names:
        $ref: "/schemas/types.yaml#/definitions/string-array"
        items:
            enum:
                - usb2-0
                - usb3-1


required:
    - compatible
    - reg
    - interrupts
    - clocks
    - clock-names
    - iommus

examples:
    - |
        usb@a808670000 {
            compatible = "nvidia,tegra264-xudc";
            reg = <0xa8 0x8670000 0x00 0x8000>,
                  <0xa8 0x8678000 0x00 0x8000>;
            reg-names = "base, fpci";
            interrupts = <2 2 IRQ_TYPE_LEVEL_HIGH>;
            clocks = <&bpmp TEGRA264_CLK_XUSB1_CORE_DEV>,
                     <&bpmp TEGRA264_CLK_XUSB1_CORE_SUPERSPEED>,
                     <&bpmp TEGRA264_CLK_XUSB1_SS>,
                     <&bpmp TEGRA264_CLK_XUSB1_FS>;
            clock-names = "dev, ss, ss_src, fs_src";
            power-domains = <&bpmp TEGRA264_POWER_DOMAIN_XUSB_DEV>,
                            <&bpmp TEGRA264_POWER_DOMAIN_XUSB_SS>;
            power-domain-names = "dev, ss";
            nvidia,xusb-padctl = <&xusb_padctl>;
            iommus = <&smmu1_mmu TEGRA_SID_XUSB_DEV_MODE>;
            dma-coherent;
            status = "disabled";
        };
```

## Documentation/devicetree/bindings/video/nvdisp_serdes.yaml
```yaml
# SPDX-License-Identifier: (GPL-2.0 OR BSD-2-Clause)
# Copyright (c) 2024, NVIDIA CORPORATION & AFFILIATES. All rights reserved.
%YAML 1.2
---
$id: http://devicetree.org/schemas/video/nvdisp_serdes.yaml#
$schema: http://devicetree.org/meta-schemas/core.yaml#

title: Device tree binding for NVIDIA Tegra NvDisp SerDes Components

maintainers:
  - Prafull Suryawanshi <prafulls@nvidia.com>

description: |
   The nvdisp_serdes driver is common display serializer driver for different display serializers
   which can be connected to NVIDIA Tegra Automotive Platforms on standard display output connectors like DP or HDMI.
   This driver initialize the display serializer hardware (and downstream deserializer), handles the gpio error interrupt
   and deinitialize the hardware.

properties:
  compatible:
    - nvidia,nvdisp_serdes

  reg:
    maxItems: 1
    description: |
       I2C address of the SerDes device on I2C controller.

  interrupts:
    maxItems: 1
    description: |
       GPIO pin number for ERRB interrupt from serializer

  interrupt-parent:
    maxItems: 1
    description: |
       Interrupt parent controller for GPIO pin interrupt

  nvdisp-serdes-errb:
    maxItems: 1
    description: |
       Interrupt number and parent gpio controller

  display-serdes-config:
    maxItems: 1
    description: |
       SerDes configuration for underlying SerDes topology.

  description:
    maxItems: 1
    description: |
       One line brief description explaining the current serdes config.

  init-seq:
    maxItems: 1
    description: |
       Initialization sequence which consist of set of OPCODEs.
       Each OPCODE could be some action executed by SerDes driver like i2c transfer (read/write), delay, etc.
       This sequence executed by SerDes driver during init and resume.


  deinit-seq:
    maxItems: 1
    description: |
       De-initialization sequence which consist of set of OPCODEs.
       Each OPCODE could be some action executed by SerDes driver like i2c transfer (read/write), delay, etc.
       This sequence executed by SerDes driver during suspend and deinit.

  errb-seq:
    maxItems: 1
    description: |
       ERRB error handling sequence which consist of set of OPCODEs.
       Each OPCODE could be some action executed by SerDes driver like i2c transfer (read/write), delay, report EPL error etc.
       This sequence executed by SerDes driver during irq handler which should be set by nvdisp-serdes-errb property.

  reg-bits:
    maxItems: 1
    description: |
       SerDes I2C device register address size.

  val-bits:
    maxItems: 1
    description: |
       SerDes I2C device register value size.

required:
  - compatible
  - reg
  - display-serdes-config

Optional properties:
  - reg-bits
  - val-bits
  - nvdisp-serdes-errb

examples:
  - |
    i2c@31e0000 { /* i2c8 */
        status = "okay";
        nvdisp_serdes: nvdisp_serdes@40 {
            compatible = "nvidia,nvdisp_serdes";
            reg = <0x40>;
            status = "okay";
            interrupt-parent = <&tegra_main_gpio>;
            interrupts = <TEGRA234_MAIN_GPIO(G, 7) IRQ_TYPE_LEVEL_HIGH>;
            nvdisp-serdes-errb = <&tegra_main_gpio TEGRA234_MAIN_GPIO(G, 7) 0>;
            reg-bits = <0x10>;
            val-bits = <0x08>;
            display-serdes-config {
                description = "MAX96767 connected with GMSL2 config";
                /* opcode sequence to initialize SerDes */
                init-seq =
                    [50], [00 00 0F A0], [FF],
                    [10], [40 00], [29 00], [01], [00], [FF],
                    [10], [40 00], [33 00], [01], [00], [FF],
                    [30], [40 00], [21 00], [FF],
                    [90], [40 00], [2A 00], [0A], [00], [10 27 00 00], [01 00], [01 00], [FF],
                    [F0], [40 00], [05 00], [FF];

                  deinit-seq =
                      /* disable video link output at each pipe */
                      [10], [40 00], [00 01], [60], [00], [FF];

                  errb-seq =
                      /*** start: detect and clear error for remote error */
                      /* read remote error for link A and print if error is detected */
                      [80], [40 00], [1B 00], [10], [00], [10], [00], [FF],
                      /* read remote error for link B and print if error is detected */
                      [80], [40 00], [1B 00], [20], [00], [20], [00], [FF];
                      /*** end: detect and clear error for remote error */
            };
        };
    };
```

## Documentation/devicetree/bindings/video/tegra/host/capture/nvidia,tegra234-vi-thi.yaml
```yaml
# Copyright (c) 2024, NVIDIA CORPORATION & AFFILIATES.  All rights reserved.
#
# This program is free software; you can redistribute it and/or modify it
# under the terms and conditions of the GNU General Public License,
# version 2, as published by the Free Software Foundation.
#
# This program is distributed in the hope it will be useful, but WITHOUT
# ANY WARRANTY; without even the implied warranty of MERCHANTABILITY or
# FITNESS FOR A PARTICULAR PURPOSE.  See the GNU General Public License for
# more details.

%YAML 1.2
---
$id: http://devicetree.org/schemas/vi0-thi@8188700000/nvidia,tegra234-vi-thi.yaml#
$schema: http://devicetree.org/meta-schemas/core.yaml#

title: Tegra Camera Capture Support Module

maintainers:
  - Chinniah Poosapadi

description: |
     the compatability = nvidia,tegra234-vi-thi is mentioned in the following drivers
        - <TOP>/kernel/nvidia-oot/drivers/video/tegra/host/capture/capture-support.c

     The following nodes use this compatibility
        - /bus@0/host1x@8181200000/vi0-thi@8188700000
        - /bus@0/host1x@8181200000/vi1-thi@8188f00000

select:
  properties:
    compatible:
        minItems: 1
        maxItems: 1
        items:
            enum:
                - nvidia,tegra234-vi-thi

  required:
    - compatible

properties:

    resets:
        $ref: "/schemas/types.yaml#/definitions/uint32-matrix"
        description: |
            Resets are given by a tuple of 2 values:
                - Phandle to the device
                - Reset ID
        items:
            minItems: 2
            maxItems: 2
            items:
                - $ref: "/schemas/types.yaml#/definitions/uint32"
                - $ref: "/schemas/types.yaml#/definitions/uint32"
                  minimum: 0x2e
                  maximum: 0x2f

    reset-names:
        $ref: "/schemas/types.yaml#/definitions/string-array"
        items:
            enum:
                - vi_thi
                - vi2_thi


required:
    - compatible
    - resets
    - reset-names

examples:
    - |
        vi0-thi@8188700000 {
            compatible = "nvidia,tegra234-vi-thi";
            resets = <&bpmp TEGRA264_RESET_VI>;
            reset-names = "vi_thi";
            status = "disabled";
        };
```

## Documentation/devicetree/bindings/video/tegra/host/capture/nvidia,tegra264-isp-thi.yaml
```yaml
# Copyright (c) 2024, NVIDIA CORPORATION & AFFILIATES.  All rights reserved.
#
# This program is free software; you can redistribute it and/or modify it
# under the terms and conditions of the GNU General Public License,
# version 2, as published by the Free Software Foundation.
#
# This program is distributed in the hope it will be useful, but WITHOUT
# ANY WARRANTY; without even the implied warranty of MERCHANTABILITY or
# FITNESS FOR A PARTICULAR PURPOSE.  See the GNU General Public License for
# more details.

%YAML 1.2
---
$id: http://devicetree.org/schemas/isp-thi@8188b00000/nvidia,tegra264-isp-thi.yaml#
$schema: http://devicetree.org/meta-schemas/core.yaml#

title: Tegra Image Sensor Processor Support Module

maintainers:
  - Chinniah Poosapadi

description: |
     the compatability = nvidia,tegra264-isp-thi is mentioned in the following drivers
        - <TOP>/kernel/nvidia-oot/drivers/video/tegra/host/capture/capture-support-t264.h

     The following nodes use this compatibility
        - /bus@0/host1x@8181200000/isp-thi@8188b00000
        - /bus@0/host1x@8181200000/isp1-thi@818ab00000

select:
  properties:
    compatible:
        minItems: 1
        maxItems: 1
        items:
            enum:
                - nvidia,tegra264-isp-thi

  required:
    - compatible

properties:

    resets:
        $ref: "/schemas/types.yaml#/definitions/uint32-matrix"
        description: |
            Resets are given by a tuple of 2 values:
                - Phandle to the device
                - Reset ID
        items:
            minItems: 2
            maxItems: 2
            items:
                - $ref: "/schemas/types.yaml#/definitions/uint32"
                - $ref: "/schemas/types.yaml#/definitions/uint32"
                  minimum: 0x37
                  maximum: 0x37

    reset-names:
        $ref: "/schemas/types.yaml#/definitions/string-array"
        items:
            enum:
                - isp_thi
                - isp1_thi


required:
    - compatible
    - resets
    - reset-names

examples:
    - |
        isp-thi@8188b00000 {
            compatible = "nvidia,tegra264-isp-thi";
            resets = <&bpmp TEGRA264_RESET_ISP1>;
            reset-names = "isp_thi";
            status = "disabled";
        };
```
