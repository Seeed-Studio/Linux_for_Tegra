## Documentation/devicetree/bindings/video/tegra/host/isp/nvidia,tegra264-isp.yaml
```yaml
# Copyright (c) 2024, NVIDIA CORPORATION & AFFILIATES.  All rights reserved.
#
# This program is free software; you can redistribute it and/or modify it
# under the terms and conditions of the GNU General Public License,
# version 2, as published by the Free Software Foundation.
#
# This program is distributed in the hope it will be useful, but WITHOUT
# ANY WARRANTY; without even the implied warranty of MERCHANTABILITY or
# FITNESS FOR A PARTICULAR PURPOSE.  See the GNU General Public License for
# more details.

%YAML 1.2
---
$id: http://devicetree.org/schemas/isp@8188800000/nvidia,tegra264-isp.yaml#
$schema: http://devicetree.org/meta-schemas/core.yaml#

title: Tegra Image Sensor Processor Module

maintainers:
  - Chinniah Poosapadi

description: |
     the compatability = nvidia,tegra264-isp is mentioned in the following drivers
        - <TOP>/kernel/nvidia-oot/drivers/video/tegra/host/isp/isp5.c
        - <TOP>/kernel/nvidia-oot/drivers/video/tegra/host/isp/isp5-t264.h
        - <TOP>/kernel/nvidia-oot/drivers/video/tegra/host/capture/capture-support-t264.h

     The following nodes use this compatibility
        - /bus@0/host1x@8181200000/isp@8188800000
        - /bus@0/host1x@8181200000/isp1@818a800000

select:
  properties:
    compatible:
        minItems: 1
        maxItems: 1
        items:
            enum:
                - nvidia,tegra264-isp

  required:
    - compatible

properties:

    reg:
        $ref: "/schemas/types.yaml#/definitions/uint32-matrix"
        description: |
            Registers are given by a tuple of two values:
                - register address:
                - register block size.
        items:
            minItems: 4
            maxItems: 4
            items:
                - $ref: "/schemas/types.yaml#/definitions/uint32"
                  minimum: 0x81
                  maximum: 0x81
                - $ref: "/schemas/types.yaml#/definitions/uint32"
                  minimum: 0x88800000
                  maximum: 0x88800000
                - $ref: "/schemas/types.yaml#/definitions/uint32"
                  minimum: 0x0
                  maximum: 0x0
                - $ref: "/schemas/types.yaml#/definitions/uint32"
                  minimum: 0x300000
                  maximum: 0x300000

    resets:
        $ref: "/schemas/types.yaml#/definitions/uint32-matrix"
        description: |
            Resets are given by a tuple of 2 values:
                - Phandle to the device
                - Reset ID
        items:
            minItems: 2
            maxItems: 2
            items:
                - $ref: "/schemas/types.yaml#/definitions/uint32"
                - $ref: "/schemas/types.yaml#/definitions/uint32"
                  minimum: 0x13
                  maximum: 0x37

    reset-names:
        $ref: "/schemas/types.yaml#/definitions/string-array"
        items:
            enum:
                - isp
                - isp1


    clocks:
        $ref: "/schemas/types.yaml#/definitions/uint32-matrix"
        description: |
            Clocks are given by a tuple of 2 values:
                - Phandle to the device
                - Clock ID
        items:
            minItems: 2
            maxItems: 2
            items:
                - $ref: "/schemas/types.yaml#/definitions/uint32"
                - $ref: "/schemas/types.yaml#/definitions/uint32"
                  minimum: 0xf
                  maximum: 0x10

    clock-names:
        $ref: "/schemas/types.yaml#/definitions/string-array"
        items:
            enum:
                - isp
                - isp1


    nvidia,isp-falcon-device:
        $ref: "/schemas/types.yaml#/definitions/uint32"

    iommus:
        $ref: "/schemas/types.yaml#/definitions/uint32-matrix"
        description: |
            iommus are given by a tuple of 2 values:
                - Phandle to the device
                - Device ID
        items:
            minItems: 2
            maxItems: 2
            items:
                - $ref: "/schemas/types.yaml#/definitions/uint32"
                - $ref: "/schemas/types.yaml#/definitions/uint32"
                  minimum: 0xc01
                  maximum: 0xd01

    dma-coherent:
        $ref: "/schemas/types.yaml#/definitions/flag"

required:
    - compatible
    - reg
    - resets
    - reset-names
    - clocks
    - clock-names
    - iommus

examples:
    - |
        isp@8188800000 {
            compatible = "nvidia,tegra264-isp";
            reg = <0x81 0x88800000 0x0 0x00300000>;
            resets = <&bpmp TEGRA264_RESET_ISP>;
            reset-names = "isp";
            clocks = <&bpmp TEGRA264_CLK_ISP>;
            clock-names = "isp";
            nvidia,isp-falcon-device = <&isp_thi>;
            iommus = <&smmu4_mmu TEGRA_SID_ISP_VM1>;
            dma-coherent;
            status = "disabled";
        };
```

## Documentation/devicetree/bindings/video/tegra/nvmap/nvidia,vi-carveout.yaml
```yaml
# Copyright (c) 2025, NVIDIA CORPORATION & AFFILIATES.  All rights reserved.
#
# This program is free software; you can redistribute it and/or modify it
# under the terms and conditions of the GNU General Public License,
# version 2, as published by the Free Software Foundation.
#
# This program is distributed in the hope it will be useful, but WITHOUT
# ANY WARRANTY; without even the implied warranty of MERCHANTABILITY or
# FITNESS FOR A PARTICULAR PURPOSE.  See the GNU General Public License for
# more details.

%YAML 1.2
---
$id: http://devicetree.org/schemas/vi-carveout/nvidia,vi-carveout.yaml#
$schema: http://devicetree.org/meta-schemas/core.yaml#

title: Nvidia VI Carveout

maintainers:
  - Ketan Patil

description: |
  This schema defines the properties for the NVIDIA VI carveout (mempool) memory
  node. The reference to this DT node should be added memory-region in tegra carveout
  to create the VI carveout.

select:
  properties:
    compatible:
        minItems: 1
        maxItems: 1
        items:
            enum:
                - nvidia,vi_carveout

  required:
    - compatible

properties:
    ivm:
        description: |
            A phandle to the tegra-hv node followed by the mempool id.
        items:
            minItems: 2
            maxItems: 2
            items:
                - $ref: "/schemas/types.yaml#/definitions/phandle"
                - $ref: "/schemas/types.yaml#/definitions/uint32"

    status:
        description: |
            The status of the carveouts node.
        enum:
            - okay
            - disabled

required:
    - compatible
    - ivm

examples:
    - |
        vi-carveout {
            compatible = "nvidia,vi_carveout";
            ivm = <&tegra_hv 3>;
            status = "okay";
        };
```

## Documentation/devicetree/bindings/virt/tegra/nvidia,tegra-hv.yaml
```yaml
# Copyright (c) 2024, NVIDIA CORPORATION & AFFILIATES.  All rights reserved.
#
# This program is free software; you can redistribute it and/or modify it
# under the terms and conditions of the GNU General Public License,
# version 2, as published by the Free Software Foundation.
#
# This program is distributed in the hope it will be useful, but WITHOUT
# ANY WARRANTY; without even the implied warranty of MERCHANTABILITY or
# FITNESS FOR A PARTICULAR PURPOSE.  See the GNU General Public License for
# more details.

%YAML 1.2
---
$id: http://devicetree.org/schemas/hyp/nvidia,tegra-hv.yaml#
$schema: http://devicetree.org/meta-schemas/core.yaml#

title: Tegra Hypervisor Driver Module

maintainers:
  - Sreenivas Velpula
  - Manish Bhardwaj

description: |
     the compatability = nvidia,tegra-hv is mentioned in the following drivers
        - <TOP>/kernel/nvidia-oot/drivers/block/tegra_virt_storage/tegra_hv_vblk.c
        - <TOP>/kernel/nvidia-oot/drivers/block/tegra_oops_virt_storage/tegra_hv_vblk_oops.c
        - <TOP>/kernel/nvidia-oot/drivers/virt/tegra/tegra_hv_vcpu_yield.c
        - <TOP>/kernel/nvidia-oot/drivers/virt/tegra/tegra_hv.c
        - <TOP>/kernel/nvidia-oot/drivers/virt/tegra/tegra_hv_pm_ctl.c
        - <TOP>/kernel/nvidia-oot/drivers/platform/tegra/tegra-hv-xhci-debug.c
        - <TOP>/kernel/nvidia-oot/drivers/platform/tegra/tegra-hv-xhci.c

     The following nodes use this compatibility
        - /hyp

select:
  properties:
    compatible:
        minItems: 1
        maxItems: 1
        items:
            enum:
                - nvidia,tegra-hv

  required:
    - compatible

properties:

required:
    - compatible

examples:
    - |
      hyp {
         compatible = "nvidia,tegra-hv";
         status = "okay";
         phandle = <0x10>;
      };
```

## Documentation/devicetree/bindings/watchdog/nvidia,tegra-wdt-t264.yaml
```yaml
# Copyright (c) 2024, NVIDIA CORPORATION & AFFILIATES.  All rights reserved.
#
# This program is free software; you can redistribute it and/or modify it
# under the terms and conditions of the GNU General Public License,
# version 2, as published by the Free Software Foundation.
#
# This program is distributed in the hope it will be useful, but WITHOUT
# ANY WARRANTY; without even the implied warranty of MERCHANTABILITY or
# FITNESS FOR A PARTICULAR PURPOSE.  See the GNU General Public License for
# more details.

%YAML 1.2
---
$id: http://devicetree.org/schemas/watchdog@8110000/nvidia,tegra-wdt-t264.yaml#
$schema: http://devicetree.org/meta-schemas/core.yaml#

title: Tegra Watchdog Driver

maintainers:
  - Suresh Mangipudi

description: |
     the compatability = nvidia,tegra-wdt-t264 is mentioned in the following drivers
        - <TOP>/kernel/nvidia-oot/drivers/watchdog/watchdog-tegra-t18x.c

     The following nodes use this compatibility
        - /bus@0/watchdog@8110000

select:
  properties:
    compatible:
        minItems: 1
        maxItems: 1
        items:
            enum:
                - nvidia,tegra-wdt-t264

  required:
    - compatible

properties:

    reg:
        $ref: "/schemas/types.yaml#/definitions/uint32-matrix"
        description: |
            Registers are given by a tuple of two values:
                - register address:
                - register block size.
        items:
            minItems: 4
            maxItems: 4
            items:
                - $ref: "/schemas/types.yaml#/definitions/uint32"
                  minimum: 0x0
                  maximum: 0x0
                - $ref: "/schemas/types.yaml#/definitions/uint32"
                  minimum: 0x8000000
                  maximum: 0x8110000
                - $ref: "/schemas/types.yaml#/definitions/uint32"
                  minimum: 0x0
                  maximum: 0x0
                - $ref: "/schemas/types.yaml#/definitions/uint32"
                  minimum: 0x10000
                  maximum: 0x10000

    interrupts:
        $ref: "/schemas/types.yaml#/definitions/uint32-matrix"
        description: |
            Interrupts are give by a tuple of 3 values:
                - interrupt specifier (GIC_SPI = 0, GIC_PPI = 1)
                  definitions in dt-bindings/interrupt-controller/arm-gic.h
                - interrupt number
                - trigger type (rising edge, falling edge, both, etc)
                  definitions in dt-bindings/interrupt-controller/irq.h
        items:
            items:
                - $ref: "/schemas/types.yaml#/definitions/uint32"
                  minimum: 0x0
                  maximum: 0x0
                - $ref: "/schemas/types.yaml#/definitions/uint32"
                  minimum: 0x305
                  maximum: 0x308
                - $ref: "/schemas/types.yaml#/definitions/uint32"
                  minimum: 0x4
                  maximum: 0x4

    nvidia,watchdog-index:
        $ref: "/schemas/types.yaml#/definitions/uint32"
        minimum: 0x0
        maximum: 0x0

    nvidia,timer-index:
        $ref: "/schemas/types.yaml#/definitions/uint32"
        minimum: 0x0
        maximum: 0x0

    nvidia,shared-interrupt:
        $ref: "/schemas/types.yaml#/definitions/uint32"
        minimum: 0x0
        maximum: 0x0

    timeout-sec:
        $ref: "/schemas/types.yaml#/definitions/uint32"
        minimum: 0x78
        maximum: 0x78

    nvidia,wdt-error-threshold:
        $ref: "/schemas/types.yaml#/definitions/uint32"
        minimum: 0x5
        maximum: 0x5

    nvidia,extend-watchdog-suspend:
        $ref: "/schemas/types.yaml#/definitions/flag"

    nvidia,disable-debug-reset:
        $ref: "/schemas/types.yaml#/definitions/flag"

    nvidia,disable-por-reset:
        $ref: "/schemas/types.yaml#/definitions/flag"

required:
    - compatible
    - reg
    - interrupts

examples:
    - |
        watchdog@8110000 {
            compatible = "nvidia,tegra-wdt-t264";
            reg = <0x0 0x08110000 0x0 0x10000>,
                  <0x0 0x08010000 0x0 0x10000>,
                  <0x0 0x08000000 0x0 0x10000>;
            interrupts = <GIC_SPI 773 IRQ_TYPE_LEVEL_HIGH>,
                         <GIC_SPI 774 IRQ_TYPE_LEVEL_HIGH>,
                         <GIC_SPI 775 IRQ_TYPE_LEVEL_HIGH>,
                         <GIC_SPI 776 IRQ_TYPE_LEVEL_HIGH>;
            nvidia,watchdog-index = <0>;
            nvidia,timer-index = <0>;
            nvidia,shared-interrupt = <0>;
            timeout-sec = <120>;
            nvidia,wdt-error-threshold = <5>;
            nvidia,extend-watchdog-suspend;
            nvidia,disable-debug-reset;
            nvidia,disable-por-reset;
            status = "disabled";
        };
```
