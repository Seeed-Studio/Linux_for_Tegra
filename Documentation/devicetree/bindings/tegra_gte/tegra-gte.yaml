## Documentation/devicetree/bindings/tegra_gte/tegra-gte.yaml
```yaml
# SPDX-License-Identifier: GPL-2.0
%YAML 1.2
---
$id: http://devicetree.org/schemas/tegra_gte/tegra-gte.yaml#
$schema: http://devicetree.org/meta-schemas/core.yaml#

title: NVIDIA Tegra T194 GTE (Generic hardware Timestamping Engine) bindings

maintainers:
  - Dipen Patel <dipenp@nvidia.com>

description: |+
  GTE is a hardware block which monitors various events for the state change and
  timestamps them using TSC counter. Tegra implements LIC GTE and AON GTE
  instances. LIC GTE is used only to monitor LIC IRQ lines and AON GTE is used
  to monitor Always On domain GPIO lines.

properties:
  compatible:
    enum:
      - nvidia,tegra194-gte-lic
      - nvidia,tegra194-gte-aon
      - nvidia,tegra234-gte-aon

  reg:
    maxItems: 1
    description: physical base address.

  interrupts:
    description:
	    interrupt number

  nvidia,int-threshold:
    $ref: /schemas/types.yaml#/definitions/uint32
    description:
      GTE device generates its interrupt based on this u32 FIFO threshold
      value. The recommended value is 1.
    minimum: 1
    maximum: 256

  nvidia,num-slices:
    $ref: /schemas/types.yaml#/definitions/uint32
    description:
      GTE lines are arranged in 32 bit slice where each bit represents different
      line/signal that it can enable/configure for the timestamp. It is u32
      property and the value depends on the GTE instance in the chip. Tegra194
      LIC instance uses 11 slices while Tegra234 instance uses 17 slices to
      represent interrupts line from LIC. The AON-GPIO GTE instances for both
      Tegra194 and Tegra234 use 3 slices for the GPIO.
    enum: [3, 11, 17]

required:
  - compatible
  - reg
  - interrupts
  - nvidia,num-slices

additionalProperties: false

examples:
  - |
    gte@3aa0000 {
        interrupts = <0x00 0x0b 0x04>;
        compatible = "nvidia,tegra194-gte-lic";
        nvidia,int-threshold = <0x01>;
        status = "okay";
        nvidia,num-slices = <0x11>;
        reg = <0x3aa0000 0x10000>;
    };

    gte@c1e0000 {
        interrupts = <0x00 0x0d 0x04>;
        compatible = "nvidia,tegra234-gte-aon";
        nvidia,int-threshold = <0x01>;
        status = "okay";
        nvidia,num-slices = <0x03>;
        reg = <0xc1e0000 0x10000>;
    };
```

## Documentation/devicetree/bindings/thermal/tegra/nvidia,tegra186-bpmp-thermal.yaml
```yaml
# Copyright (c) 2024, NVIDIA CORPORATION & AFFILIATES.  All rights reserved.
#
# This program is free software; you can redistribute it and/or modify it
# under the terms and conditions of the GNU General Public License,
# version 2, as published by the Free Software Foundation.
#
# This program is distributed in the hope it will be useful, but WITHOUT
# ANY WARRANTY; without even the implied warranty of MERCHANTABILITY or
# FITNESS FOR A PARTICULAR PURPOSE.  See the GNU General Public License for
# more details.

%YAML 1.2
---
$id: http://devicetree.org/schemas/thermal/nvidia,tegra186-bpmp-thermal.yaml#
$schema: http://devicetree.org/meta-schemas/core.yaml#

title: NVIDIA Tegra BPMP thermal sensor driver

maintainers:
  - Yi-Wei Wang

description: |
     the compatability = nvidia,tegra186-bpmp-thermal is mentioned in the following drivers
        - <TOP>/kernel/kernel-oot/drivers/thermal/tegra/tegra-bpmp-thermal.c

     The following nodes use this compatibility
        - /bpmp/thermal

select:
  properties:
    compatible:
        minItems: 1
        maxItems: 1
        items:
            enum:
                - nvidia,tegra186-bpmp-thermal

  required:
    - compatible

properties:

    '#thermal-sensor-cells':
        $ref: "/schemas/types.yaml#/definitions/uint32"
        minimum: 0x1
        maximum: 0x1

required:
    - compatible

examples:
    - |
        thermal {
            compatible = "nvidia,tegra186-bpmp-thermal";
            status = "disabled";
            #thermal-sensor-cells = <1>;
        };
```

## Documentation/devicetree/bindings/tty/serial/arm,pl011.yaml
```yaml
# Copyright (c) 2024, NVIDIA CORPORATION & AFFILIATES.  All rights reserved.
#
# This program is free software; you can redistribute it and/or modify it
# under the terms and conditions of the GNU General Public License,
# version 2, as published by the Free Software Foundation.
#
# This program is distributed in the hope it will be useful, but WITHOUT
# ANY WARRANTY; without even the implied warranty of MERCHANTABILITY or
# FITNESS FOR A PARTICULAR PURPOSE.  See the GNU General Public License for
# more details.

%YAML 1.2
---
$id: http://devicetree.org/schemas/serial@810c500000/arm,pl011.yaml#
$schema: http://devicetree.org/meta-schemas/core.yaml#

title: ARM AMBA serial port driver

maintainers:
  - Suresh Mangipudi

description: |
     the compatability = arm,pl011 is mentioned in the following drivers
        - <TOP>/kernel/kernel-oot/drivers/tty/serial/amba-pl011.c

     The following nodes use this compatibility
        - /bus@0/serial@810c500000
        - /bus@0/serial@810c510000
        - /bus@0/serial@a808800000
        - /bus@0/serial@810c530000
        - /bus@0/serial@810c540000

select:
  properties:
    compatible:
        minItems: 2
        maxItems: 2
        items:
            enum:
                - arm,pl011
                - arm,primecell

  required:
    - compatible

properties:

    reg:
        $ref: "/schemas/types.yaml#/definitions/uint32-matrix"
        description: |
            Registers are given by a tuple of two values:
                - register address:
                - register block size.
        items:
            minItems: 4
            maxItems: 4
            items:
                - $ref: "/schemas/types.yaml#/definitions/uint32"
                  minimum: 0x81
                  maximum: 0xa8
                - $ref: "/schemas/types.yaml#/definitions/uint32"
                  minimum: 0x8800000
                  maximum: 0xc540000
                - $ref: "/schemas/types.yaml#/definitions/uint32"
                  minimum: 0x0
                  maximum: 0x0
                - $ref: "/schemas/types.yaml#/definitions/uint32"
                  minimum: 0x10000
                  maximum: 0x10000

    interrupts:
        $ref: "/schemas/types.yaml#/definitions/uint32-matrix"
        description: |
            Interrupts are give by a tuple of 3 values:
                - interrupt specifier (GIC_SPI = 0, GIC_PPI = 1)
                  definitions in dt-bindings/interrupt-controller/arm-gic.h
                - interrupt number
                - trigger type (rising edge, falling edge, both, etc)
                  definitions in dt-bindings/interrupt-controller/irq.h
        items:
            items:
                - $ref: "/schemas/types.yaml#/definitions/uint32"
                  minimum: 0x0
                  maximum: 0x0
                - $ref: "/schemas/types.yaml#/definitions/uint32"
                  minimum: 0xaa
                  maximum: 0x3b6
                - $ref: "/schemas/types.yaml#/definitions/uint32"
                  minimum: 0x4
                  maximum: 0x4

    clocks:
        $ref: "/schemas/types.yaml#/definitions/uint32-matrix"
        description: |
            Clocks are given by a tuple of 2 values:
                - Phandle to the device
                - Clock ID
        items:
            minItems: 2
            maxItems: 2
            items:
                - $ref: "/schemas/types.yaml#/definitions/uint32"
                - $ref: "/schemas/types.yaml#/definitions/uint32"
                  minimum: 0x16
                  maximum: 0x38

    clock-names:
        $ref: "/schemas/types.yaml#/definitions/string-array"
        items:
            enum:
                - uartclk
                - apb_pclk


    assigned-clocks:
        $ref: "/schemas/types.yaml#/definitions/uint32-matrix"
        items:
            minItems: 2
            maxItems: 2
            items:
                - $ref: "/schemas/types.yaml#/definitions/uint32"
                - $ref: "/schemas/types.yaml#/definitions/uint32"
                  minimum: 0x33
                  maximum: 0x38

    assigned-clock-parents:
        $ref: "/schemas/types.yaml#/definitions/uint32-matrix"
        items:
            minItems: 2
            maxItems: 2
            items:
                - $ref: "/schemas/types.yaml#/definitions/uint32"
                - $ref: "/schemas/types.yaml#/definitions/uint32"
                  minimum: 0x16
                  maximum: 0x16

    dmas:
        $ref: "/schemas/types.yaml#/definitions/uint32-matrix"
        items:
            minItems: 4
            maxItems: 4
            items:
                - $ref: "/schemas/types.yaml#/definitions/uint32"
                - $ref: "/schemas/types.yaml#/definitions/uint32"
                  minimum: 0xa
                  maximum: 0xd
                - $ref: "/schemas/types.yaml#/definitions/uint32"
                  minimum: 0xa
                  maximum: 0x17
                - $ref: "/schemas/types.yaml#/definitions/uint32"
                  minimum: 0x800
                  maximum: 0x800

    dma-names:
        $ref: "/schemas/types.yaml#/definitions/string-array"
        items:
            enum:
                - rx
                - tx


    dma-coherent:
        $ref: "/schemas/types.yaml#/definitions/flag"

    arm,primecell-periphid:
        $ref: "/schemas/types.yaml#/definitions/uint32"
        minimum: 0x51011
        maximum: 0x51011

    resets:
        $ref: "/schemas/types.yaml#/definitions/uint32-matrix"
        description: |
            Resets are given by a tuple of 2 values:
                - Phandle to the device
                - Reset ID
        items:
            minItems: 2
            maxItems: 2
            items:
                - $ref: "/schemas/types.yaml#/definitions/uint32"
                - $ref: "/schemas/types.yaml#/definitions/uint32"
                  minimum: 0x50
                  maximum: 0x54

    reset-names:
        $ref: "/schemas/types.yaml#/definitions/string-array"
        items:
            enum:
                - serial


required:
    - compatible
    - reg
    - interrupts
    - clocks
    - clock-names
    - resets
    - reset-names

examples:
    - |
        serial@810c500000 {
            compatible = "arm,pl011, arm,primecell";
            reg = <0x81 0x0c500000 0x0 0x10000>;
            interrupts = <GIC_SPI 170 IRQ_TYPE_LEVEL_HIGH>;
            clocks = <&bpmp TEGRA264_CLK_UART4>,
                     <&bpmp TEGRA264_CLK_PLLP_OUT0>;
            clock-names = "uartclk, apb_pclk";
            assigned-clocks = <&bpmp TEGRA264_CLK_UART4>;
            assigned-clock-parents = <&bpmp TEGRA264_CLK_PLLP_OUT0>;
            dmas = <&gpcdma 13 23 TEGRA_SID_GPCDMA>,
                   <&gpcdma 13 13 TEGRA_SID_GPCDMA>;
            dma-names = "rx, tx";
            dma-coherent;
            arm,primecell-periphid = <0x00051011>;
            resets = <&bpmp TEGRA264_RESET_UART4>;
            reset-names = "serial";
            status = "disabled";
        };
```

## Documentation/devicetree/bindings/tty/serial/nvidia,tegra264-utc.yaml
```yaml
# Copyright (c) 2024, NVIDIA CORPORATION & AFFILIATES.  All rights reserved.
#
# This program is free software; you can redistribute it and/or modify it
# under the terms and conditions of the GNU General Public License,
# version 2, as published by the Free Software Foundation.
#
# This program is distributed in the hope it will be useful, but WITHOUT
# ANY WARRANTY; without even the implied warranty of MERCHANTABILITY or
# FITNESS FOR A PARTICULAR PURPOSE.  See the GNU General Public License for
# more details.

%YAML 1.2
---
$id: http://devicetree.org/schemas/tegra-utc@c4e0000/nvidia,tegra264-utc.yaml#
$schema: http://devicetree.org/meta-schemas/core.yaml#

title: Tegra UART Trace Controller

maintainers:
  - Suresh Mangipudi

description: |
     the compatability = nvidia,tegra264-utc is mentioned in the following drivers
        - <TOP>/kernel/kernel-oot/drivers/tty/serial/tegra-utc.c

     The following nodes use this compatibility
        - /bus@0/tegra-utc@c4e0000
        - /bus@0/tegra-utc@c5a0000

select:
  properties:
    compatible:
        minItems: 1
        maxItems: 1
        items:
            enum:
                - nvidia,tegra264-utc

  required:
    - compatible

properties:

    reg:
        $ref: "/schemas/types.yaml#/definitions/uint32-matrix"
        description: |
            Registers are given by a tuple of two values:
                - register address:
                - register block size.
        items:
            minItems: 4
            maxItems: 4
            items:
                - $ref: "/schemas/types.yaml#/definitions/uint32"
                  minimum: 0x0
                  maximum: 0x0
                - $ref: "/schemas/types.yaml#/definitions/uint32"
                  minimum: 0xc4e0000
                  maximum: 0xc5a8000
                - $ref: "/schemas/types.yaml#/definitions/uint32"
                  minimum: 0x0
                  maximum: 0x0
                - $ref: "/schemas/types.yaml#/definitions/uint32"
                  minimum: 0x8000
                  maximum: 0x8000

    reg-names:
        $ref: "/schemas/types.yaml#/definitions/string-array"
        items:
            enum:
                - rx
                - tx


    interrupts:
        $ref: "/schemas/types.yaml#/definitions/uint32-matrix"
        description: |
            Interrupts are give by a tuple of 3 values:
                - interrupt specifier (GIC_SPI = 0, GIC_PPI = 1)
                  definitions in dt-bindings/interrupt-controller/arm-gic.h
                - interrupt number
                - trigger type (rising edge, falling edge, both, etc)
                  definitions in dt-bindings/interrupt-controller/irq.h
        items:
            items:
                - $ref: "/schemas/types.yaml#/definitions/uint32"
                  minimum: 0x0
                  maximum: 0x0
                - $ref: "/schemas/types.yaml#/definitions/uint32"
                  minimum: 0x203
                  maximum: 0x20f
                - $ref: "/schemas/types.yaml#/definitions/uint32"
                  minimum: 0x4
                  maximum: 0x4

    current-speed:
        $ref: "/schemas/types.yaml#/definitions/uint32"
        minimum: 0x1c200
        maximum: 0x1c200

required:
    - compatible
    - reg
    - interrupts

examples:
    - |
        tegra-utc@c4e0000 {
            compatible = "nvidia,tegra264-utc";
            reg = <0x0 0x0c4e8000 0x0 0x8000>,
                  <0x0 0x0c4e0000 0x0 0x8000>;
            reg-names = "rx, tx";
            interrupts = <GIC_SPI 515 IRQ_TYPE_LEVEL_HIGH>;
            current-speed = <115200>;
            status = "disabled";
        };
```
