## source/kernel/kernel-noble/arch/arm64/configs/tegra_recovery_chain_defconfig
```kconfig
CONFIG_LOCALVERSION="-recovery"
CONFIG_SYSVIPC=y
CONFIG_POSIX_MQUEUE=y
CONFIG_NO_HZ_IDLE=y
CONFIG_HIGH_RES_TIMERS=y
CONFIG_PREEMPT=y
CONFIG_CGROUPS=y
CONFIG_MEMCG=y
CONFIG_BLK_CGROUP=y
CONFIG_CGROUP_SCHED=y
CONFIG_CGROUP_PIDS=y
CONFIG_CGROUP_FREEZER=y
CONFIG_CGROUP_HUGETLB=y
CONFIG_CPUSETS=y
CONFIG_CGROUP_DEVICE=y
CONFIG_CGROUP_CPUACCT=y
CONFIG_USER_NS=y
CONFIG_BLK_DEV_INITRD=y
CONFIG_KEXEC=y
CONFIG_KEXEC_FILE=y
CONFIG_CRASH_DUMP=y
CONFIG_ARCH_TEGRA=y
CONFIG_ARM64_VA_BITS_48=y
CONFIG_SCHED_MC=y
CONFIG_SCHED_SMT=y
CONFIG_NUMA=y
CONFIG_XEN=y
CONFIG_ARM64_SW_TTBR0_PAN=y
CONFIG_ARM64_PMEM=y
CONFIG_RANDOMIZE_BASE=y
CONFIG_WQ_POWER_EFFICIENT_DEFAULT=y
CONFIG_ACPI=y
CONFIG_VIRTUALIZATION=y
CONFIG_JUMP_LABEL=y
CONFIG_MODULES=y
CONFIG_MODULE_UNLOAD=y
CONFIG_MODVERSIONS=y
CONFIG_MODULE_SIG=y
CONFIG_MODULE_SIG_SHA512=y
# CONFIG_CORE_DUMP_DEFAULT_ELF_HEADERS is not set
CONFIG_BINFMT_MISC=y
CONFIG_SLAB_FREELIST_RANDOM=y
CONFIG_SLAB_FREELIST_HARDENED=y
# CONFIG_COMPAT_BRK is not set
CONFIG_DEFAULT_MMAP_MIN_ADDR=32768
CONFIG_TRANSPARENT_HUGEPAGE=y
CONFIG_NET=y
CONFIG_PACKET=y
CONFIG_UNIX=y
CONFIG_INET=y
CONFIG_IP_MULTICAST=y
CONFIG_IP_PNP=y
CONFIG_IP_PNP_DHCP=y
CONFIG_IP_PNP_BOOTP=y
CONFIG_SYN_COOKIES=y
CONFIG_BRIDGE=m
CONFIG_VLAN_8021Q=m
CONFIG_CFG80211=y
CONFIG_PCI=y
CONFIG_PCI_TEGRA=y
CONFIG_PCI_ENDPOINT=y
CONFIG_DEVTMPFS=y
CONFIG_DEVTMPFS_MOUNT=y
CONFIG_FW_LOADER_USER_HELPER=y
CONFIG_TEGRA_ACONNECT=m
CONFIG_ARM_SCMI_PROTOCOL=y
CONFIG_ARM_SCPI_PROTOCOL=y
CONFIG_NETDEVICES=y
CONFIG_MACVLAN=m
CONFIG_PHYLIB=y
CONFIG_MICREL_PHY=y
CONFIG_MICROSEMI_PHY=y
CONFIG_AT803X_PHY=y
CONFIG_REALTEK_PHY=y
CONFIG_ROCKCHIP_PHY=y
CONFIG_VITESSE_PHY=y
CONFIG_MDIO_BUS_MUX_MULTIPLEXER=y
CONFIG_MDIO_BUS_MUX_MMIOREG=y
CONFIG_INPUT_EVDEV=y
CONFIG_INPUT_MISC=y
# CONFIG_SERIO_SERPORT is not set
CONFIG_SERIO_AMBAKMI=y
CONFIG_SERIAL_8250=y
CONFIG_SERIAL_8250_CONSOLE=y
CONFIG_SERIAL_8250_EXTENDED=y
CONFIG_SERIAL_8250_SHARE_IRQ=y
CONFIG_SERIAL_8250_DW=y
CONFIG_SERIAL_OF_PLATFORM=y
CONFIG_SERIAL_AMBA_PL011=y
CONFIG_SERIAL_AMBA_PL011_CONSOLE=y
CONFIG_SERIAL_TEGRA=y
CONFIG_SERIAL_TEGRA_TCU=y
CONFIG_SERIAL_XILINX_PS_UART=y
CONFIG_SERIAL_XILINX_PS_UART_CONSOLE=y
CONFIG_SERIAL_FSL_LPUART=y
CONFIG_SERIAL_FSL_LPUART_CONSOLE=y
CONFIG_SERIAL_FSL_LINFLEXUART=y
CONFIG_SERIAL_FSL_LINFLEXUART_CONSOLE=y
CONFIG_SERIAL_DEV_BUS=y
CONFIG_VIRTIO_CONSOLE=y
CONFIG_TCG_TPM=y
CONFIG_PINCTRL_SINGLE=y
CONFIG_POWER_RESET_SYSCON=y
CONFIG_SYSCON_REBOOT_MODE=y
CONFIG_CPU_THERMAL=y
CONFIG_THERMAL_EMULATION=y
CONFIG_TEGRA_SOCTHERM=m
CONFIG_TEGRA_BPMP_THERMAL=m
CONFIG_WATCHDOG=y
CONFIG_ARM_SMC_WATCHDOG=y
CONFIG_REGULATOR=y
CONFIG_REGULATOR_FIXED_VOLTAGE=y
CONFIG_REGULATOR_VCTRL=m
CONFIG_TEGRA_HOST1X=m
CONFIG_RTC_CLASS=y
CONFIG_RTC_DRV_TEGRA=y
CONFIG_DMADEVICES=y
CONFIG_TEGRA186_GPC_DMA=y
CONFIG_TEGRA20_APB_DMA=y
CONFIG_TEGRA210_ADMA=m
CONFIG_SYNC_FILE=y
CONFIG_VIRT_DRIVERS=y
CONFIG_STAGING=y
CONFIG_STAGING_MEDIA=y
CONFIG_TEGRA_EPL=y
CONFIG_HWSPINLOCK=y
CONFIG_ARM_MHU=y
CONFIG_PLATFORM_MHU=y
CONFIG_ARM_SMMU=y
CONFIG_ARM_SMMU_V3=y
CONFIG_ARCH_TEGRA_132_SOC=y
CONFIG_ARCH_TEGRA_210_SOC=y
CONFIG_ARCH_TEGRA_186_SOC=y
CONFIG_ARCH_TEGRA_194_SOC=y
CONFIG_ARCH_TEGRA_234_SOC=y
CONFIG_ARCH_TEGRA_264_SOC=y
CONFIG_PWM=y
CONFIG_MUX_MMIO=y
CONFIG_INTERCONNECT=y
CONFIG_EXT2_FS=y
CONFIG_EXT3_FS=y
CONFIG_EXT4_FS_POSIX_ACL=y
CONFIG_FANOTIFY=y
CONFIG_FANOTIFY_ACCESS_PERMISSIONS=y
CONFIG_QUOTA=y
CONFIG_VFAT_FS=y
CONFIG_HUGETLBFS=y
CONFIG_SQUASHFS=y
CONFIG_NFS_FS=y
CONFIG_NFS_V4=y
CONFIG_NFS_V4_1=y
CONFIG_NFS_V4_2=y
CONFIG_ROOT_NFS=y
CONFIG_NLS_ISO8859_1=y
CONFIG_SECURITY_DMESG_RESTRICT=y
CONFIG_SECURITY=y
CONFIG_SECURITY_NETWORK=y
CONFIG_HARDENED_USERCOPY=y
CONFIG_FORTIFY_SOURCE=y
CONFIG_LSM="landlock,lockdown,yama,loadpin,safesetid,integrity,selinux,bpf"
CONFIG_CRYPTO_CTR=m
CONFIG_CRYPTO_GHASH=m
CONFIG_PACKING=y
CONFIG_PRINTK_TIME=y
CONFIG_MAGIC_SYSRQ=y
CONFIG_DEBUG_FS=y
CONFIG_DEBUG_FS_ALLOW_NONE=y
CONFIG_IO_STRICT_DEVMEM=y
```

## source/nvidia-oot/Documentation/devicetree/bindings/arm/arm64-ras.yaml
```yaml
# SPDX-License-Identifier: (GPL-2.0 OR BSD-2-Clause)
%YAML 1.2
---
$id: http://devicetree.org/schemas/arm/arm64-ras.yaml#
$schema: http://devicetree.org/meta-schemas/core.yaml#

title: Device tree binding for ARMv8.2 RAS

maintainers:
  - Laxman Dewangan <ldewangan@nvidia.com>

description: |
   RAS are three aspects of the dependability of a system:
   Reliability: continuity of correct service
   Availability: readiness for correct service
   Serviceability: ability to undergo modifications and repairs

   ARMv8.2 provides RAS extensions to achieve the above features in a system.

   arm64_ras driver allows you to handle Correctable errors using per core
   Fault Handling Interrupt (or FHI). Un-correactable errors are handled by
   raising SError exception to kernel or Trusted Firmware(EL3) on CCLEX.

   The driver provides an API for CPU specific RAS drivers to
   register callbacks in case of FHI. When FHI occurs, the FHI
   ISR goes through the list of registered callbacks and executes
   them. Similarly, the driver allows registering SError callbacks
   for Un-correctable errors within Core, Core-Cluster & CCPLEX.
   When SError is reported, then those callbacks are scanned to
   find and report error in a Core, Cluster or CCPLEX

properties:
  compatible:
    enum:
      - arm,armv8.2-ras

  interrupts:
    minItems: 1
    maxItems: 8
    description: |
       Represents per core Fault Handling Interrupt.

required:
  - compatible
  - interrupts

unevaluatedProperties: false

examples:
  - |
    arm64_ras: arm64_ras {
       compatible = "arm,armv8.2-ras";
       interrupts = <0 392 0x04>,
                    <0 393 0x04>,
                    <0 394 0x04>,
                    <0 395 0x04>,
                    <0 396 0x04>,
                    <0 397 0x04>,
                    <0 398 0x04>,
                    <0 399 0x04>;
    };
...
```

## source/nvidia-oot/Documentation/devicetree/bindings/block/tegra_oops_nvlog/tegra-nvlog-oops-storage.txt
```
Tegra NvLog crash dump storage driver

The NvLog OOPS storage driver captures kernel crash dumps (panic/oops) and writes
them to hypervisor shared memory using NVIDIA's NvLog framework raw binary protocol.
This driver operates exclusively in crash context when the kernel panics, ensuring
critical crash data is preserved for post-mortem analysis.

Key Features:
- Executes only during kernel panic/oops (not during normal operation)
- Captures KMSG (kernel messages) data from pstore framework
- Uses ARM64-safe operations for reliability in crash context
- Writes raw binary data to circular buffer in hypervisor memory
- NvLog Server handles message wrapping and storage
- Preserves crash dumps even if filesystem is corrupted
- Compatible with existing NvLog infrastructure

Architecture:
When a kernel panic occurs, this driver is invoked through the pstore framework
to capture KMSG crash data. It writes the raw compressed panic data directly to
a pre-allocated hypervisor shared memory region (mempool) using a circular buffer
protocol. The driver does NOT format messages - it writes raw binary data that
the NvLog Server subsequently reads, wraps in NvLogMsg_t format, and stores.

Important: During kernel panic, ONLY KMSG data is sent by the pstore framework.
Console, FTRACE, and PMSG data are NOT available during panic due to the unstable
state of the kernel. This driver is optimized for this single-purpose operation.

Required Properties:
- compatible: should be "nvidia,tegra-nvlog-oops-storage"
- nvlog_kmsg_entity_id: Entity ID for kernel panic messages and stack traces
- nvlog_mempool_id: Hypervisor mempool ID for crash data storage

Optional Properties:
- pstore_max_reason: Crash capture threshold (default and fixed: 2)
    Value 2 = KMSG_DUMP_OOPS (captures PANIC and OOPS events)
- pstore_kmsg_size: Buffer for kernel panic dumps (default: 64KB)
    Size should be block-aligned, range: 4KB - 1MB

Entity ID Values:
Entity ID format: [15:14]=0xC (mark), [13:8]=Entity, [7:0]=Sub-Entity

Common KMSG Entity ID Assignments:
- 0xC001: GOS0 (Primary VM) kernel panic messages
- 0xC201: GOS1 (Secondary VM) kernel panic messages
- 0xC401: GOS2 kernel panic messages
- 0xC601: GOS3 kernel panic messages

Custom values: 0xC000-0xFFFF range

Raw Binary Protocol:
The driver implements a circular buffer protocol with metadata:
- 8 x u64 metadata array at start of mempool
- Metadata[0]: Signature (0xDEADBEEFDEADBEEF)
- Metadata[1]: Data start offset
- Metadata[2]: Read offset (updated by consumer)
- Metadata[3]: Write offset (updated by driver)
- Metadata[5]: Total bytes written
- Metadata[7]: End tag (set to 1 when dump complete)

Data Flow:
1. Pstore framework provides compressed KMSG data (DBGC header)
2. Driver writes raw data to circular buffer at write offset
3. Driver updates write offset and sets end tag
4. NvLog Server reads raw data from circular buffer
5. NvLog Server wraps data in NvLogMsg_t and stores

Common Crash Storage Configuration:
- Mempool ID 153 (NVLOG_SERVER_M_153): Dedicated crash dump storage
- Pre-allocated to ensure availability during panic
- Raw binary writes to circular buffer
- Survives kernel crashes for retrieval

The crash mempool must be configured in hypervisor PCT configuration
to ensure it's allocated before any kernel crash occurs.

Standard Configuration Example:
	tegra_nvlog_oops {
		compatible = "nvidia,tegra-nvlog-oops-storage";
		status = "okay";

		/* Crash data storage mempool */
		nvlog_mempool_id = <153>;              /* Pre-allocated crash storage */

		/* Entity ID for kernel panic dumps (only KMSG sent during panic) */
		nvlog_kmsg_entity_id = <0xC001>;       /* KMSG panic data */

		/* pstore configuration */
		pstore_kmsg_size = <0x10000>;          /* 64KB for KMSG */
		pstore_max_reason = <2>;               /* Panic/oops threshold */
	};

Crash Context Notes:
- Driver executes only during kernel panic/oops
- Receives compressed data from pstore (DBGC format)
- Uses ARM64-safe operations for crash reliability
- Pre-allocated mempool survives kernel crashes
- Raw binary writes to circular buffer
- No message formatting in driver (NvLog Server handles)
- Only KMSG data available during panic
- Crash data retrieved after reboot via NvLog infrastructure
```

## source/nvidia-oot/Documentation/devicetree/bindings/clocksource/arm,armv8-timer.yaml
```yaml
# Copyright (c) 2024, NVIDIA CORPORATION & AFFILIATES.  All rights reserved.
#
# This program is free software; you can redistribute it and/or modify it
# under the terms and conditions of the GNU General Public License,
# version 2, as published by the Free Software Foundation.
#
# This program is distributed in the hope it will be useful, but WITHOUT
# ANY WARRANTY; without even the implied warranty of MERCHANTABILITY or
# FITNESS FOR A PARTICULAR PURPOSE.  See the GNU General Public License for
# more details.

%YAML 1.2
---
$id: http://devicetree.org/schemas/timer/arm,armv8-timer.yaml#
$schema: http://devicetree.org/meta-schemas/core.yaml#

title: ARM Architecture Timer

maintainers:
  - Suresh Mangipudi

description: |
     the compatability = arm,armv8-timer is mentioned in the following drivers
        - <TOP>/kernel/kernel-oot/drivers/clocksource/arm_arch_timer.c

     The following nodes use this compatibility
        - /timer

select:
  properties:
    compatible:
        minItems: 1
        maxItems: 1
        items:
            enum:
                - arm,armv8-timer

  required:
    - compatible

properties:

    interrupts:
        $ref: "/schemas/types.yaml#/definitions/uint32-matrix"
        description: |
            Interrupts are give by a tuple of 3 values:
                - interrupt specifier (GIC_SPI = 0, GIC_PPI = 1)
                  definitions in dt-bindings/interrupt-controller/arm-gic.h
                - interrupt number
                - trigger type (rising edge, falling edge, both, etc)
                  definitions in dt-bindings/interrupt-controller/irq.h
        items:
            items:
                - $ref: "/schemas/types.yaml#/definitions/uint32"
                  minimum: 0x1
                  maximum: 0x1
                - $ref: "/schemas/types.yaml#/definitions/uint32"
                  minimum: 0xa
                  maximum: 0xe
                - $ref: "/schemas/types.yaml#/definitions/uint32"
                  minimum: 0x8
                  maximum: 0x8

    interrupt-parent:
        $ref: "/schemas/types.yaml#/definitions/uint32"

    always-on:
        $ref: "/schemas/types.yaml#/definitions/flag"

required:
    - compatible
    - interrupts

examples:
    - |
        timer {
            compatible = "arm,armv8-timer";
            status = "disabled";
            interrupts = <GIC_PPI 13 8>,
                         <GIC_PPI 14 8>,
                         <GIC_PPI 11 8>,
                         <GIC_PPI 10 8>,
                         <GIC_PPI 12 8>;
            interrupt-parent = <&gic>;
            always-on;
        };
```
