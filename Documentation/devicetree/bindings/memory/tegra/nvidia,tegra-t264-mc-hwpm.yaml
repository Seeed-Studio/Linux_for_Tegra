## Documentation/devicetree/bindings/misc/nvidia,dulink-connection.yaml
```yaml
# Copyright (c) 2024, NVIDIA CORPORATION & AFFILIATES.  All rights reserved.
#
# This program is free software; you can redistribute it and/or modify it
# under the terms and conditions of the GNU General Public License,
# version 2, as published by the Free Software Foundation.
#
# This program is distributed in the hope it will be useful, but WITHOUT
# ANY WARRANTY; without even the implied warranty of MERCHANTABILITY or
# FITNESS FOR A PARTICULAR PURPOSE.  See the GNU General Public License for
# more details.

%YAML 1.2
---
$id: http://devicetree.org/schemas/bootmgr/nvidia,dulink-connection.yaml#
$schema: http://devicetree.org/meta-schemas/core.yaml#

title: Nvidia Drive Update Connection Driver

maintainers:
  - Johnny Fan

description: |

     The following nodes use this compatibility
        - /chosen/driveupdate/bootmgr
        - /chosen/driveupdate/bhc
        - /chosen/driveupdate/decomp
        - /chosen/driveupdate/du-client
        - /chosen/driveupdate/content
        - /chosen/driveupdate/master
        - /chosen/driveupdate/tii
        - /chosen/driveupdate/ctx_store
        - /chosen/driveupdate/auth
        - /chosen/driveupdate/dushell
        - /chosen/driveupdate/plugin
        - /chosen/driveupdate/ddu

select:
  properties:
    compatible:
        minItems: 1
        maxItems: 1
        items:
            enum:
                - nvidia,dulink-connection

  required:
    - compatible

properties:

    remote-path:
        $ref: "/schemas/types.yaml#/definitions/string-array"
        items:
            enum:
                - /bootmgr
                - /bhc
                - /decomp
                - /du-client
                - /content
                - /master
                - /tii
                - /ctx_store
                - /auth
                - /dushell
                - /plugin
                - /ddu


    type:
        $ref: "/schemas/types.yaml#/definitions/string-array"
        items:
            enum:
                - DOWNLINK


    tr-type:
        $ref: "/schemas/types.yaml#/definitions/string-array"
        items:
            enum:
                - NVSCI
                - TCP


    tr-params:
        $ref: "/schemas/types.yaml#/definitions/string-array"
        items:
            enum:
                - nvdu_gos_ipc_a_0
                - nvdu_gos_ipc_a_1
                - nvdu_gos_ipc_b_0
                - nvdu_gos_ipc_b_1
                - nvdu_gos_ipc_c_0
                - nvdu_gos_ipc_c_1
                - nvdu_gos_ipc_d_0
                - nvdu_gos_ipc_d_1
                - nvdu_gos_ipc_e_0
                - nvdu_gos_ipc_e_1
                - nvdu_gos_ipc_l_0
                - nvdu_gos_ipc_l_1
                - nvdu_gos_ipc_j_0
                - nvdu_gos_ipc_j_1
                - nvdu_gos_ipc_k_0
                - nvdu_gos_ipc_k_1
                - nvdu_gos_ipc_m_0
                - nvdu_gos_ipc_m_1
                - nvdu_gos_ipc_f_0
                - nvdu_gos_ipc_f_1
                - nvdu_gos_ipc_g_0
                - nvdu_gos_ipc_g_1
                - TCP_SERVER
                - 0.0.0.0
                - 4455
                - 0


required:
    - compatible

examples:
    - |
        bootmgr {
        };
```

## Documentation/devicetree/bindings/misc/nvidia,smmu_test.yaml
```yaml
# Copyright (c) 2024, NVIDIA CORPORATION & AFFILIATES.  All rights reserved.
#
# This program is free software; you can redistribute it and/or modify it
# under the terms and conditions of the GNU General Public License,
# version 2, as published by the Free Software Foundation.
#
# This program is distributed in the hope it will be useful, but WITHOUT
# ANY WARRANTY; without even the implied warranty of MERCHANTABILITY or
# FITNESS FOR A PARTICULAR PURPOSE.  See the GNU General Public License for
# more details.

%YAML 1.2
---
$id: http://devicetree.org/schemas/smmu_test/nvidia,smmu_test.yaml#
$schema: http://devicetree.org/meta-schemas/core.yaml#

title: Nvidia SMMU Test

maintainers:
  - Sachin Nikam

description: |
     The following nodes use this compatibility
        - /smmu_test

select:
  properties:
    compatible:
        minItems: 1
        maxItems: 1
        items:
            enum:
                - nvidia,smmu_test

  required:
    - compatible

properties:

    iommus:
        $ref: "/schemas/types.yaml#/definitions/uint32-matrix"
        description: |
            iommus are given by a tuple of 2 values:
                - Phandle to the device
                - Device ID
        items:
            minItems: 2
            maxItems: 2
            items:
                - $ref: "/schemas/types.yaml#/definitions/uint32"
                - $ref: "/schemas/types.yaml#/definitions/uint32"
                  minimum: 0x0
                  maximum: 0x0

required:
    - compatible
    - iommus

examples:
    - |
        smmu_test {
            compatible = "nvidia,smmu_test";
            iommus = <&smmu4_mmu 0x00000000>;
            status = "disabled";
        };
```

## Documentation/devicetree/bindings/misc/nvidia,t264-soc-hwpm.yaml
```yaml
# Copyright (c) 2024, NVIDIA CORPORATION & AFFILIATES.  All rights reserved.
#
# This program is free software; you can redistribute it and/or modify it
# under the terms and conditions of the GNU General Public License,
# version 2, as published by the Free Software Foundation.
#
# This program is distributed in the hope it will be useful, but WITHOUT
# ANY WARRANTY; without even the implied warranty of MERCHANTABILITY or
# FITNESS FOR A PARTICULAR PURPOSE.  See the GNU General Public License for
# more details.

%YAML 1.2
---
$id: http://devicetree.org/schemas/tegra_soc_hwpm@1604000/nvidia,t264-soc-hwpm.yaml#
$schema: http://devicetree.org/meta-schemas/core.yaml#

title: Nvidia Tegra SOC-HWPM

maintainers:
  - Besar Wicaksono
  - Vasuki Shankar

description: |
     The following nodes use this compatibility
        - /bus@0/tegra_soc_hwpm@1604000

select:
  properties:
    compatible:
        minItems: 1
        maxItems: 1
        items:
            enum:
                - nvidia,t264-soc-hwpm

  required:
    - compatible

properties:

    dma-coherent:
        $ref: "/schemas/types.yaml#/definitions/flag"

    reg:
        $ref: "/schemas/types.yaml#/definitions/uint32-matrix"
        description: |
            Registers are given by a tuple of two values:
                - register address:
                - register block size.
        items:
            minItems: 4
            maxItems: 4
            items:
                - $ref: "/schemas/types.yaml#/definitions/uint32"
                  minimum: 0x0
                  maximum: 0xa8
                - $ref: "/schemas/types.yaml#/definitions/uint32"
                  minimum: 0x1600000
                  maximum: 0x8160f000
                - $ref: "/schemas/types.yaml#/definitions/uint32"
                  minimum: 0x0
                  maximum: 0x0
                - $ref: "/schemas/types.yaml#/definitions/uint32"
                  minimum: 0x1000
                  maximum: 0x2000

    clocks:
        $ref: "/schemas/types.yaml#/definitions/uint32-matrix"
        description: |
            Clocks are given by a tuple of 2 values:
                - Phandle to the device
                - Clock ID
        items:
            minItems: 2
            maxItems: 2
            items:
                - $ref: "/schemas/types.yaml#/definitions/uint32"
                - $ref: "/schemas/types.yaml#/definitions/uint32"
                  minimum: 0xc
                  maximum: 0xcd

    clock-names:
        $ref: "/schemas/types.yaml#/definitions/string-array"
        items:
            enum:
                - la
                - parent


    resets:
        $ref: "/schemas/types.yaml#/definitions/uint32-matrix"
        description: |
            Resets are given by a tuple of 2 values:
                - Phandle to the device
                - Reset ID
        items:
            minItems: 2
            maxItems: 2
            items:
                - $ref: "/schemas/types.yaml#/definitions/uint32"
                - $ref: "/schemas/types.yaml#/definitions/uint32"
                  minimum: 0xa
                  maximum: 0x14

    reset-names:
        $ref: "/schemas/types.yaml#/definitions/string-array"
        items:
            enum:
                - la
                - hwpm


    iommus:
        $ref: "/schemas/types.yaml#/definitions/uint32-matrix"
        description: |
            iommus are given by a tuple of 2 values:
                - Phandle to the device
                - Device ID
        items:
            minItems: 2
            maxItems: 2
            items:
                - $ref: "/schemas/types.yaml#/definitions/uint32"
                - $ref: "/schemas/types.yaml#/definitions/uint32"
                  minimum: 0xe00
                  maximum: 0xe00

required:
    - compatible
    - reg
    - clocks
    - clock-names
    - resets
    - reset-names
    - iommus

examples:
    - |
        tegra_soc_hwpm@1604000 {
            compatible = "nvidia,t264-soc-hwpm";
            dma-coherent;
            reg = <0x00 0x01600000 0x0 0x1000>,
                  <0x00 0x01604000 0x0 0x1000>,
                  <0x00 0x14100000 0x0 0x1000>,
                  <0x00 0x14110000 0x0 0x1000>,
                  <0x00 0x14120000 0x0 0x1000>,
                  <0x00 0x14130000 0x0 0x1000>,
                  <0x00 0x14140000 0x0 0x1000>,
                  <0x00 0x14150000 0x0 0x1000>,
                  <0x00 0x14160000 0x0 0x1000>,
                  <0x00 0x14170000 0x0 0x1000>,
                  <0x00 0x14180000 0x0 0x1000>,
                  <0x00 0x14190000 0x0 0x1000>,
                  <0x00 0x141a0000 0x0 0x1000>,
                  <0x00 0x141b0000 0x0 0x1000>,
                  <0x00 0x141c0000 0x0 0x1000>,
                  <0x00 0x141d0000 0x0 0x1000>,
                  <0x81 0x01600000 0x0 0x1000>,
                  <0x81 0x01601000 0x0 0x1000>,
                  <0x81 0x01602000 0x0 0x1000>,
                  <0x81 0x01603000 0x0 0x1000>,
                  <0x81 0x01604000 0x0 0x1000>,
                  <0x81 0x01605000 0x0 0x1000>,
                  <0x81 0x01606000 0x0 0x1000>,
                  <0x81 0x01607000 0x0 0x1000>,
                  <0x81 0x01608000 0x0 0x1000>,
                  <0x81 0x01609000 0x0 0x1000>,
                  <0x81 0x0160a000 0x0 0x1000>,
                  <0x81 0x0160b000 0x0 0x1000>,
                  <0x81 0x0160c000 0x0 0x1000>,
                  <0x81 0x0160d000 0x0 0x1000>,
                  <0x81 0x0160e000 0x0 0x1000>,
                  <0x81 0x0160f000 0x0 0x1000>,
                  <0x81 0x01621000 0x0 0x1000>,
                  <0x81 0x01622000 0x0 0x1000>,
                  <0x81 0x01623000 0x0 0x1000>,
                  <0x81 0x01624000 0x0 0x1000>,
                  <0x81 0x01625000 0x0 0x1000>,
                  <0x81 0x01626000 0x0 0x1000>,
                  <0x81 0x01627000 0x0 0x1000>,
                  <0x81 0x01628000 0x0 0x1000>,
                  <0x81 0x01629000 0x0 0x1000>,
                  <0x81 0x0162a000 0x0 0x1000>,
                  <0x81 0x0162b000 0x0 0x1000>,
                  <0x81 0x0162c000 0x0 0x1000>,
                  <0x81 0x0162d000 0x0 0x1000>,
                  <0x81 0x0162e000 0x0 0x1000>,
                  <0x81 0x0162f000 0x0 0x1000>,
                  <0x81 0x01630000 0x0 0x1000>,
                  <0x81 0x01631000 0x0 0x1000>,
                  <0x81 0x01632000 0x0 0x1000>,
                  <0x81 0x0163e000 0x0 0x1000>,
                  <0x81 0x0163f000 0x0 0x1000>,
                  <0x81 0x01642000 0x0 0x1000>,
                  <0x81 0x01643000 0x0 0x1000>,
                  <0x81 0x01644000 0x0 0x1000>,
                  <0x81 0x01645000 0x0 0x1000>,
                  <0x81 0x01646000 0x0 0x1000>,
                  <0x81 0x01647000 0x0 0x1000>,
                  <0x81 0x0164b000 0x0 0x1000>,
                  <0x81 0x0164f000 0x0 0x1000>,
                  <0x81 0x01653000 0x0 0x1000>,
                  <0x81 0x81604000 0x0 0x1000>,
                  <0x81 0x81605000 0x0 0x1000>,
                  <0x81 0x81606000 0x0 0x1000>,
                  <0x81 0x81607000 0x0 0x1000>,
                  <0x81 0x8160b000 0x0 0x1000>,
                  <0x81 0x8160c000 0x0 0x1000>,
                  <0x81 0x8160e000 0x0 0x1000>,
                  <0x81 0x8160f000 0x0 0x1000>,
                  <0x88 0x01601000 0x0 0x1000>,
                  <0x88 0x01602000 0x0 0x1000>,
                  <0xa8 0x01604000 0x0 0x1000>,
                  <0xa8 0x01628000 0x0 0x1000>,
                  <0xa8 0x01629000 0x0 0x1000>,
                  <0x00 0x01610000 0x0 0x2000>,
                  <0x00 0x01612000 0x0 0x1000>;
            clocks = <&bpmp TEGRA264_CLK_LA>,
                     <&bpmp TEGRA264_CLK_SPLL_OUT7>;
            clock-names = "la, parent";
            resets = <&bpmp TEGRA264_RESET_LA>,
                     <&bpmp TEGRA264_RESET_HWPM>;
            reset-names = "la, hwpm";
            iommus = <&smmu1_mmu TEGRA_SID_PMA0>;
            status = "disabled";
        };
```

## Documentation/devicetree/bindings/misc/nvidia,tegra-bpmp-dummy.yaml
```yaml
# Copyright (c) 2024, NVIDIA CORPORATION & AFFILIATES.  All rights reserved.
#
# This program is free software; you can redistribute it and/or modify it
# under the terms and conditions of the GNU General Public License,
# version 2, as published by the Free Software Foundation.
#
# This program is distributed in the hope it will be useful, but WITHOUT
# ANY WARRANTY; without even the implied warranty of MERCHANTABILITY or
# FITNESS FOR A PARTICULAR PURPOSE.  See the GNU General Public License for
# more details.

%YAML 1.2
---
$id: http://devicetree.org/schemas/bpmp-dummy/nvidia,tegra-bpmp-dummy.yaml#
$schema: http://devicetree.org/meta-schemas/core.yaml#

title: Nvidia BPMP Dummy Node

maintainers:
  - Venkat Reddy Talla

description: |
     The following nodes use this compatibility
        - /bpmp-dummy

select:
  properties:
    compatible:
        minItems: 1
        maxItems: 1
        items:
            enum:
                - nvidia,tegra-bpmp-dummy

  required:
    - compatible

properties:

    '#clock-cells':
        $ref: "/schemas/types.yaml#/definitions/uint32"
        minimum: 0x1
        maximum: 0x1

    '#reset-cells':
        $ref: "/schemas/types.yaml#/definitions/uint32"
        minimum: 0x1
        maximum: 0x1

    '#power-domain-cells':
        $ref: "/schemas/types.yaml#/definitions/uint32"
        minimum: 0x1
        maximum: 0x1

required:
    - compatible

examples:
    - |
        bpmp-dummy {
        };
```
