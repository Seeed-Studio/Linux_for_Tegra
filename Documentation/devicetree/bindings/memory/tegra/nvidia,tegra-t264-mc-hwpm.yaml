## Documentation/devicetree/bindings/memory/tegra/nvidia,tegra-t264-mc-hwpm.yaml
```yaml
# SPDX-License-Identifier: GPL-2.0-only
# SPDX-FileCopyrightText: Copyright (c) 2024-2025 NVIDIA CORPORATION & AFFILIATES. All rights reserved.

%YAML 1.2
---
$id: http://devicetree.org/schemas/memory-controller-hwpm@8108020000/nvidia,tegra-t264-mc-hwpm.yaml#
$schema: http://devicetree.org/meta-schemas/core.yaml#

title: Tegra264 MC-HWPM driver

maintainers:
  - Pritesh Raithatha
  - Ketan Patil

description: |
     the compatability = nvidia,tegra-t264-mc-hwpm is mentioned in the following drivers
        - <TOP>/kernel/nvidia-oot/drivers/memory/tegra/tegra264-mc-hwpm.c

     The following nodes use this compatibility
        - /bus@0/memory-controller-hwpm@8108020000

select:
  properties:
    compatible:
        minItems: 1
        maxItems: 1
        items:
            enum:
                - nvidia,tegra-t264-mc-hwpm

  required:
    - compatible

properties:

    reg:
        $ref: "/schemas/types.yaml#/definitions/uint32-matrix"
        description: |
            Registers are given by a tuple of two values:
                - register address:
                - register block size.
        items:
            minItems: 4
            maxItems: 4
            items:
                - $ref: "/schemas/types.yaml#/definitions/uint32"
                  minimum: 0x81
                  maximum: 0x81
                - $ref: "/schemas/types.yaml#/definitions/uint32"
                  minimum: 0x8020000
                  maximum: 0x8220000
                - $ref: "/schemas/types.yaml#/definitions/uint32"
                  minimum: 0x0
                  maximum: 0x0
                - $ref: "/schemas/types.yaml#/definitions/uint32"
                  minimum: 0x20000
                  maximum: 0x20000

required:
    - compatible
    - reg

examples:
    - |
        memory-controller-hwpm@8108020000 {
            compatible = "nvidia,tegra-t264-mc-hwpm";
            reg = <0x81 0x8020000 0x0 0x20000>,
                  <0x81 0x8040000 0x0 0x20000>,
                  <0x81 0x8060000 0x0 0x20000>,
                  <0x81 0x8080000 0x0 0x20000>,
                  <0x81 0x80a0000 0x0 0x20000>,
                  <0x81 0x80c0000 0x0 0x20000>,
                  <0x81 0x80e0000 0x0 0x20000>,
                  <0x81 0x8100000 0x0 0x20000>,
                  <0x81 0x8120000 0x0 0x20000>,
                  <0x81 0x8140000 0x0 0x20000>,
                  <0x81 0x8160000 0x0 0x20000>,
                  <0x81 0x8180000 0x0 0x20000>,
                  <0x81 0x81a0000 0x0 0x20000>,
                  <0x81 0x81c0000 0x0 0x20000>,
                  <0x81 0x81e0000 0x0 0x20000>,
                  <0x81 0x8200000 0x0 0x20000>,
                  <0x81 0x8220000 0x0 0x20000>;
            status = "disabled";
        };
```

## Documentation/devicetree/bindings/memory/tegra/nvidia,tegra-t264-mem-qual.yaml
```yaml
# SPDX-License-Identifier: GPL-2.0-only
# SPDX-FileCopyrightText: Copyright (c) 2024-2025 NVIDIA CORPORATION & AFFILIATES. All rights reserved.

%YAML 1.2
---
$id: http://devicetree.org/schemas/memqual@f020000/nvidia,tegra-t264-mem-qual.yaml#
$schema: http://devicetree.org/meta-schemas/core.yaml#

title: Mem Qual IOVA Mapping Provider

maintainers:
  - Ketan Patil

description: |
     the compatability = nvidia,tegra-t264-mem-qual is mentioned in the following drivers
        - <TOP>/kernel/nvidia-oot/drivers/memory/tegra/mem-qual.c

     The following nodes use this compatibility
        - /bus@0/memqual@f020000
        - /bus@0/memqual@a808730000
        - /bus@0/memqual@818d020000
        - /bus@0/memqual@a808750000
        - /bus@0/memqual@818d030000

select:
  properties:
    compatible:
        minItems: 1
        maxItems: 1
        items:
            enum:
                - nvidia,tegra-t264-mem-qual

  required:
    - compatible

properties:

    reg:
        $ref: "/schemas/types.yaml#/definitions/uint32-matrix"
        description: |
            Registers are given by a tuple of two values:
                - register address:
                - register block size.
        items:
            minItems: 4
            maxItems: 4
            items:
                - $ref: "/schemas/types.yaml#/definitions/uint32"
                  minimum: 0x0
                  maximum: 0xa8
                - $ref: "/schemas/types.yaml#/definitions/uint32"
                  minimum: 0x8730000
                  maximum: 0x8d030000
                - $ref: "/schemas/types.yaml#/definitions/uint32"
                  minimum: 0x0
                  maximum: 0x0
                - $ref: "/schemas/types.yaml#/definitions/uint32"
                  minimum: 0x10000
                  maximum: 0x10000

    iommus:
        $ref: "/schemas/types.yaml#/definitions/uint32-matrix"
        description: |
            iommus are given by a tuple of 2 values:
                - Phandle to the device
                - Device ID
        items:
            minItems: 2
            maxItems: 2
            items:
                - $ref: "/schemas/types.yaml#/definitions/uint32"
                - $ref: "/schemas/types.yaml#/definitions/uint32"
                  minimum: 0x0
                  maximum: 0x3f00

    dma-coherent:
        $ref: "/schemas/types.yaml#/definitions/flag"

required:
    - compatible
    - reg
    - iommus

examples:
    - |
        memqual@f020000 {
            compatible = "nvidia,tegra-t264-mem-qual";
            status = "disabled";
            reg = <0x0 0x0f020000 0x0 0x10000>;
            iommus = <&smmu1_mmu TEGRA_SID_MIU0>,
                     <&smmu1_mmu TEGRA_SID_MIU1>;
            dma-coherent;
        };
```

## Documentation/devicetree/bindings/memory/tegra/nvidia,tegra-t26x-mc.yaml
```yaml
# SPDX-License-Identifier: GPL-2.0-only
# SPDX-FileCopyrightText: Copyright (c) 2024-2025 NVIDIA CORPORATION & AFFILIATES. All rights reserved.

%YAML 1.2
---
$id: http://devicetree.org/schemas/mc_carveout@8108020000/nvidia,tegra-t26x-mc.yaml#
$schema: http://devicetree.org/meta-schemas/core.yaml#

title: NVIDIA Tegra Memory Controller driver

maintainers:
  - Ashish Mhetre

description: |
     the compatability = nvidia,tegra-t26x-mc is mentioned in the following drivers
        - <TOP>/kernel/nvidia-oot/drivers/memory/tegra/mc-t26x.c

     The following nodes use this compatibility
        - /bus@0/mc_carveout@8108020000

select:
  properties:
    compatible:
        minItems: 1
        maxItems: 1
        items:
            enum:
                - nvidia,tegra-t26x-mc

  required:
    - compatible

properties:

    reg:
        $ref: "/schemas/types.yaml#/definitions/uint32-matrix"
        description: |
            Registers are given by a tuple of two values:
                - register address:
                - register block size.
        items:
            minItems: 4
            maxItems: 4
            items:
                - $ref: "/schemas/types.yaml#/definitions/uint32"
                  minimum: 0x81
                  maximum: 0x81
                - $ref: "/schemas/types.yaml#/definitions/uint32"
                  minimum: 0x8020000
                  maximum: 0x8020000
                - $ref: "/schemas/types.yaml#/definitions/uint32"
                  minimum: 0x0
                  maximum: 0x0
                - $ref: "/schemas/types.yaml#/definitions/uint32"
                  minimum: 0x20000
                  maximum: 0x20000

required:
    - compatible
    - reg

examples:
    - |
        mc_carveout@8108020000 {
            compatible = "nvidia,tegra-t26x-mc";
            reg = <0x81 0x08020000 0x0 0x20000>;
            status = "disabled";
        };
```

## Documentation/devicetree/bindings/memory/tegra/nvidia,tegra264-emc.yaml
```yaml
# Copyright (c) 2024, NVIDIA CORPORATION & AFFILIATES.  All rights reserved.
#
# This program is free software; you can redistribute it and/or modify it
# under the terms and conditions of the GNU General Public License,
# version 2, as published by the Free Software Foundation.
#
# This program is distributed in the hope it will be useful, but WITHOUT
# ANY WARRANTY; without even the implied warranty of MERCHANTABILITY or
# FITNESS FOR A PARTICULAR PURPOSE.  See the GNU General Public License for
# more details.

%YAML 1.2
---
$id: http://devicetree.org/schemas/external-memory-controller@8108800000/nvidia,tegra264-emc.yaml#
$schema: http://devicetree.org/meta-schemas/core.yaml#

title: NVIDIA Tegra External Memory Controller driver

maintainers:
  - Sachin Nikam

description: |
     the compatability = nvidia,tegra264-emc is mentioned in the following drivers
        - <TOP>/kernel/kernel-oot/drivers/memory/tegra/tegra186-emc.c

     The following nodes use this compatibility
        - /bus@0/memory-controller@8108020000/external-memory-controller@8108800000

select:
  properties:
    compatible:
        minItems: 2
        maxItems: 2
        items:
            enum:
                - nvidia,tegra264-emc
                - nvidia,tegra234-emc

  required:
    - compatible

properties:

    reg:
        $ref: "/schemas/types.yaml#/definitions/uint32-matrix"
        description: |
            Registers are given by a tuple of two values:
                - register address:
                - register block size.
        items:
            minItems: 4
            maxItems: 4
            items:
                - $ref: "/schemas/types.yaml#/definitions/uint32"
                  minimum: 0x81
                  maximum: 0x81
                - $ref: "/schemas/types.yaml#/definitions/uint32"
                  minimum: 0x8800000
                  maximum: 0x8890000
                - $ref: "/schemas/types.yaml#/definitions/uint32"
                  minimum: 0x0
                  maximum: 0x0
                - $ref: "/schemas/types.yaml#/definitions/uint32"
                  minimum: 0x20000
                  maximum: 0x20000

    interrupts:
        $ref: "/schemas/types.yaml#/definitions/uint32-matrix"
        description: |
            Interrupts are give by a tuple of 3 values:
                - interrupt specifier (GIC_SPI = 0, GIC_PPI = 1)
                  definitions in dt-bindings/interrupt-controller/arm-gic.h
                - interrupt number
                - trigger type (rising edge, falling edge, both, etc)
                  definitions in dt-bindings/interrupt-controller/irq.h
        items:
            items:
                - $ref: "/schemas/types.yaml#/definitions/uint32"
                  minimum: 0x0
                  maximum: 0x0
                - $ref: "/schemas/types.yaml#/definitions/uint32"
                  minimum: 0x8d
                  maximum: 0x8d
                - $ref: "/schemas/types.yaml#/definitions/uint32"
                  minimum: 0x4
                  maximum: 0x4

    clocks:
        $ref: "/schemas/types.yaml#/definitions/uint32-matrix"
        description: |
            Clocks are given by a tuple of 2 values:
                - Phandle to the device
                - Clock ID
        items:
            minItems: 2
            maxItems: 2
            items:
                - $ref: "/schemas/types.yaml#/definitions/uint32"
                - $ref: "/schemas/types.yaml#/definitions/uint32"
                  minimum: 0x122
                  maximum: 0x122

    clock-names:
        $ref: "/schemas/types.yaml#/definitions/string-array"
        items:
            enum:
                - emc


    '#interconnect-cells':
        $ref: "/schemas/types.yaml#/definitions/uint32"
        minimum: 0x0
        maximum: 0x0

    nvidia,bpmp:
        $ref: "/schemas/types.yaml#/definitions/uint32"

    numa-node-id:
        $ref: "/schemas/types.yaml#/definitions/uint32"
        minimum: 0x0
        maximum: 0x0

required:
    - compatible
    - reg
    - interrupts
    - clocks
    - clock-names

examples:
    - |
        external-memory-controller@8108800000 {
            compatible = "nvidia,tegra264-emc",
                         "nvidia,tegra234-emc";
            status = "disabled";
            reg = <0x81 0x08800000 0x0 0x20000>,
                  <0x81 0x08890000 0x0 0x20000>;
            interrupts = <GIC_SPI 141 IRQ_TYPE_LEVEL_HIGH>;
            clocks = <&bpmp TEGRA264_CLK_EMC>;
            clock-names = "emc";
            #interconnect-cells = <0>;
            nvidia,bpmp = <&bpmp>;
            numa-node-id = <0x0>;
        };
```
