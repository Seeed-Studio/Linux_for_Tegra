## Documentation/devicetree/bindings/misc/arm,coresight-tmc.yaml
```yaml
# Copyright (c) 2024, NVIDIA CORPORATION & AFFILIATES.  All rights reserved.
#
# This program is free software; you can redistribute it and/or modify it
# under the terms and conditions of the GNU General Public License,
# version 2, as published by the Free Software Foundation.
#
# This program is distributed in the hope it will be useful, but WITHOUT
# ANY WARRANTY; without even the implied warranty of MERCHANTABILITY or
# FITNESS FOR A PARTICULAR PURPOSE.  See the GNU General Public License for
# more details.

%YAML 1.2
---
$id: http://devicetree.org/schemas/etf_soc@10040000/arm,coresight-tmc.yaml#
$schema: http://devicetree.org/meta-schemas/core.yaml#

title: Coresight TMC Driver

maintainers:
  - Rich Wiley

description: |
     The following nodes use this compatibility
        - /etf_soc@10040000
        - /etr_soc@10050000

select:
  properties:
    compatible:
        minItems: 2
        maxItems: 2
        items:
            enum:
                - arm,coresight-tmc
                - arm,primecell

  required:
    - compatible

properties:

    reg:
        $ref: "/schemas/types.yaml#/definitions/uint32-matrix"
        description: |
            Registers are given by a tuple of two values:
                - register address:
                - register block size.
        items:
            minItems: 4
            maxItems: 4
            items:
                - $ref: "/schemas/types.yaml#/definitions/uint32"
                  minimum: 0x0
                  maximum: 0x0
                - $ref: "/schemas/types.yaml#/definitions/uint32"
                  minimum: 0x10040000
                  maximum: 0x10050000
                - $ref: "/schemas/types.yaml#/definitions/uint32"
                  minimum: 0x0
                  maximum: 0x0
                - $ref: "/schemas/types.yaml#/definitions/uint32"
                  minimum: 0x1000
                  maximum: 0x1000

    coresight-default-sink:
        $ref: "/schemas/types.yaml#/definitions/flag"

    clocks:
        $ref: "/schemas/types.yaml#/definitions/uint32-matrix"
        description: |
            Clocks are given by a tuple of 2 values:
                - Phandle to the device
                - Clock ID
        items:
            minItems: 2
            maxItems: 2
            items:
                - $ref: "/schemas/types.yaml#/definitions/uint32"
                - $ref: "/schemas/types.yaml#/definitions/uint32"
                  minimum: 0xcb
                  maximum: 0xcb

    clock-names:
        $ref: "/schemas/types.yaml#/definitions/string-array"
        items:
            enum:
                - apb_pclk


    iommus:
        $ref: "/schemas/types.yaml#/definitions/uint32-matrix"
        description: |
            iommus are given by a tuple of 2 values:
                - Phandle to the device
                - Device ID
        items:
            minItems: 2
            maxItems: 2
            items:
                - $ref: "/schemas/types.yaml#/definitions/uint32"
                - $ref: "/schemas/types.yaml#/definitions/uint32"
                  minimum: 0x300
                  maximum: 0x300

required:
    - compatible
    - reg
    - clocks
    - clock-names
    - iommus

examples:
    - |
        etf_soc@10040000 {
            compatible = "arm,coresight-tmc, arm,primecell";
            status = "disabled";
            reg = <0x0 0x10040000 0x0 0x1000>;
            coresight-default-sink;
            clocks = <&bpmp TEGRA264_CLK_HCSITE>;
            clock-names = "apb_pclk";
        };
```

## Documentation/devicetree/bindings/misc/mods/nvidia,mods_smmu.yaml
```yaml
# Copyright (c) 2024, NVIDIA CORPORATION & AFFILIATES.  All rights reserved.
#
# This program is free software; you can redistribute it and/or modify it
# under the terms and conditions of the GNU General Public License,
# version 2, as published by the Free Software Foundation.
#
# This program is distributed in the hope it will be useful, but WITHOUT
# ANY WARRANTY; without even the implied warranty of MERCHANTABILITY or
# FITNESS FOR A PARTICULAR PURPOSE.  See the GNU General Public License for
# more details.

%YAML 1.2
---
$id: http://devicetree.org/schemas/mods_pcie0/nvidia,mods_smmu.yaml#
$schema: http://devicetree.org/meta-schemas/core.yaml#

title: MOD's SMMU Driver

maintainers:
  - Kiran Kasamsetty

description: |
     the compatability = nvidia,mods_smmu is mentioned in the following drivers
        - <TOP>/kernel/nvidia-oot/drivers/misc/mods/mods_smmu_drv.c

     The following nodes use this compatibility
        - /mods_pcie0
        - /mods_pcie1
        - /mods_pcie2
        - /mods_pcie3
        - /mods_pcie4
        - /mods_pcie5
        - /mods_isp0
        - /mods_isp2
        - /mods_i2c0
        - /mods_i2c1
        - /mods_i2c2
        - /mods_i2c3
        - /mods_i2c7
        - /mods_i2c9
        - /mods_i2c11
        - /mods_i2c12
        - /mods_i2c14
        - /mods_i2c15
        - /mods_i2c16
        - /mods_spi1
        - /mods_spi2
        - /mods_spi3
        - /mods_spi4
        - /mods_spi5
        - /mods_uart4
        - /mods_uart5
        - /mods_uart9
        - /mods_uart10
        - /mods_vi0
        - /mods_vi1
        - /mods_sdmmc1
        - /mods_ufs
        - /mods_xhci
        - /mods_xusb
        - /mods_dma
        - /mods_se
        - /mods_seu1
        - /mods_seu2
        - /mods_seu3
        - /mods_qspi0_dma

select:
  properties:
    compatible:
        minItems: 1
        maxItems: 1
        items:
            enum:
                - nvidia,mods_smmu

  required:
    - compatible

properties:

    iommu-map:
        $ref: "/schemas/types.yaml#/definitions/uint32-matrix"
        items:
            minItems: 4
            maxItems: 4
            items:
                - $ref: "/schemas/types.yaml#/definitions/uint32"
                  minimum: 0x0
                  maximum: 0x0
                - $ref: "/schemas/types.yaml#/definitions/uint32"
                - $ref: "/schemas/types.yaml#/definitions/uint32"
                  minimum: 0x10000
                  maximum: 0x50000
                - $ref: "/schemas/types.yaml#/definitions/uint32"
                  minimum: 0x10000
                  maximum: 0x10000

    dma-coherent:
        $ref: "/schemas/types.yaml#/definitions/flag"

    dev-names:
        $ref: "/schemas/types.yaml#/definitions/string-array"
        items:
            enum:
                - mods_pcie0
                - mods_pcie1
                - mods_pcie2
                - mods_pcie3
                - mods_pcie4
                - mods_pcie5
                - mods_isp0
                - mods_isp2
                - mods_i2c0
                - mods_i2c1
                - mods_i2c2
                - mods_i2c3
                - mods_i2c7
                - mods_i2c9
                - mods_i2c11
                - mods_i2c12
                - mods_i2c14
                - mods_i2c15
                - mods_i2c16
                - mods_spi1
                - mods_spi2
                - mods_spi3
                - mods_spi4
                - mods_spi5
                - mods_uart4
                - mods_uart5
                - mods_uart9
                - mods_uart10
                - mods_vi0
                - mods_vi1
                - mods_sdmmc1
                - mods_ufs
                - mods_xhci
                - mods_xusb
                - mods_dma
                - mods_se
                - mods_seu1
                - mods_seu2
                - mods_seu3
                - mods_qspi0_dma


    nvidia,bpmp:
        $ref: "/schemas/types.yaml#/definitions/uint32-matrix"
        items:
            minItems: 2
            maxItems: 2
            items:
                - $ref: "/schemas/types.yaml#/definitions/uint32"
                - $ref: "/schemas/types.yaml#/definitions/uint32"
                  minimum: 0x0
                  maximum: 0x5

    iommus:
        $ref: "/schemas/types.yaml#/definitions/uint32-matrix"
        description: |
            iommus are given by a tuple of 2 values:
                - Phandle to the device
                - Device ID
        items:
            minItems: 2
            maxItems: 2
            items:
                - $ref: "/schemas/types.yaml#/definitions/uint32"
                - $ref: "/schemas/types.yaml#/definitions/uint32"
                  minimum: 0x800
                  maximum: 0x50000

required:
    - compatible
    - iommus

examples:
    - |
        mods_pcie0 {
            compatible = "nvidia,mods_smmu";
            iommu-map = <0x0 &smmu2_mmu 0x10000 0x10000>;
            dma-coherent;
            dev-names = "mods_pcie0";
            status = "disabled";
            nvidia,bpmp = <&bpmp 0x0>;
        };
```

## Documentation/devicetree/bindings/misc/mods/nvidia,mods_tegra_dma.yaml
```yaml
# Copyright (c) 2024, NVIDIA CORPORATION & AFFILIATES.  All rights reserved.
#
# This program is free software; you can redistribute it and/or modify it
# under the terms and conditions of the GNU General Public License,
# version 2, as published by the Free Software Foundation.
#
# This program is distributed in the hope it will be useful, but WITHOUT
# ANY WARRANTY; without even the implied warranty of MERCHANTABILITY or
# FITNESS FOR A PARTICULAR PURPOSE.  See the GNU General Public License for
# more details.

%YAML 1.2
---
$id: http://devicetree.org/schemas/mods_tegra_dma/nvidia,mods_tegra_dma.yaml#
$schema: http://devicetree.org/meta-schemas/core.yaml#

title: MOD's DMA Driver

maintainers:
  - Kiran Kasamsetty

description: |
     the compatability = nvidia,mods_tegra_dma is mentioned in the following drivers
        - <TOP>/kernel/nvidia-oot/drivers/misc/mods/mods_dma.c

     The following nodes use this compatibility
        - /mods_tegra_dma

select:
  properties:
    compatible:
        minItems: 1
        maxItems: 1
        items:
            enum:
                - nvidia,mods_tegra_dma

  required:
    - compatible

properties:

    dmas:
        $ref: "/schemas/types.yaml#/definitions/uint32-matrix"
        items:
            minItems: 4
            maxItems: 4
            items:
                - $ref: "/schemas/types.yaml#/definitions/uint32"
                - $ref: "/schemas/types.yaml#/definitions/uint32"
                  minimum: 0x0
                  maximum: 0x14
                - $ref: "/schemas/types.yaml#/definitions/uint32"
                  minimum: 0x1
                  maximum: 0x1f
                - $ref: "/schemas/types.yaml#/definitions/uint32"
                  minimum: 0x801
                  maximum: 0x81f

    dma-names:
        $ref: "/schemas/types.yaml#/definitions/string-array"
        items:
            enum:
                - i2c0_tx
                - i2c1_tx
                - i2c2_tx
                - i2c3_tx
                - i2c7_tx
                - i2c9_tx
                - i2c11_tx
                - i2c12_tx
                - i2c14_tx
                - i2c15_tx
                - i2c16_tx
                - spi1_rx
                - spi1_tx
                - spi2_rx
                - spi2_tx
                - spi3_rx
                - spi3_tx
                - spi4_rx
                - spi4_tx
                - spi5_rx
                - spi5_tx
                - uart4_rx
                - uart4_tx
                - uart5_rx
                - uart5_tx
                - uart9_rx
                - uart9_tx
                - uart10_rx
                - uart10_tx


required:
    - compatible

examples:
    - |
        mods_tegra_dma {
            compatible = "nvidia,mods_tegra_dma";
            dmas = <&gpcdma 0 31 TEGRA264_GPCDMA_SID_I2C0>,
                   < &gpcdma 7 7 TEGRA264_GPCDMA_SID_I2C1>,
                   < &gpcdma 3 3 TEGRA264_GPCDMA_SID_I2C2>,
                   < &gpcdma 4 4 TEGRA264_GPCDMA_SID_I2C3>,
                   < &gpcdma 6 6 TEGRA264_GPCDMA_SID_I2C7>,
                   < &gpcdma 2 2 TEGRA264_GPCDMA_SID_I2C9>,
                   < &gpcdma 1 1 TEGRA264_GPCDMA_SID_I2C11>,
                   < &gpcdma 5 5 TEGRA264_GPCDMA_SID_I2C12>,
                   < &gpcdma 18 28 TEGRA264_GPCDMA_SID_I2C14>,
                   < &gpcdma 19 29 TEGRA264_GPCDMA_SID_I2C15>,
                   < &gpcdma 20 30 TEGRA264_GPCDMA_SID_I2C16>,
                   < &gpcdma 9 9 TEGRA264_GPCDMA_SID_SPI1>,
                   < &gpcdma 9 19 TEGRA264_GPCDMA_SID_SPI1>,
                   < &gpcdma 8 8 TEGRA264_GPCDMA_SID_SPI2>,
                   < &gpcdma 8 18 TEGRA264_GPCDMA_SID_SPI2>,
                   < &gpcdma 14 14 TEGRA264_GPCDMA_SID_SPI3>,
                   < &gpcdma 14 24 TEGRA264_GPCDMA_SID_SPI3>,
                   < &gpcdma 15 15 TEGRA264_GPCDMA_SID_SPI4>,
                   < &gpcdma 15 25 TEGRA264_GPCDMA_SID_SPI4>,
                   < &gpcdma 16 16 TEGRA264_GPCDMA_SID_SPI5>,
                   < &gpcdma 16 26 TEGRA264_GPCDMA_SID_SPI5>,
                   < &gpcdma 13 23 TEGRA264_GPCDMA_SID_UART4>,
                   < &gpcdma 13 13 TEGRA264_GPCDMA_SID_UART4>,
                   < &gpcdma 11 11 TEGRA264_GPCDMA_SID_UART5>,
                   < &gpcdma 11 21 TEGRA264_GPCDMA_SID_UART5>,
                   < &gpcdma 10 10 TEGRA264_GPCDMA_SID_UART9>,
                   < &gpcdma 10 20 TEGRA264_GPCDMA_SID_UART9>,
                   < &gpcdma 12 12 TEGRA264_GPCDMA_SID_UART10>,
                   < &gpcdma 12 22 TEGRA264_GPCDMA_SID_UART10>;
            dma-names = "i2c0_tx, i2c1_tx, i2c2_tx, i2c3_tx, i2c7_tx, i2c9_tx, i2c11_tx, i2c12_tx, i2c14_tx, i2c15_tx, i2c16_tx, spi1_rx, spi1_tx, spi2_rx, spi2_tx, spi3_rx, spi3_tx, spi4_rx, spi4_tx, spi5_rx, spi5_tx, uart4_rx, uart4_tx, uart5_rx, uart5_tx, uart9_rx, uart9_tx, uart10_rx, uart10_tx";
            status = "disabled";
        };
```

## Documentation/devicetree/bindings/misc/mods/nvidia,mods_test.yaml
```yaml
# Copyright (c) 2024, NVIDIA CORPORATION & AFFILIATES.  All rights reserved.
#
# This program is free software; you can redistribute it and/or modify it
# under the terms and conditions of the GNU General Public License,
# version 2, as published by the Free Software Foundation.
#
# This program is distributed in the hope it will be useful, but WITHOUT
# ANY WARRANTY; without even the implied warranty of MERCHANTABILITY or
# FITNESS FOR A PARTICULAR PURPOSE.  See the GNU General Public License for
# more details.

%YAML 1.2
---
$id: http://devicetree.org/schemas/mods_test/nvidia,mods_test.yaml#
$schema: http://devicetree.org/meta-schemas/core.yaml#

title: MOD's Test Driver

maintainers:
  - Kiran Kasamsetty

description: |
     the compatability = nvidia,mods_test is mentioned in the following drivers
        - <TOP>/kernel/nvidia-oot/drivers/misc/mods/mods_dmabuf.c

     The following nodes use this compatibility
        - /mods_test

select:
  properties:
    compatible:
        minItems: 1
        maxItems: 1
        items:
            enum:
                - nvidia,mods_test

  required:
    - compatible

properties:

required:
    - compatible

examples:
    - |
        mods_test {
            compatible = "nvidia,mods_test";
            status = "disabled";
        };
```
