## Documentation/devicetree/bindings/misc/nvidia,tegra-fsicom-CcplexApp.yaml
```yaml
# Copyright (c) 2024, NVIDIA CORPORATION & AFFILIATES.  All rights reserved.
#
# This program is free software; you can redistribute it and/or modify it
# under the terms and conditions of the GNU General Public License,
# version 2, as published by the Free Software Foundation.
#
# This program is distributed in the hope it will be useful, but WITHOUT
# ANY WARRANTY; without even the implied warranty of MERCHANTABILITY or
# FITNESS FOR A PARTICULAR PURPOSE.  See the GNU General Public License for
# more details.

%YAML 1.2
---
$id: http://devicetree.org/schemas/FsiComAppChConfCcplexApp/nvidia,tegra-fsicom-CcplexApp.yaml#
$schema: http://devicetree.org/meta-schemas/core.yaml#

title: FSI Communication Application Configuration

maintainers:
  - Rahul Bedarkar

description: |
     The following nodes use this compatibility
        - /FsiComAppChConfCcplexApp

select:
  properties:
    compatible:
        minItems: 1
        maxItems: 1
        items:
            enum:
                - nvidia,tegra-fsicom-CcplexApp

  required:
    - compatible

properties:

    channelid_list:
        $ref: "/schemas/types.yaml#/definitions/uint32"
        minimum: 0x1
        maximum: 0x2

required:
    - compatible

examples:
    - |
        FsiComAppChConfCcplexApp {
        };
```

## Documentation/devicetree/bindings/misc/nvidia,tegra-fsicom-channels.yaml
```yaml
# Copyright (c) 2024, NVIDIA CORPORATION & AFFILIATES.  All rights reserved.
#
# This program is free software; you can redistribute it and/or modify it
# under the terms and conditions of the GNU General Public License,
# version 2, as published by the Free Software Foundation.
#
# This program is distributed in the hope it will be useful, but WITHOUT
# ANY WARRANTY; without even the implied warranty of MERCHANTABILITY or
# FITNESS FOR A PARTICULAR PURPOSE.  See the GNU General Public License for
# more details.

%YAML 1.2
---
$id: http://devicetree.org/schemas/FsiComIvc/nvidia,tegra-fsicom-channels.yaml#
$schema: http://devicetree.org/meta-schemas/core.yaml#

title: FSI Communication IVC Node

maintainers:
  - Rahul Bedarkar

description: |
     The following nodes use this compatibility
        - /FsiComIvc

select:
  properties:
    compatible:
        minItems: 1
        maxItems: 1
        items:
            enum:
                - nvidia,tegra-fsicom-channels

  required:
    - compatible

properties:

    nChannel:
        description: Number of communication channels supported
        $ref: "/schemas/types.yaml#/definitions/uint32"
        minimum: 0x1
        maximum: 0x80

    nvsciipc_endpoint:
        description: Array of NvSci IPC endpoint names supported
        $ref: "/schemas/types.yaml#/definitions/string-array"

patternProperties:
    "^channel_[0-9]+$":
        type: object
        description: Individual channel configuration properties
        properties:
            frame-count:
                description: Number of frames allocated to this channel. frame-count*frame-size should not be greater than 16U * 1024U * 1024U
                $ref: "/schemas/types.yaml#/definitions/uint32"
                minimum: 0x1
                maximum: 0x40000

            frame-size:
                description: Size of each frame in bytes. Frame size to be multiple of 64. frame-count*frame-size should not be greater than 16U * 1024U * 1024U
                $ref: "/schemas/types.yaml#/definitions/uint32"
                minimum: 0x40
                maximum: 0x800

            core-id:
                description: ID of the core this channel belongs to
                $ref: "/schemas/types.yaml#/definitions/uint32"
                minimum: 0x0
                maximum: 0x3

            notification:
                description: Notification configuration for this channel
                $ref: "/schemas/types.yaml#/definitions/string"
                enum:
                    - disabled

            NvSciCh:
                description: NvSci channel name for this channel
                $ref: "/schemas/types.yaml#/definitions/string"


required:
    - compatible

examples:
    - |
        FsiComIvc {
            compatible = "nvidia,tegra-fsicom-channels";
            status = "disabled";
            nChannel=<9>;
            nvsciipc_endpoint = "nvfsicom_EPD",
                                "nvfsicom_CcplexApp",
                                "nvfsicom_CcplexApp_state_change",
                                "nvfsicom_app1",
                                "nvfsicom_app2",
                                "nvfsicom_appGR";
            channel_0{
                frame-count = <7>;
                frame-size = <2048>;
                core-id = <0>;
                NvSciCh = "nvfsicom_EPD";
            };
            channel_1{
                frame-count = <30>;
                frame-size = <64>;
                core-id = <0>;
                NvSciCh = "nvfsicom_CcplexApp";
            };
            channel_2{
                frame-count = <4>;
                frame-size = <64>;
                core-id = <0>;
                NvSciCh = "nvfsicom_CcplexApp_state_change";
            };
            channel_3{
                frame-count = <4>;
                frame-size = <64>;
                core-id = <0>;
                NvSciCh = "nvfsicom_app1";
            };
            channel_4{
                frame-count = <2>;
                frame-size = <64>;
                core-id = <1>;
                NvSciCh = "nvfsicom_app2";
            };
            channel_5{
                frame-count = <4>;
                frame-size = <64>;
                core-id = <0>;
                NvSciCh = "nvfsicom_appGR";
            };
            channel_6{
                frame-count = <4>;
                frame-size = <1024>;
                core-id = <0>;
            };
            channel_10{
                frame-count = <4>;
                frame-size = <64>;
                core-id = <2>;
                notification = "disabled";
                NvSciCh = "nvfsicom_app3";
            };
            channel_11{
                frame-count = <4>;
                frame-size = <1024>;
                core-id = <3>;
                notification = "disabled";
                NvSciCh = "nvfsicom_app4";
            };
        };
```

## Documentation/devicetree/bindings/misc/nvidia,tegra-fsicom-sampleApp1.yaml
```yaml
# Copyright (c) 2024, NVIDIA CORPORATION & AFFILIATES.  All rights reserved.
#
# This program is free software; you can redistribute it and/or modify it
# under the terms and conditions of the GNU General Public License,
# version 2, as published by the Free Software Foundation.
#
# This program is distributed in the hope it will be useful, but WITHOUT
# ANY WARRANTY; without even the implied warranty of MERCHANTABILITY or
# FITNESS FOR A PARTICULAR PURPOSE.  See the GNU General Public License for
# more details.

%YAML 1.2
---
$id: http://devicetree.org/schemas/FsiComAppChConfApp1/nvidia,tegra-fsicom-sampleApp1.yaml#
$schema: http://devicetree.org/meta-schemas/core.yaml#

title: FSI Application IVC Channel Configuration

maintainers:
  - Rahul Bedarkar

description: |
     The following nodes use this compatibility
        - /FsiComAppChConfApp1

select:
  properties:
    compatible:
        minItems: 1
        maxItems: 1
        items:
            enum:
                - nvidia,tegra-fsicom-sampleApp1

  required:
    - compatible

properties:

    channelid_list:
        $ref: "/schemas/types.yaml#/definitions/uint32"
        minimum: 0x3
        maximum: 0x3

required:
    - compatible

examples:
    - |
        FsiComAppChConfApp1 {
            compatible = "nvidia,tegra-fsicom-sampleApp1";
            status = "okay";
        };
```

## Documentation/devicetree/bindings/misc/nvidia,tegra-fsicom-sampleAppGR.yaml
```yaml
# Copyright (c) 2024, NVIDIA CORPORATION & AFFILIATES.  All rights reserved.
#
# This program is free software; you can redistribute it and/or modify it
# under the terms and conditions of the GNU General Public License,
# version 2, as published by the Free Software Foundation.
#
# This program is distributed in the hope it will be useful, but WITHOUT
# ANY WARRANTY; without even the implied warranty of MERCHANTABILITY or
# FITNESS FOR A PARTICULAR PURPOSE.  See the GNU General Public License for
# more details.

%YAML 1.2
---
$id: http://devicetree.org/schemas/FsiComQnxAppChConfAppGR/nvidia,tegra-fsicom-sampleAppGR.yaml#
$schema: http://devicetree.org/meta-schemas/core.yaml#

title: QNX FSI Communication Application Configuration

maintainers:
  - Rahul Bedarkar

description: |
     The following nodes use this compatibility
        - /FsiComQnxAppChConfAppGR

select:
  properties:
    compatible:
        minItems: 1
        maxItems: 1
        items:
            enum:
                - nvidia,tegra-fsicom-sampleAppGR

  required:
    - compatible

properties:

    channelid_list:
        $ref: "/schemas/types.yaml#/definitions/uint32"
        minimum: 0x5
        maximum: 0x5

required:
    - compatible

examples:
    - |
        FsiComQnxAppChConfAppGR {
        };
```

## Documentation/devicetree/bindings/misc/nvidia,tegra194-pva0-hsp.yaml
```yaml
# Copyright (c) 2024, NVIDIA CORPORATION & AFFILIATES.  All rights reserved.
#
# This program is free software; you can redistribute it and/or modify it
# under the terms and conditions of the GNU General Public License,
# version 2, as published by the Free Software Foundation.
#
# This program is distributed in the hope it will be useful, but WITHOUT
# ANY WARRANTY; without even the implied warranty of MERCHANTABILITY or
# FITNESS FOR A PARTICULAR PURPOSE.  See the GNU General Public License for
# more details.

%YAML 1.2
---
$id: http://devicetree.org/schemas/hsp/nvidia,tegra194-pva0-hsp.yaml#
$schema: http://devicetree.org/meta-schemas/core.yaml#

title: Progrmable Vision Accelerator (PVA) Hypervisor Hardware Syncronization Primatives (HSP)

maintainers:
  - Omar Nemri

description: |
     The following nodes use this compatibility
        - /bus@0/host1x@8181200000/pva0@818c000000/hsp

select:
  properties:
    compatible:
        minItems: 1
        maxItems: 1
        items:
            enum:
                - nvidia,tegra194-pva0-hsp

  required:
    - compatible

properties:

required:
    - compatible

examples:
    - |
        hsp {
            compatible = "nvidia,tegra194-pva0-hsp";
        };
```

## Documentation/devicetree/bindings/misc/nvidia,tegra264-aconnect.yaml
```yaml
# Copyright (c) 2024, NVIDIA CORPORATION & AFFILIATES.  All rights reserved.
#
# This program is free software; you can redistribute it and/or modify it
# under the terms and conditions of the GNU General Public License,
# version 2, as published by the Free Software Foundation.
#
# This program is distributed in the hope it will be useful, but WITHOUT
# ANY WARRANTY; without even the implied warranty of MERCHANTABILITY or
# FITNESS FOR A PARTICULAR PURPOSE.  See the GNU General Public License for
# more details.

%YAML 1.2
---
$id: http://devicetree.org/schemas/aconnect@9000000/nvidia,tegra264-aconnect.yaml#
$schema: http://devicetree.org/meta-schemas/core.yaml#

title: Nvidia Always Connected Driver

maintainers:
  - Mohan Kumar

description: |
     The following nodes use this compatibility
        - /bus@0/aconnect@9000000

select:
  properties:
    compatible:
        minItems: 2
        maxItems: 2
        items:
            enum:
                - nvidia,tegra264-aconnect
                - nvidia,tegra210-aconnect

  required:
    - compatible

properties:

    clocks:
        $ref: "/schemas/types.yaml#/definitions/uint32-matrix"
        description: |
            Clocks are given by a tuple of 2 values:
                - Phandle to the device
                - Clock ID
        items:
            minItems: 2
            maxItems: 2
            items:
                - $ref: "/schemas/types.yaml#/definitions/uint32"
                - $ref: "/schemas/types.yaml#/definitions/uint32"
                  minimum: 0x9c
                  maximum: 0xa4

    clock-names:
        $ref: "/schemas/types.yaml#/definitions/string-array"
        items:
            enum:
                - ape
                - apb2ape


    '#address-cells':
        $ref: "/schemas/types.yaml#/definitions/uint32"
        minimum: 0x2
        maximum: 0x2

    '#size-cells':
        $ref: "/schemas/types.yaml#/definitions/uint32"
        minimum: 0x2
        maximum: 0x2

required:
    - compatible
    - clocks
    - clock-names

examples:
    - |
        aconnect@9000000 {
            compatible = "nvidia,tegra264-aconnect",
                         "nvidia,tegra210-aconnect";
            clocks = <&bpmp TEGRA264_CLK_APE>,
                     <&bpmp TEGRA264_CLK_ADSP>;
            clock-names = "ape, apb2ape";
            power-domains = <&bpmp TEGRA264_POWER_DOMAIN_AUD>;
            status = "disabled";
            #address-cells = <2>;
            #size-cells = <2>;
            ranges = <0x0 0x9000000 0x0 0x9000000 0x0 0x2000000>;
        };
```

## Documentation/devicetree/bindings/misc/nvidia,tegra264-bpmp-shmem.yaml
```yaml
# Copyright (c) 2024, NVIDIA CORPORATION & AFFILIATES.  All rights reserved.
#
# This program is free software; you can redistribute it and/or modify it
# under the terms and conditions of the GNU General Public License,
# version 2, as published by the Free Software Foundation.
#
# This program is distributed in the hope it will be useful, but WITHOUT
# ANY WARRANTY; without even the implied warranty of MERCHANTABILITY or
# FITNESS FOR A PARTICULAR PURPOSE.  See the GNU General Public License for
# more details.

%YAML 1.2
---
$id: http://devicetree.org/schemas/bpmp-shmem@0/nvidia,tegra264-bpmp-shmem.yaml#
$schema: http://devicetree.org/meta-schemas/core.yaml#

title: Nvidia Tegra T264 BPMP Shared Memory Driver

maintainers:
  - Sandipan Patra

description: |
     The following nodes use this compatibility
        - /reserved-memory/bpmp-shmem@0

select:
  properties:
    compatible:
        minItems: 2
        maxItems: 2
        items:
            enum:
                - nvidia,tegra264-bpmp-shmem
                - nvidia,tegra234-bpmp-shmem

  required:
    - compatible

properties:

    reg:
        $ref: "/schemas/types.yaml#/definitions/uint32-matrix"
        description: |
            Registers are given by a tuple of two values:
                - register address:
                - register block size.
        items:
            minItems: 4
            maxItems: 4
            items:
                - $ref: "/schemas/types.yaml#/definitions/uint32"
                  minimum: 0x0
                  maximum: 0x0
                - $ref: "/schemas/types.yaml#/definitions/uint32"
                  minimum: 0x86070000
                  maximum: 0x86070000
                - $ref: "/schemas/types.yaml#/definitions/uint32"
                  minimum: 0x0
                  maximum: 0x0
                - $ref: "/schemas/types.yaml#/definitions/uint32"
                  minimum: 0x2000
                  maximum: 0x2000

    no-map:
        $ref: "/schemas/types.yaml#/definitions/flag"

required:
    - compatible
    - reg

examples:
    - |
        bpmp-shmem@0 {
            compatible = "nvidia,tegra264-bpmp-shmem",
                         "nvidia,tegra234-bpmp-shmem";
            status = "disabled";
            reg = <0x0 0x86070000 0x0 0x2000>;
            no-map;
        };
```
