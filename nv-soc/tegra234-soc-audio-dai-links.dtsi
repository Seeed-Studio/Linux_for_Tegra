// SPDX-License-Identifier: GPL-2.0-only
// SPDX-FileCopyrightText: Copyright (c) 2019-2025, NVIDIA CORPORATION & AFFILIATES.  All rights reserved.

/ {
	tegra_sound: sound {
		/* mixer-controls node provide controls to override PCM params */
		mixer-controls {
			compatible = "nvidia,tegra234-mixer-control";
			status = "okay";
		};
	};
};
