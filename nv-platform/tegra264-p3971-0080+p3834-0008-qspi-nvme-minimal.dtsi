// SPDX-License-Identifier: GPL-2.0-only
// SPDX-FileCopyrightText: Copyright (c) 2024, NVIDIA CORPORATION & AFFILIATES.  All rights reserved.

/ {
	bus@0 {
		tegra_soc_hwpm@1604000 {
			status = "disabled";
		};

		pcie@a808460000 {
			status = "disabled";
		};
	};
};
