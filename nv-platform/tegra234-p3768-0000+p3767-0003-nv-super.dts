// SPDX-License-Identifier: GPL-2.0
// SPDX-FileCopyrightText: Copyright (c) 2024, NVIDIA CORPORATION & AFFILIATES.  All rights reserved.

/dts-v1/;

#include "tegra234-p3768-0000+p3767-0003-nv.dts"

/ {
	compatible = "nvidia,p3768-0000+p3767-0003-super", "nvidia,p3767-0003", "nvidia,tegra234";
	model = "NVIDIA Jetson Orin Nano Engineering Reference Developer Kit Super";
};

/delete-node/ &{/opp-table-cluster0/opp-1510400000};
/delete-node/ &{/opp-table-cluster1/opp-1510400000};
/delete-node/ &{/opp-table-cluster2/opp-1510400000};
