// SPDX-License-Identifier: GPL-2.0
/dts-v1/;

#include "tegra234-p3768-0000+p3767-0000.dts"

/ {
	compatible = "nvidia,p3768-0000+p3767-0000-taylor-low", "nvidia,p3767-0000", "nvidia,tegra234";
	model = "NVIDIA Jetson Orin NX Taylor Low";
};
