// SPDX-License-Identifier: GPL-2.0-only
// SPDX-FileCopyrightText: Copyright (c) 2024, NVIDIA CORPORATION & AFFILIATES.  All rights reserved.
/dts-v1/;

#include "tegra264-p3834-0005.dtsi"
#include "tegra264-p3971-0050.dtsi"

/ {
	model = "NVIDIA Jetson Thor Developer Kit";
	compatible = "nvidia,p3971-0050+p3834-0005", "nvidia,p3834-0005", "nvidia,tegra264";
};

/* Add minimal dtsi at the End of the file */
#include "tegra264-p3971-0050+p3834-0005-qspi-nvme-minimal.dtsi"
