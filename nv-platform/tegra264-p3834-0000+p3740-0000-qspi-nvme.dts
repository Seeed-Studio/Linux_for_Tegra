// SPDX-License-Identifier: GPL-2.0-only
// SPDX-FileCopyrightText: Copyright (c) 2024, NVIDIA CORPORATION & AFFILIATES.  All rights reserved.
/dts-v1/;

#include "tegra264-p3740-0000.dtsi"
#include "tegra264-p3834-0000.dtsi"

/ {

};

/* Add minimal dtsi at the End of the file */
#include "tegra264-p3834-0000+p3740-0000-qspi-nvme-minimal.dtsi"
