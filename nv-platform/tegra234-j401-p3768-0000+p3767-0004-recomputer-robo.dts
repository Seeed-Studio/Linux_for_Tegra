// SPDX-License-Identifier: GPL-2.0-only
// SPDX-FileCopyrightText: Copyright (c) 2023, NVIDIA CORPORATION & AFFILIATES.  All rights reserved.

/dts-v1/;

#include "tegra234-j401-p3768-0000+p3767-recomputer-robo-common.dts"
#include "tegra234-camera-quad-g300-overlay.dts"

#define CAM0_RST_L	TEGRA234_AON_GPIO(CC, 3)
#define CAM0_PWDN   TEGRA234_MAIN_GPIO(H, 6)
/ {
        compatible = "nvidia,p3768-0000+p3767-0004-super", "nvidia,p3767-0004", "nvidia,tegra234";
        model = "NVIDIA Jetson Orin Nano Seeed recomputer classic Robotics";

        leds {
                compatible = "gpio-leds";
                led1: led1 {
                        label = "led1";
                        gpios = <&gpio_xten 6 GPIO_ACTIVE_HIGH>;
                        default-state = "on";
                };
        };
        // bus@0 {
	// 	/* GPIO configuration */
	// 	gpio@2200000 {
	// 		camera-control-output-high1 {
	// 			gpio-hog;
	// 			output-high;
	// 			gpios = <CAM0_PWDN 0>;
	// 			label = "cam0-pwdn";
	// 		};
	// 	};

	// 	gpio@c2f0000 {
	// 		camera-control-output-high2 {
	// 			gpio-hog;
	// 			output-high;
	// 			gpios = <CAM0_RST_L 0>;
	// 			label = "cam0-rst";
	// 		};
	// 	};                
        // };
};


/delete-node/ &{/opp-table-cluster0/opp-1510400000};
/delete-node/ &{/opp-table-cluster1/opp-1510400000};
/delete-node/ &{/opp-table-cluster2/opp-1510400000};

