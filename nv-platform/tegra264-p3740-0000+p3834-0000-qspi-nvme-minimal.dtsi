// SPDX-License-Identifier: GPL-2.0-only
// SPDX-FileCopyrightText: Copyright (c) 2024, NVIDIA CORPORATION & AFFILIATES.  All rights reserved.

/ {
	bus@0 {
		host1x@8181200000 {
			pva0@818c000000 {
				status = "disabled";
			};
		};
	};
};
