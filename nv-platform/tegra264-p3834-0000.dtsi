// SPDX-License-Identifier: GPL-2.0-only
// SPDX-FileCopyrightText: Copyright (c) 2025, NVIDIA CORPORATION & AFFILIATES.  All rights reserved.

#include "tegra264-p3834-common.dtsi"
#include "nv-soc/tegra264-soc-thermal-slowdown.dtsi"
#include "nv-soc/tegra264-soc-thermal-shutdown.dtsi"
#include "nv-soc/tegra264-soc-thermal-trip-event.dtsi"

/ {
	nvtherm-oc-event {
		status = "okay";
	};
};
