/*
 * SPDX-FileCopyrightText: Copyright (c) 2024 NVIDIA CORPORATION & AFFILIATES. All rights reserved.
 * SPDX-License-Identifier: LicenseRef-NvidiaProprietary
 *
 * NVIDIA CORPORATION, its affiliates and licensors retain all intellectual
 * property and proprietary rights in and to this material, related
 * documentation and any modifications thereto. Any use, reproduction,
 * disclosure or distribution of this material and related documentation
 * without an express license agreement from NVIDIA CORPORATION or
 * its affiliates is strictly prohibited.
 */

#include "tegra264-p3834-0005-as-p3834-0000-rc00-maxn.dtsi"
#include "tegra264-p3834-0005-as-p3834-0000-rc01-maxn.dtsi"
#include "tegra264-p3834-0005-as-p3834-0000-rc02-maxn.dtsi"
#include "tegra264-p3834-0005-as-p3834-0000-rc03-maxn.dtsi"
#include "tegra264-p3834-0005-as-p3834-0000-rc04-maxn.dtsi"
#include "tegra264-p3834-0005-as-p3834-0000-rc05-maxn.dtsi"
#include "tegra264-p3834-0005-as-p3834-0000-rc06-maxn.dtsi"
#include "tegra264-p3834-0005-as-p3834-0000-rc07-maxn.dtsi"
#include "tegra264-p3834-0005-as-p3834-0000-rc08-maxn.dtsi"
#include "tegra264-p3834-0005-as-p3834-0000-rc09-maxn.dtsi"
#include "tegra264-p3834-0005-as-p3834-0000-rc10-maxn.dtsi"
#include "tegra264-p3834-0005-as-p3834-0000-rc11-maxn.dtsi"
#include "tegra264-p3834-0005-as-p3834-0000-rc12-maxn.dtsi"
#include "tegra264-p3834-0005-as-p3834-0000-rc13-maxn.dtsi"
#include "tegra264-p3834-0005-as-p3834-0000-rc14-maxn.dtsi"
#include "tegra264-p3834-0005-as-p3834-0000-rc15-maxn.dtsi"
