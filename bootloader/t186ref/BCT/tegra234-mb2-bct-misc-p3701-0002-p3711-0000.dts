/dts-v1/;

#include "tegra234-mb2-bct-common.dtsi"
/ {
    mb2-misc {
        eeprom {
            cvm_eeprom_i2c_instance = <0>; //Starts from I2C bus 0
            cvm_eeprom_i2c_slave_address = <0xa0>; //0x50 << 1
            cvm_eeprom_read_size = <0x100>;
            cvb_eeprom_i2c_instance = <6>; //Starts from I2C bus 0
            cvb_eeprom_i2c_slave_address = <0xae>; //0x57 << 1
            cvb_eeprom_read_size = <0x100>;
        };
    };
};
