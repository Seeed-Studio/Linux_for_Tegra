/*
 * SPDX-FileCopyrightText: Copyright (c) 2023 NVIDIA CORPORATION & AFFILIATES. All rights reserved.
 * SPDX-License-Identifier: LicenseRef-NvidiaProprietary
 *
 * NVIDIA CORPORATION, its affiliates and licensors retain all intellectual
 * property and proprietary rights in and to this material, related
 * documentation and any modifications thereto. Any use, reproduction,
 * disclosure or distribution of this material and related documentation
 * without an express license agreement from NVIDIA CORPORATION or
 * its affiliates is strictly prohibited.
 */

/dts-v1/;

#include "tegra234-mb2-bct-common.dtsi"

/ {
    mb2-misc {
        /* Control fields for FSI cluster. */
        auxp_controls@5 {
            enable_init = <0>;
            enable_fw_load = <1>;
            enable_unhalt = <1>;
        };
    };
};
