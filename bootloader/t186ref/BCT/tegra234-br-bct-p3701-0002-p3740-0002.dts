/*
 * SPDX-FileCopyrightText: Copyright (c) 2022, NVIDIA CORPORATION & AFFILIATES. All rights reserved.
 * SPDX-License-Identifier: BSD-3-Clause
 *
 * Redistribution and use in source and binary forms, with or without
 * modification, are permitted provided that the following conditions are met:
 *
 * 1. Redistributions of source code must retain the above copyright notice, this
 * list of conditions and the following disclaimer.
 *
 * 2. Redistributions in binary form must reproduce the above copyright notice,
 * this list of conditions and the following disclaimer in the documentation
 * and/or other materials provided with the distribution.
 *
 * 3. Neither the name of the copyright holder nor the names of its
 * contributors may be used to endorse or promote products derived from
 * this software without specific prior written permission.
 *
 * THIS SOFTWARE IS PROVIDED BY THE COPYRIGHT HOLDERS AND CONTRIBUTORS "AS IS"
 * AND ANY EXPRESS OR IMPLIED WARRANTIES, INCLUDING, BUT NOT LIMITED TO, THE
 * IMPLIED WARRANTIES OF MERCHANTABILITY AND FITNESS FOR A PARTICULAR PURPOSE ARE
 * DISCLAIMED. IN NO EVENT SHALL THE COPYRIGHT HOLDER OR CONTRIBUTORS BE LIABLE
 * FOR ANY DIRECT, INDIRECT, INCIDENTAL, SPECIAL, EXEMPLARY, OR CONSEQUENTIAL
 * DAMAGES (INCLUDING, BUT NOT LIMITED TO, PROCUREMENT OF SUBSTITUTE GOODS OR
 * SERVICES; LOSS OF USE, DATA, OR PROFITS; OR BUSINESS INTERRUPTION) HOWEVER
 * CAUSED AND ON ANY THEORY OF LIABILITY, WHETHER IN CONTRACT, STRICT LIABILITY,
 * OR TORT (INCLUDING NEGLIGENCE OR OTHERWISE) ARISING IN ANY WAY OUT OF THE USE
 * OF THIS SOFTWARE, EVEN IF ADVISED OF THE POSSIBILITY OF SUCH DAMAGE.
 */

/dts-v1/;

/ {
    brbct {
        ECID = <0x00000000 0x00000000 0x00000000 0x00000000>;
        SecureDebugControlEcid = <0>;
        SecureDebugControlNoneEcid = <0>;
        u32_non_gpio_select_boot_chain = <0>;
        u32_num_boot_chains = <4>;
        preprod_dev_sign = <1>;
        bf_bl_allbits {
            bf_bl_gpio_select_boot_chain_1b                = <0>;
            bf_bl_mb1_debug_production_1b                  = <0>;
            bf_bl_sc7_rf_debug_production_1b               = <0>;
            bf_bl_psc_bl_debug_production_1b               = <0>;
            bf_bl_psc_rf_debug_production_1b               = <0>;
            bf_bl_psc_fw_debug_production_1b               = <0>;
            bf_bl_bpmp_debug_production_1b                 = <0>;
            bf_bl_bpmp_ist_debug_production_1b             = <0>;
            bf_bl_mce_debug_production_1b                  = <0>;
            bf_bl_ist_ccplex_debug_production_1b           = <0>;
            bf_bl_ist_fw_debug_production_1b               = <0>;
            bf_bl_rtc_rail_violation_detect_1b             = <0>;
            bf_bl_cust_nv_ccplex_dfd_en_1b                 = <0>;
            bf_bl_debug_with_test_keys_1b                  = <0>;
            bf_bl_debug_with_test_keys_during_psc_debug_1b = <0>;
            bf_bl_disable_bootrom_clock_boost_1b           = <0>;
            bf_bl_disable_pscrom_clk_boost_1b              = <0>;
            bf_bl_enable_scpm_reset                        = <0>;
            bf_bl_skip_oem_auth_diag_boot                  = <0>;
            bf_bl_diag_boot                                = <0>;
            bf_bl_bpmp_diag_boot                           = <0>;
            bf_bl_l0_ist                                   = <1>;
            bf_bl_l1_ist                                   = <0>;
        };
    };
};
