/dts-v1/;

#include "tegra234-chip.dtsi"
#include "tegra234-mb2-bct-scr-p3701-0000-override.dts"

/ {
    tfc {
        reg@5138 { /* CBB_CENTRAL_CBB_FIREWALL_QSPI0_BLF, READ_CTL */
            exclusion-info = <2>;
            value = <0x00100009>;
        };

        reg@5139 { /* CBB_CENTRAL_CBB_FIREWALL_QSPI0_BLF, WRITE_CTL */
            exclusion-info = <2>;
            value = <0x00100009>;
        };
    };
};
