/*
 * SPDX-FileCopyrightText: Copyright (c) 2024 NVIDIA CORPORATION & AFFILIATES. All rights reserved.
 * SPDX-License-Identifier: LicenseRef-NvidiaProprietary
 *
 * NVIDIA CORPORATION, its affiliates and licensors retain all intellectual
 * property and proprietary rights in and to this material, related
 * documentation and any modifications thereto. Any use, reproduction,
 * disclosure or distribution of this material and related documentation
 * without an express license agreement from NVIDIA CORPORATION or
 * its affiliates is strictly prohibited.
 */

#include "tegra264-p3834-0008-rc00-maxn-alt-ecc.dtsi"
#include "tegra264-p3834-0008-rc01-maxn-alt-ecc.dtsi"
#include "tegra264-p3834-0008-rc02-maxn-alt-ecc.dtsi"
#include "tegra264-p3834-0008-rc03-maxn-alt-ecc.dtsi"
#include "tegra264-p3834-0008-rc04-maxn-alt-ecc.dtsi"
#include "tegra264-p3834-0008-rc05-maxn-alt-ecc.dtsi"
#include "tegra264-p3834-0008-rc06-maxn-alt-ecc.dtsi"
#include "tegra264-p3834-0008-rc07-maxn-alt-ecc.dtsi"
#include "tegra264-p3834-0008-rc08-maxn-alt-ecc.dtsi"
#include "tegra264-p3834-0008-rc09-maxn-alt-ecc.dtsi"
#include "tegra264-p3834-0008-rc10-maxn-alt-ecc.dtsi"
#include "tegra264-p3834-0008-rc11-maxn-alt-ecc.dtsi"
#include "tegra264-p3834-0008-rc12-maxn-alt-ecc.dtsi"
#include "tegra264-p3834-0008-rc13-maxn-alt-ecc.dtsi"
#include "tegra264-p3834-0008-rc14-maxn-alt-ecc.dtsi"
#include "tegra264-p3834-0008-rc15-maxn-alt-ecc.dtsi"
