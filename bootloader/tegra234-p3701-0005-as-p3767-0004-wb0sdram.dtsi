/*
 * SPDX-FileCopyrightText: Copyright (c) 2023 NVIDIA CORPORATION & AFFILIATES. All rights reserved.
 * SPDX-License-Identifier: LicenseRef-NvidiaProprietary
 *
 * NVIDIA CORPORATION, its affiliates and licensors retain all intellectual
 * property and proprietary rights in and to this material, related
 * documentation and any modifications thereto. Any use, reproduction,
 * disclosure or distribution of this material and related documentation
 * without an express license agreement from NVIDIA CORPORATION or
 * its affiliates is strictly prohibited.
 */

#include "tegra234-mb1-bct-p3701-0005-as-p3767-0004-rc00-204mhz.dtsi"
#include "tegra234-mb1-bct-p3701-0005-as-p3767-0004-rc01-204mhz.dtsi"
#include "tegra234-mb1-bct-p3701-0005-as-p3767-0004-rc02-204mhz.dtsi"
#include "tegra234-mb1-bct-p3701-0005-as-p3767-0004-rc03-204mhz.dtsi"
#include "tegra234-mb1-bct-p3701-0005-as-p3767-0004-rc04-204mhz.dtsi"
#include "tegra234-mb1-bct-p3701-0005-as-p3767-0004-rc05-204mhz.dtsi"
#include "tegra234-mb1-bct-p3701-0005-as-p3767-0004-rc06-204mhz.dtsi"
#include "tegra234-mb1-bct-p3701-0005-as-p3767-0004-rc07-204mhz.dtsi"
#include "tegra234-mb1-bct-p3701-0005-as-p3767-0004-rc08-204mhz.dtsi"
#include "tegra234-mb1-bct-p3701-0005-as-p3767-0004-rc09-204mhz.dtsi"
#include "tegra234-mb1-bct-p3701-0005-as-p3767-0004-rc10-204mhz.dtsi"
#include "tegra234-mb1-bct-p3701-0005-as-p3767-0004-rc11-204mhz.dtsi"
#include "tegra234-mb1-bct-p3701-0005-as-p3767-0004-rc12-204mhz.dtsi"
#include "tegra234-mb1-bct-p3701-0005-as-p3767-0004-rc13-204mhz.dtsi"
#include "tegra234-mb1-bct-p3701-0005-as-p3767-0004-rc14-204mhz.dtsi"
#include "tegra234-mb1-bct-p3701-0005-as-p3767-0004-rc15-204mhz.dtsi"
