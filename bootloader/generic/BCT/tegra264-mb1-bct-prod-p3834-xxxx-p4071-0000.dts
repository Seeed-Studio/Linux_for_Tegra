/*
 * SPDX-FileCopyrightText: Copyright (c) 2024-2025, NVIDIA CORPORATION & AFFILIATES. All rights reserved.
 * SPDX-License-Identifier: BSD-3-Clause
 *
 * Redistribution and use in source and binary forms, with or without
 * modification, are permitted provided that the following conditions are met:
 *
 * 1. Redistributions of source code must retain the above copyright notice, this
 * list of conditions and the following disclaimer.
 *
 * 2. Redistributions in binary form must reproduce the above copyright notice,
 * this list of conditions and the following disclaimer in the documentation
 * and/or other materials provided with the distribution.
 *
 * 3. Neither the name of the copyright holder nor the names of its
 * contributors may be used to endorse or promote products derived from
 * this software without specific prior written permission.
 *
 * THIS SOFTWARE IS PROVIDED BY THE COPYRIGHT HOLDERS AND CONTRIBUTORS "AS IS"
 * AND ANY EXPRESS OR IMPLIED WARRANTIES, INCLUDING, BUT NOT LIMITED TO, THE
 * IMPLIED WARRANTIES OF MERCHANTABILITY AND FITNESS FOR A PARTICULAR PURPOSE ARE
 * DISCLAIMED. IN NO EVENT SHALL THE COPYRIGHT HOLDER OR CONTRIBUTORS BE LIABLE
 * FOR ANY DIRECT, INDIRECT, INCIDENTAL, SPECIAL, EXEMPLARY, OR CONSEQUENTIAL
 * DAMAGES (INCLUDING, BUT NOT LIMITED TO, PROCUREMENT OF SUBSTITUTE GOODS OR
 * SERVICES; LOSS OF USE, DATA, OR PROFITS; OR BUSINESS INTERRUPTION) HOWEVER
 * CAUSED AND ON ANY THEORY OF LIABILITY, WHETHER IN CONTRACT, STRICT LIABILITY,
 * OR TORT (INCLUDING NEGLIGENCE OR OTHERWISE) ARISING IN ANY WAY OUT OF THE USE
 * OF THIS SOFTWARE, EVEN IF ADVISED OF THE POSSIBILITY OF SUCH DAMAGE.
 */
/*
# CFG Version 1.0
# This File contains the configuration of multiple rails.
*/
/dts-v1/;

#include "tegra264-mb1-bct-prod-common-l4t.dtsi"
/ {
prod@0 {

        addr-mask-data =
            /* I2C0 */
            <0xac287004 0x00f0f000 0x0000f000>,
            <0xac28700c 0x00f0f000 0x0000f000>,
            /* I2C1 */
            <0xac287014 0x00f0f000 0x00001000>,
            <0xac28701c 0x00f0f000 0x00001000>,
            /* I2C2 */
            <0x8c7a3004 0x00f0f000 0x0000f000>,
            <0x8c7a300c 0x00f0f000 0x0000f000>,
            /* I2C4 */
            <0x8c7a3014 0x00f0f000 0x0000f000>,
            <0x8c7a301c 0x00f0f000 0x0000f000>,
            /* SF_PWR_I2C */
            <0xac2870dc 0x00f0f000 0x0000f000>,
            <0xac2870d4 0x00f0f000 0x0000f000>,
            /* I2C8 */
            <0xac28804c 0x00f0f000 0x0000f000>,
            <0xac288054 0x00f0f000 0x0000f000>,
            /* I2C5 */
            <0xac28805c 0x00f0f000 0x0000f000>,
            <0xac288064 0x00f0f000 0x0000f000>,
            /* I2C7 */
            <0xac2860b4 0x00f0f000 0x0000f000>,
            <0xac2860bc 0x00f0f000 0x0000f000>,
            /* I2C3 */
            <0xac2810b4 0x00f0f000 0x0000f000>,
            <0xac2810bc 0x00f0f000 0x0000f000>,
            /* I2C6 */
            <0xb031400c 0x00f0f000 0x0000f000>,
            <0xb0314004 0x00f0f000 0x0000f000>,
            /* I2C9 */
            <0xac286004 0x00f0f000 0x0000f000>,
            <0xac28600c 0x00f0f000 0x0000f000>,
            /* I2C15 */
            <0xac28202c 0x00f0f000 0x0000f000>,
            <0xac282034 0x00f0f000 0x0000f000>,
            /* I2C10 */
            <0xac28b004 0x00f0f000 0x0000f000>,
            <0xac28b00c 0x00f0f000 0x0000f000>,
            /* QSPI0 */
            <0xac28400c 0x00f0f000 0x00a0a000>,
            <0xac284014 0x00f0f000 0x00a0a000>,
            <0xac28401c 0x00f0f000 0x00a0a000>,
            <0xac284024 0x00f0f000 0x00a0a000>,
            <0xac28402c 0x00f0f000 0x00f0f000>,
            <0xac284004 0x00f0f000 0x00a0a000>;
    };
};

