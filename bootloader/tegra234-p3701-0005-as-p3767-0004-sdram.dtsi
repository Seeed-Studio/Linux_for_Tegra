/*
 * SPDX-FileCopyrightText: Copyright (c) 2023 NVIDIA CORPORATION & AFFILIATES. All rights reserved.
 * SPDX-License-Identifier: LicenseRef-NvidiaProprietary
 *
 * NVIDIA CORPORATION, its affiliates and licensors retain all intellectual
 * property and proprietary rights in and to this material, related
 * documentation and any modifications thereto. Any use, reproduction,
 * disclosure or distribution of this material and related documentation
 * without an express license agreement from NVIDIA CORPORATION or
 * its affiliates is strictly prohibited.
 */

#include "tegra234-mb1-bct-p3701-0005-as-p3767-0004-rc00-665mhz.dtsi"
#include "tegra234-mb1-bct-p3701-0005-as-p3767-0004-rc01-665mhz.dtsi"
#include "tegra234-mb1-bct-p3701-0005-as-p3767-0004-rc02-665mhz.dtsi"
#include "tegra234-mb1-bct-p3701-0005-as-p3767-0004-rc03-665mhz.dtsi"
#include "tegra234-mb1-bct-p3701-0005-as-p3767-0004-rc04-665mhz.dtsi"
#include "tegra234-mb1-bct-p3701-0005-as-p3767-0004-rc05-665mhz.dtsi"
#include "tegra234-mb1-bct-p3701-0005-as-p3767-0004-rc06-665mhz.dtsi"
#include "tegra234-mb1-bct-p3701-0005-as-p3767-0004-rc07-665mhz.dtsi"
#include "tegra234-mb1-bct-p3701-0005-as-p3767-0004-rc08-665mhz.dtsi"
#include "tegra234-mb1-bct-p3701-0005-as-p3767-0004-rc09-665mhz.dtsi"
#include "tegra234-mb1-bct-p3701-0005-as-p3767-0004-rc10-665mhz.dtsi"
#include "tegra234-mb1-bct-p3701-0005-as-p3767-0004-rc11-665mhz.dtsi"
#include "tegra234-mb1-bct-p3701-0005-as-p3767-0004-rc12-665mhz.dtsi"
#include "tegra234-mb1-bct-p3701-0005-as-p3767-0004-rc13-665mhz.dtsi"
#include "tegra234-mb1-bct-p3701-0005-as-p3767-0004-rc14-665mhz.dtsi"
#include "tegra234-mb1-bct-p3701-0005-as-p3767-0004-rc15-665mhz.dtsi"
