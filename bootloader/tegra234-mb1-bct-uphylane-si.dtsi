/*
 * SPDX-FileCopyrightText: Copyright (c) 2023 NVIDIA CORPORATION & AFFILIATES. All rights reserved.
 * SPDX-License-Identifier: LicenseRef-NvidiaProprietary
 *
 * NVIDIA CORPORATION, its affiliates and licensors retain all intellectual
 * property and proprietary rights in and to this material, related
 * documentation and any modifications thereto. Any use, reproduction,
 * disclosure or distribution of this material and related documentation
 * without an express license agreement from NVIDIA CORPORATION or
 * its affiliates is strictly prohibited.
 */

/dts-v1/;


/ {
    uphy-lane {
            lane-owner-map = <0 4 1>, /* lane 4 assigned to UFS */
                             <0 5 1>, /* lane 5 assigned to UFS */
                             <0 6 1>, /* lane 6 assigned to UFS */
                             <0 7 1>; /* lane 7 assigned to UFS */
    };
};
